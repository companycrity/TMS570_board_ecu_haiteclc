AUTOSAR XML (schema 3.0.1)
package /MICROSAR
  module config SchM_Rec: definition=SchM, implementation-config-variant=VARIANT-PRE-COMPILE  # Configuration of the SchM (BSW Scheduler) module.
    3 x SchMMainFunctionMapping, all with SchMBswUsedOsEvent=SchM_AsyncEvent_1, SchMBswUsedOsAlarm=SchM_Alarm_Async_1, SchMBswActivationOffset=0.004, SchMTaskConfigurationRef=SchM_AsyncTask_1:
      Dcm_MainFunction: SchMPositionInTask=59
      Dcm_TimerTask: SchMPositionInTask=60
      Dcm_StateTask: SchMPositionInTask=61
