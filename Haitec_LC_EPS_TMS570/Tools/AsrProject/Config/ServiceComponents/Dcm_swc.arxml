AUTOSAR XML (schema 3.0.1)
standard types defined: Boolean, UInt8, UInt16, UInt32
package /ComponentType
  internal behavior DcmInternalBehavior: component=Dcm
    timing event Timer_Dcm_MainFunction: start-on-event=Dcm_MainFunction, period=0.01
    operation invoked event OpEventDCMServicesGetSe_7c9c20fe: start-on-event=GetSesCtrlType, operation=DCMServices.GetSesCtrlType
    operation invoked event OpEventDCMServicesGetSe_cab31b79: start-on-event=GetSecurityLevel, operation=DCMServices.GetSecurityLevel
    port-api-options:
      enable-take-address=true, indirect-api=false, port=DCMServices
      enable-take-address=true, indirect-api=false, port=DidServices_0x0100
      enable-take-address=true, indirect-api=false, port=DidServices_0xf180
      enable-take-address=true, indirect-api=false, port=DidServices_0xf187
      enable-take-address=true, indirect-api=false, port=DidServices_0xf18a
      enable-take-address=true, indirect-api=false, port=DidServices_0xf18c
      enable-take-address=true, indirect-api=false, port=DidServices_0xf191
      enable-take-address=true, indirect-api=false, port=DidServices_0xf{193..195}
      enable-take-address=true, indirect-api=false, port=DidServices_0xfd01
      enable-take-address=true, indirect-api=false, port=DidServices_0xfd02
      enable-take-address=true, indirect-api=false, port=DidServices_0xfd07
      enable-take-address=true, indirect-api=false, port=DidServices_0xfd0d
      enable-take-address=true, indirect-api=false, port=DidServices_0xfd0e
      enable-take-address=true, indirect-api=false, port=DidServices_0xfd{10..14}
      enable-take-address=true, indirect-api=false, port=DidServices_0xfd17
      enable-take-address=true, indirect-api=false, port=DidServices_0xfd19
      enable-take-address=true, indirect-api=false, port=DidServices_0xfd1a
      enable-take-address=true, indirect-api=false, port=DidServices_0xfd1b
      enable-take-address=true, indirect-api=false, port=DidServices_0xfd1c
      enable-take-address=true, indirect-api=false, port=DidServices_0xfd1e
      enable-take-address=true, indirect-api=false, port=DidServices_0xfd20
      enable-take-address=true, indirect-api=false, port=DidServices_0xfd21
      enable-take-address=true, indirect-api=false, port=DidServices_0xfd23
      enable-take-address=true, indirect-api=false, port=DidServices_0xfd{25..27}
      enable-take-address=true, indirect-api=false, port=DidServices_0xfd{29..31}
      enable-take-address=true, indirect-api=false, port=DidServices_0xfda{1..3}
      enable-take-address=true, indirect-api=false, port=DidServices_0xfdac
      enable-take-address=true, indirect-api=false, port=DidServices_0xfdad
      enable-take-address=true, indirect-api=false, port=DidServices_0xfdae
      enable-take-address=true, indirect-api=false, port=DidServices_0xfdaf
      enable-take-address=true, indirect-api=false, port=DidServices_0xfdb{0..7}
      enable-take-address=true, indirect-api=false, port=DidServices_0xfe00
      enable-take-address=true, indirect-api=false, port=RoutineServices_0xf000
      enable-take-address=true, indirect-api=false, port=RoutineServices_0xf001
      enable-take-address=true, indirect-api=false, port=RoutineServices_0xf{003..005}
      enable-take-address=true, indirect-api=false, port=RoutineServices_0xf008
      enable-take-address=true, indirect-api=false, port=RoutineServices_0xf009
      enable-take-address=true, indirect-api=false, port=RoutineServices_0xf0ff
      enable-take-address=true, indirect-api=false, port=RoutineServices_0xfee0
      enable-take-address=true, indirect-api=false, port=SecurityAccess_1
      enable-take-address=true, indirect-api=false, port=SessionControl
    runnable Dcm_MainFunction
      180 x sync call, all with timeout=0:
        OpCallDidServices_0x010_94be1579: operation=DidServices_0x0100.ConditionCheckRead
        OpCallDidServices_0x010_2c658a0f: operation=DidServices_0x0100.ReadData
        OpCallDidServices_0x010_8768ae68: operation=DidServices_0x0100.ConditionCheckWrite
        OpCallDidServices_0x010_32e129ee: operation=DidServices_0x0100.WriteData
        OpCallDidServices_0xf18_182df0cd: operation=DidServices_0xf180.ConditionCheckRead
        OpCallDidServices_0xf18_ecf43517: operation=DidServices_0xf180.ReadData
        OpCallDidServices_0xf18_52137b86: operation=DidServices_0xf187.ConditionCheckRead
        OpCallDidServices_0xf18_889558de: operation=DidServices_0xf187.ReadData
        OpCallDidServices_0xf18_aaacec8b: operation=DidServices_0xf187.ConditionCheckWrite
        OpCallDidServices_0xf18_c3913b7e: operation=DidServices_0xf187.WriteData
        OpCallDidServices_0xf18_9185a7b7: operation=DidServices_0xf18a.ConditionCheckRead
        OpCallDidServices_0xf18_89dd6022: operation=DidServices_0xf18a.ReadData
        OpCallDidServices_0xf18_fbb17a6d: operation=DidServices_0xf18a.ConditionCheckWrite
        OpCallDidServices_0xf18_779bcd71: operation=DidServices_0xf18a.WriteData
        OpCallDidServices_0xf18_a72b48a4: operation=DidServices_0xf18c.ReadData
        OpCallDidServices_0xf18_e531a146: operation=DidServices_0xf18c.ConditionCheckRead
        OpCallDidServices_0xf19_144d4a6a: operation=DidServices_0xf191.ReadData
        OpCallDidServices_0xf19_aaa84bd3: operation=DidServices_0xf191.ConditionCheckRead
        OpCallDidServices_0xf19_3abb62ec: operation=DidServices_0xf193.ReadData
        OpCallDidServices_0xf19_de1c4d22: operation=DidServices_0xf193.ConditionCheckRead
        OpCallDidServices_0xf19_5eda0f25: operation=DidServices_0xf194.ReadData
        OpCallDidServices_0xf19_9422c669: operation=DidServices_0xf194.ConditionCheckRead
        OpCallDidServices_0xf19_49a11b66: operation=DidServices_0xf195.ReadData
        OpCallDidServices_0xf19_43c04631: operation=DidServices_0xf195.ConditionCheckRead
        OpCallDidServices_0xfd0_e1b110c6: operation=DidServices_0xfd01.ReadData
        OpCallDidServices_0xfd0_60327e1f: operation=DidServices_0xfd01.ConditionCheckRead
        OpCallDidServices_0xfd0_3ba33c63: operation=DidServices_0xfd02.WriteData
        OpCallDidServices_0xfd0_8ce4aba4: operation=DidServices_0xfd02.ConditionCheckWrite
        OpCallDidServices_0xfd0_d83c2c03: operation=DidServices_0xfd02.ReadData
        OpCallDidServices_0xfd0_c364f8b6: operation=DidServices_0xfd02.ConditionCheckRead
        OpCallDidServices_0xfd0_dd8af727: operation=DidServices_0xfd07.WriteData
        OpCallDidServices_0xfd0_a76e7bbb: operation=DidServices_0xfd07.ConditionCheckWrite
        OpCallDidServices_0xfd0_92ab694c: operation=DidServices_0xfd07.ReadData
        OpCallDidServices_0xfd0_fdee750c: operation=DidServices_0xfd07.ConditionCheckRead
        OpCallDidServices_0xfd0_74941fb1: operation=DidServices_0xfd0d.ShortTermAdjustment
        OpCallDidServices_0xfd0_54ea4764: operation=DidServices_0xfd0d.ReturnControlToECU
        OpCallDidServices_0xfd0_d97414ff: operation=DidServices_0xfd0d.ReadData
        OpCallDidServices_0xfd0_00f22487: operation=DidServices_0xfd0d.ConditionCheckRead
        OpCallDidServices_0xfd0_d710a4df: operation=DidServices_0xfd0e.ConditionCheckRead
        OpCallDidServices_0xfd0_ce0f00bc: operation=DidServices_0xfd0e.ReadData
        OpCallDidServices_0xfd1_d2b7c501: operation=DidServices_0xfd10.ConditionCheckRead
        OpCallDidServices_0xfd1_19086fbb: operation=DidServices_0xfd10.ReadData
        OpCallDidServices_0xfd1_514d26ba: operation=DidServices_0xfd11.ReturnControlToECU
        OpCallDidServices_0xfd1_15fa4703: operation=DidServices_0xfd11.ShortTermAdjustment
        OpCallDidServices_0xfd1_05554559: operation=DidServices_0xfd11.ConditionCheckRead
        OpCallDidServices_0xfd1_0e737bf8: operation=DidServices_0xfd11.ReadData
        OpCallDidServices_0xfd1_a603c3f0: operation=DidServices_0xfd12.ConditionCheckRead
        OpCallDidServices_0xfd1_37fe473d: operation=DidServices_0xfd12.ReadData
        OpCallDidServices_0xfd1_133e283a: operation=DidServices_0xfd12.ConditionCheckWrite
        OpCallDidServices_0xfd1_fa2de3a3: operation=DidServices_0xfd12.WriteData
        OpCallDidServices_0xfd1_71e143a8: operation=DidServices_0xfd13.ConditionCheckRead
        OpCallDidServices_0xfd1_2085537e: operation=DidServices_0xfd13.ReadData
        OpCallDidServices_0xfd1_3bdfc8e3: operation=DidServices_0xfd14.ConditionCheckRead
        OpCallDidServices_0xfd1_44e43eb7: operation=DidServices_0xfd14.ReadData
        OpCallDidServices_0xfd1_98894e4a: operation=DidServices_0xfd17.ConditionCheckRead
        OpCallDidServices_0xfd1_7d690272: operation=DidServices_0xfd17.ReadData
        OpCallDidServices_0xfd1_0cf458dc: operation=DidServices_0xfd19.ConditionCheckRead
        OpCallDidServices_0xfd1_b5abd9e0: operation=DidServices_0xfd19.ReadData
        OpCallDidServices_0xfd1_214cb342: operation=DidServices_0xfd19.ConditionCheckWrite
        OpCallDidServices_0xfd1_02cd1854: operation=DidServices_0xfd19.WriteData
        OpCallDidServices_0xfd1_5b1f927b: operation=DidServices_0xfd1a.ConditionCheckRead
        OpCallDidServices_0xfd1_7c213a8e: operation=DidServices_0xfd1a.ReadData
        OpCallDidServices_0xfd1_f84914d2: operation=DidServices_0xfd1b.ConditionCheckRead
        OpCallDidServices_0xfd1_45ac064b: operation=DidServices_0xfd1b.ReadData
        OpCallDidServices_0xfd1_c6002309: operation=DidServices_0xfd1b.ConditionCheckWrite
        OpCallDidServices_0xfd1_433965eb: operation=DidServices_0xfd1b.WriteData
        OpCallDidServices_0xfd1_2fab948a: operation=DidServices_0xfd1c.ConditionCheckRead
        OpCallDidServices_0xfd1_52d71208: operation=DidServices_0xfd1c.ReadData
        OpCallDidServices_0xfd1_21cd6b82: operation=DidServices_0xfd1e.ReadData
        OpCallDidServices_0xfd1_2744859a: operation=DidServices_0xfd1e.ConditionCheckWrite
        OpCallDidServices_0xfd1_a1e57e92: operation=DidServices_0xfd1e.WriteData
        OpCallDidServices_0xfd1_b2779f99: operation=DidServices_0xfd1e.ConditionCheckRead
        OpCallDidServices_0xfd2_7d1e88cb: operation=DidServices_0xfd20.ConditionCheckRead
        OpCallDidServices_0xfd2_f23fd4b8: operation=DidServices_0xfd20.ReadData
        OpCallDidServices_0xfd2_aafc0893: operation=DidServices_0xfd21.ConditionCheckRead
        OpCallDidServices_0xfd2_e544c0fb: operation=DidServices_0xfd21.ReadData
        OpCallDidServices_0xfd2_c789e713: operation=DidServices_0xfd21.ConditionCheckWrite
        OpCallDidServices_0xfd2_88f83ea1: operation=DidServices_0xfd21.WriteData
        OpCallDidServices_0xfd2_de480e62: operation=DidServices_0xfd23.ConditionCheckRead
        OpCallDidServices_0xfd2_cbb2e87d: operation=DidServices_0xfd23.ReadData
        OpCallDidServices_0xfd2_0d47919f: operation=DidServices_0xfd23.ConditionCheckWrite
        OpCallDidServices_0xfd2_8c0dee9c: operation=DidServices_0xfd23.WriteData
        OpCallDidServices_0xfd2_43940571: operation=DidServices_0xfd25.ConditionCheckRead
        OpCallDidServices_0xfd2_b8a891f7: operation=DidServices_0xfd25.ReadData
        OpCallDidServices_0xfd2_89640c4a: operation=DidServices_0xfd25.ConditionCheckWrite
        OpCallDidServices_0xfd2_81139edb: operation=DidServices_0xfd25.WriteData
        OpCallDidServices_0xfd2_e0c283d8: operation=DidServices_0xfd26.ConditionCheckRead
        OpCallDidServices_0xfd2_8125ad32: operation=DidServices_0xfd26.ReadData
        OpCallDidServices_0xfd2_26cd4180: operation=DidServices_0xfd26.ConditionCheckWrite
        OpCallDidServices_0xfd2_6a2425d8: operation=DidServices_0xfd26.WriteData
        OpCallDidServices_0xfd2_37200380: operation=DidServices_0xfd27.ConditionCheckRead
        OpCallDidServices_0xfd2_965eb971: operation=DidServices_0xfd27.ReadData
        OpCallDidServices_0xfd2_43aa7ac6: operation=DidServices_0xfd27.ConditionCheckWrite
        OpCallDidServices_0xfd2_85e64ee6: operation=DidServices_0xfd27.WriteData
        OpCallDidServices_0xfd2_a35d1516: operation=DidServices_0xfd29.ConditionCheckRead
        OpCallDidServices_0xfd2_5e9c62e3: operation=DidServices_0xfd29.ReadData
        OpCallDidServices_0xfd2_5a5231a1: operation=DidServices_0xfd29.ConditionCheckWrite
        OpCallDidServices_0xfd2_9b2f7e55: operation=DidServices_0xfd29.WriteData
        OpCallDidServices_0xfd3_1879b38d: operation=DidServices_0xfd30.ConditionCheckRead
        OpCallDidServices_0xfd3_1dfdbf86: operation=DidServices_0xfd30.ReadData
        OpCallDidServices_0xfd3_3d345fcb: operation=DidServices_0xfd30.ConditionCheckWrite
        OpCallDidServices_0xfd3_a6b48a5f: operation=DidServices_0xfd30.WriteData
        OpCallDidServices_0xfd3_cf9b33d5: operation=DidServices_0xfd31.ConditionCheckRead
        OpCallDidServices_0xfd3_0a86abc5: operation=DidServices_0xfd31.ReadData
        OpCallDidServices_0xfda_d06b4e6a: operation=DidServices_0xfda1.ConditionCheckRead
        OpCallDidServices_0xfda_b767fdb0: operation=DidServices_0xfda1.ReadData
        OpCallDidServices_0xfda_03923aed: operation=DidServices_0xfda1.ConditionCheckWrite
        OpCallDidServices_0xfda_69a48584: operation=DidServices_0xfda1.WriteData
        OpCallDidServices_0xfda_733dc8c3: operation=DidServices_0xfda2.ConditionCheckRead
        OpCallDidServices_0xfda_8eeac175: operation=DidServices_0xfda2.ReadData
        OpCallDidServices_0xfda_ac3b7727: operation=DidServices_0xfda2.ConditionCheckWrite
        OpCallDidServices_0xfda_82933e87: operation=DidServices_0xfda2.WriteData
        OpCallDidServices_0xfda_a4df489b: operation=DidServices_0xfda3.ConditionCheckRead
        OpCallDidServices_0xfda_9991d536: operation=DidServices_0xfda3.ReadData
        OpCallDidServices_0xfda_c95c4c61: operation=DidServices_0xfda3.ConditionCheckWrite
        OpCallDidServices_0xfda_6d5155b9: operation=DidServices_0xfda3.WriteData
        OpCallDidServices_0xfda_fa959fb9: operation=DidServices_0xfdac.ConditionCheckRead
        OpCallDidServices_0xfda_ebc39440: operation=DidServices_0xfdac.ReadData
        OpCallDidServices_0xfda_1c624752: operation=DidServices_0xfdac.ConditionCheckWrite
        OpCallDidServices_0xfda_d445d3f1: operation=DidServices_0xfdac.WriteData
        OpCallDidServices_0xfda_b0ab14f2: operation=DidServices_0xfdad.ConditionCheckRead
        OpCallDidServices_0xfda_8fa2f989: operation=DidServices_0xfdad.ReadData
        OpCallDidServices_0xfda_674994aa: operation=DidServices_0xfdae.ConditionCheckRead
        OpCallDidServices_0xfda_98d9edca: operation=DidServices_0xfdae.ReadData
        OpCallDidServices_0xfda_9841da87: operation=DidServices_0xfdae.ConditionCheckWrite
        OpCallDidServices_0xfda_d95ba3b6: operation=DidServices_0xfdae.WriteData
        OpCallDidServices_0xfda_c41f1203: operation=DidServices_0xfdaf.ConditionCheckRead
        OpCallDidServices_0xfda_a154d10f: operation=DidServices_0xfdaf.ReadData
        OpCallDidServices_0xfdb_a82083f8: operation=DidServices_0xfdb0.ConditionCheckRead
        OpCallDidServices_0xfdb_4b2b52f0: operation=DidServices_0xfdb0.ReadData
        OpCallDidServices_0xfdb_1deb8348: operation=DidServices_0xfdb0.ConditionCheckWrite
        OpCallDidServices_0xfdb_1f8488bb: operation=DidServices_0xfdb0.WriteData
        OpCallDidServices_0xfdb_7fc203a0: operation=DidServices_0xfdb1.ConditionCheckRead
        OpCallDidServices_0xfdb_5c5046b3: operation=DidServices_0xfdb1.ReadData
        OpCallDidServices_0xfdb_788cb80e: operation=DidServices_0xfdb1.ConditionCheckWrite
        OpCallDidServices_0xfdb_f046e385: operation=DidServices_0xfdb1.WriteData
        OpCallDidServices_0xfdb_dc948509: operation=DidServices_0xfdb2.ConditionCheckRead
        OpCallDidServices_0xfdb_65dd7a76: operation=DidServices_0xfdb2.ReadData
        OpCallDidServices_0xfdb_d725f5c4: operation=DidServices_0xfdb2.ConditionCheckWrite
        OpCallDidServices_0xfdb_1b715886: operation=DidServices_0xfdb2.WriteData
        OpCallDidServices_0xfdb_0b760551: operation=DidServices_0xfdb3.ConditionCheckRead
        OpCallDidServices_0xfdb_72a66e35: operation=DidServices_0xfdb3.ReadData
        OpCallDidServices_0xfdb_b242ce82: operation=DidServices_0xfdb3.ConditionCheckWrite
        OpCallDidServices_0xfdb_f4b333b8: operation=DidServices_0xfdb3.WriteData
        OpCallDidServices_0xfdb_41488e1a: operation=DidServices_0xfdb4.ConditionCheckRead
        OpCallDidServices_0xfdb_16c703fc: operation=DidServices_0xfdb4.ReadData
        OpCallDidServices_0xfdb_53066811: operation=DidServices_0xfdb4.ConditionCheckWrite
        OpCallDidServices_0xfdb_166f28c1: operation=DidServices_0xfdb4.WriteData
        OpCallDidServices_0xfdb_96aa0e42: operation=DidServices_0xfdb5.ConditionCheckRead
        OpCallDidServices_0xfdb_01bc17bf: operation=DidServices_0xfdb5.ReadData
        OpCallDidServices_0xfdb_36615357: operation=DidServices_0xfdb5.ConditionCheckWrite
        OpCallDidServices_0xfdb_f9ad43ff: operation=DidServices_0xfdb5.WriteData
        OpCallDidServices_0xfdb_35fc88eb: operation=DidServices_0xfdb6.ConditionCheckRead
        OpCallDidServices_0xfdb_38312b7a: operation=DidServices_0xfdb6.ReadData
        OpCallDidServices_0xfdb_99c81e9d: operation=DidServices_0xfdb6.ConditionCheckWrite
        OpCallDidServices_0xfdb_129af8fc: operation=DidServices_0xfdb6.WriteData
        OpCallDidServices_0xfdb_e21e08b3: operation=DidServices_0xfdb7.ConditionCheckRead
        OpCallDidServices_0xfdb_2f4a3f39: operation=DidServices_0xfdb7.ReadData
        OpCallDidServices_0xfdb_fcaf25db: operation=DidServices_0xfdb7.ConditionCheckWrite
        OpCallDidServices_0xfdb_fd5893c2: operation=DidServices_0xfdb7.WriteData
        OpCallDidServices_0xfe0_280a7dd9: operation=DidServices_0xfe00.ConditionCheckRead
        OpCallDidServices_0xfe0_3744db45: operation=DidServices_0xfe00.ReadData
        OpCallDidServices_0xfe0_7c121e3a: operation=DidServices_0xfe00.ReturnControlToECU
        OpCallDidServices_0xfe0_f86f9b1b: operation=DidServices_0xfe00.ShortTermAdjustment
        OpCallRoutineServices_0_9f4df301: operation=RoutineServices_0xf000.Start
        OpCallRoutineServices_0_541120a4: operation=RoutineServices_0xf001.Start
        OpCallRoutineServices_0_19d981af: operation=RoutineServices_0xf003.Start
        OpCallRoutineServices_0_04dcb117: operation=RoutineServices_0xf004.Start
        OpCallRoutineServices_0_cf8062b2: operation=RoutineServices_0xf005.Start
        OpCallRoutineServices_0_731e716c: operation=RoutineServices_0xf008.Start
        OpCallRoutineServices_0_b842a2c9: operation=RoutineServices_0xf009.Start
        OpCallRoutineServices_0_80e0fac7: operation=RoutineServices_0xf009.Stop
        OpCallRoutineServices_0_0a9f5a08: operation=RoutineServices_0xf009.RequestResults
        OpCallRoutineServices_0_059fc466: operation=RoutineServices_0xf0ff.Start
        OpCallRoutineServices_0_f366c8b3: operation=RoutineServices_0xfee0.Start
        OpCallSecurityAccess_1G_ec488dd4: operation=SecurityAccess_1.GetSeed
        OpCallSecurityAccess_1C_3efe12e9: operation=SecurityAccess_1.CompareKey
        OpCallSessionControlGet_64367608: operation=SessionControl.GetSesChgPermission
        OpCallSessionControlCha_47bf291b: operation=SessionControl.ChangeIndication
        OpCallSessionControlCon_0d7cfb34: operation=SessionControl.ConfirmationRespPending
    runnable GetSesCtrlType: can-be-invoked-concurrently=true, symbol=Dcm_GetSesCtrlType
    runnable GetSecurityLevel: can-be-invoked-concurrently=true, symbol=Dcm_GetSecurityLevel
  swc implementation DcmImplementation: behavior=DcmInternalBehavior
  service component type Dcm: category=ServiceComponent
    provide port DCMServices: provided-interface=DCMServices
    61 x require port:
      DidServices_0x0100: required-interface=DidServices_0x0100
      DidServices_0xf180: required-interface=DidServices_0xf180
      DidServices_0xf187: required-interface=DidServices_0xf187
      DidServices_0xf18a: required-interface=DidServices_0xf18a
      DidServices_0xf18c: required-interface=DidServices_0xf18c
      DidServices_0xf191: required-interface=DidServices_0xf191
      DidServices_0xf{193..195}: required-interface=DidServices_0xf{193..195}
      DidServices_0xfd01: required-interface=DidServices_0xfd01
      DidServices_0xfd02: required-interface=DidServices_0xfd02
      DidServices_0xfd07: required-interface=DidServices_0xfd07
      DidServices_0xfd0d: required-interface=DidServices_0xfd0d
      DidServices_0xfd0e: required-interface=DidServices_0xfd0e
      DidServices_0xfd{10..14}: required-interface=DidServices_0xfd{10..14}
      DidServices_0xfd17: required-interface=DidServices_0xfd17
      DidServices_0xfd19: required-interface=DidServices_0xfd19
      DidServices_0xfd1a: required-interface=DidServices_0xfd1a
      DidServices_0xfd1b: required-interface=DidServices_0xfd1b
      DidServices_0xfd1c: required-interface=DidServices_0xfd1c
      DidServices_0xfd1e: required-interface=DidServices_0xfd1e
      DidServices_0xfd20: required-interface=DidServices_0xfd20
      DidServices_0xfd21: required-interface=DidServices_0xfd21
      DidServices_0xfd23: required-interface=DidServices_0xfd23
      DidServices_0xfd{25..27}: required-interface=DidServices_0xfd{25..27}
      DidServices_0xfd{29..31}: required-interface=DidServices_0xfd{29..31}
      DidServices_0xfda{1..3}: required-interface=DidServices_0xfda{1..3}
      DidServices_0xfdac: required-interface=DidServices_0xfdac
      DidServices_0xfdad: required-interface=DidServices_0xfdad
      DidServices_0xfdae: required-interface=DidServices_0xfdae
      DidServices_0xfdaf: required-interface=DidServices_0xfdaf
      DidServices_0xfdb{0..7}: required-interface=DidServices_0xfdb{0..7}
      DidServices_0xfe00: required-interface=DidServices_0xfe00
      RoutineServices_0xf000: required-interface=RoutineServices_0xf000
      RoutineServices_0xf001: required-interface=RoutineServices_0xf001
      RoutineServices_0xf{003..005}: required-interface=RoutineServices_0xf{003..005}
      RoutineServices_0xf008: required-interface=RoutineServices_0xf008
      RoutineServices_0xf009: required-interface=RoutineServices_0xf009
      RoutineServices_0xf0ff: required-interface=RoutineServices_0xf0ff
      RoutineServices_0xfee0: required-interface=RoutineServices_0xfee0
      SecurityAccess_1: required-interface=SecurityAccess_1
      SessionControl: required-interface=SessionControl
package /PortInterface
  62 x client server interface, all with is-service=true:
    DCMServices
      operation GetSesCtrlType: possible-error=DCMServices/E_NOT_OK
        arg SessionCtrlType: type=Dcm_SesCtrlType, direction=OUT
      operation GetSecurityLevel: possible-error=DCMServices/E_NOT_OK
        arg SecLevel: type=Dcm_SecLevelType, direction=OUT
      error E_NOT_OK: error-code=1
      error E_PENDING: error-code=10
    DidServices_0x0100
      4 x operation:
        ConditionCheckRead: possible-error=DidServices_0x0100/E_PENDING
          arg ErrorCode: type=Dcm_NegativeResponseCodeType, direction=OUT
        ReadData: possible-error=[DidServices_0x0100/E_NOT_OK, DidServices_0x0100/E_PENDING]
          arg data: type=Dcm_1Byte_Type, direction=INOUT
        ConditionCheckWrite: possible-error=DidServices_0x0100/E_PENDING
          arg ErrorCode: type=Dcm_NegativeResponseCodeType, direction=OUT
        WriteData: possible-error=DidServices_0x0100/E_PENDING
          arg data: type=Dcm_1Byte_Type, direction=INOUT
          arg dataLength: type=UInt16, direction=IN
          arg ErrorCode: type=Dcm_NegativeResponseCodeType, direction=OUT
      error E_NOT_OK: error-code=1
      error E_PENDING: error-code=10
    DidServices_0xf180
      operation ConditionCheckRead: possible-error=DidServices_0xf180/E_PENDING
        arg ErrorCode: type=Dcm_NegativeResponseCodeType, direction=OUT
      operation ReadData: possible-error=[DidServices_0xf180/E_NOT_OK, DidServices_0xf180/E_PENDING]
        arg data: type=Dcm_25Byte_Type, direction=INOUT
      error E_NOT_OK: error-code=1
      error E_PENDING: error-code=10
    DidServices_0xf187
      4 x operation:
        ConditionCheckRead: possible-error=DidServices_0xf187/E_PENDING
          arg ErrorCode: type=Dcm_NegativeResponseCodeType, direction=OUT
        ReadData: possible-error=[DidServices_0xf187/E_NOT_OK, DidServices_0xf187/E_PENDING]
          arg data: type=Dcm_10Byte_Type, direction=INOUT
        ConditionCheckWrite: possible-error=DidServices_0xf187/E_PENDING
          arg ErrorCode: type=Dcm_NegativeResponseCodeType, direction=OUT
        WriteData: possible-error=DidServices_0xf187/E_PENDING
          arg data: type=Dcm_10Byte_Type, direction=INOUT
          arg dataLength: type=UInt16, direction=IN
          arg ErrorCode: type=Dcm_NegativeResponseCodeType, direction=OUT
      error E_NOT_OK: error-code=1
      error E_PENDING: error-code=10
    DidServices_0xf18a
      4 x operation:
        ConditionCheckRead: possible-error=DidServices_0xf18a/E_PENDING
          arg ErrorCode: type=Dcm_NegativeResponseCodeType, direction=OUT
        ReadData: possible-error=[DidServices_0xf18a/E_NOT_OK, DidServices_0xf18a/E_PENDING]
          arg data: type=Dcm_10Byte_Type, direction=INOUT
        ConditionCheckWrite: possible-error=DidServices_0xf18a/E_PENDING
          arg ErrorCode: type=Dcm_NegativeResponseCodeType, direction=OUT
        WriteData: possible-error=DidServices_0xf18a/E_PENDING
          arg data: type=Dcm_10Byte_Type, direction=INOUT
          arg dataLength: type=UInt16, direction=IN
          arg ErrorCode: type=Dcm_NegativeResponseCodeType, direction=OUT
      error E_NOT_OK: error-code=1
      error E_PENDING: error-code=10
    DidServices_0xf18c
      operation ConditionCheckRead: possible-error=DidServices_0xf18c/E_PENDING
        arg ErrorCode: type=Dcm_NegativeResponseCodeType, direction=OUT
      operation ReadData: possible-error=[DidServices_0xf18c/E_NOT_OK, DidServices_0xf18c/E_PENDING]
        arg data: type=Dcm_16Byte_Type, direction=INOUT
      error E_NOT_OK: error-code=1
      error E_PENDING: error-code=10
    DidServices_0xf191
      operation ConditionCheckRead: possible-error=DidServices_0xf191/E_PENDING
        arg ErrorCode: type=Dcm_NegativeResponseCodeType, direction=OUT
      operation ReadData: possible-error=[DidServices_0xf191/E_NOT_OK, DidServices_0xf191/E_PENDING]
        arg data: type=Dcm_16Byte_Type, direction=INOUT
      error E_NOT_OK: error-code=1
      error E_PENDING: error-code=10
    DidServices_0xf193
      operation ConditionCheckRead: possible-error=DidServices_0xf193/E_PENDING
        arg ErrorCode: type=Dcm_NegativeResponseCodeType, direction=OUT
      operation ReadData: possible-error=[DidServices_0xf193/E_NOT_OK, DidServices_0xf193/E_PENDING]
        arg data: type=Dcm_10Byte_Type, direction=INOUT
      error E_NOT_OK: error-code=1
      error E_PENDING: error-code=10
    DidServices_0xf194
      operation ConditionCheckRead: possible-error=DidServices_0xf194/E_PENDING
        arg ErrorCode: type=Dcm_NegativeResponseCodeType, direction=OUT
      operation ReadData: possible-error=[DidServices_0xf194/E_NOT_OK, DidServices_0xf194/E_PENDING]
        arg data: type=Dcm_10Byte_Type, direction=INOUT
      error E_NOT_OK: error-code=1
      error E_PENDING: error-code=10
    DidServices_0xf195
      operation ConditionCheckRead: possible-error=DidServices_0xf195/E_PENDING
        arg ErrorCode: type=Dcm_NegativeResponseCodeType, direction=OUT
      operation ReadData: possible-error=[DidServices_0xf195/E_NOT_OK, DidServices_0xf195/E_PENDING]
        arg data: type=Dcm_10Byte_Type, direction=INOUT
      error E_NOT_OK: error-code=1
      error E_PENDING: error-code=10
    DidServices_0xfd01
      operation ConditionCheckRead: possible-error=DidServices_0xfd01/E_PENDING
        arg ErrorCode: type=Dcm_NegativeResponseCodeType, direction=OUT
      operation ReadData: possible-error=[DidServices_0xfd01/E_NOT_OK, DidServices_0xfd01/E_PENDING]
        arg data: type=Dcm_322Byte_Type, direction=INOUT
      error E_NOT_OK: error-code=1
      error E_PENDING: error-code=10
    DidServices_0xfd02
      4 x operation:
        ConditionCheckRead: possible-error=DidServices_0xfd02/E_PENDING
          arg ErrorCode: type=Dcm_NegativeResponseCodeType, direction=OUT
        ReadData: possible-error=[DidServices_0xfd02/E_NOT_OK, DidServices_0xfd02/E_PENDING]
          arg data: type=Dcm_4Byte_Type, direction=INOUT
        ConditionCheckWrite: possible-error=DidServices_0xfd02/E_PENDING
          arg ErrorCode: type=Dcm_NegativeResponseCodeType, direction=OUT
        WriteData: possible-error=DidServices_0xfd02/E_PENDING
          arg data: type=Dcm_4Byte_Type, direction=INOUT
          arg dataLength: type=UInt16, direction=IN
          arg ErrorCode: type=Dcm_NegativeResponseCodeType, direction=OUT
      error E_NOT_OK: error-code=1
      error E_PENDING: error-code=10
    DidServices_0xfd07
      4 x operation:
        ConditionCheckRead: possible-error=DidServices_0xfd07/E_PENDING
          arg ErrorCode: type=Dcm_NegativeResponseCodeType, direction=OUT
        ReadData: possible-error=[DidServices_0xfd07/E_NOT_OK, DidServices_0xfd07/E_PENDING]
          arg data: type=Dcm_1Byte_Type, direction=INOUT
        ConditionCheckWrite: possible-error=DidServices_0xfd07/E_PENDING
          arg ErrorCode: type=Dcm_NegativeResponseCodeType, direction=OUT
        WriteData: possible-error=DidServices_0xfd07/E_PENDING
          arg data: type=Dcm_1Byte_Type, direction=INOUT
          arg dataLength: type=UInt16, direction=IN
          arg ErrorCode: type=Dcm_NegativeResponseCodeType, direction=OUT
      error E_NOT_OK: error-code=1
      error E_PENDING: error-code=10
    DidServices_0xfd0d
      4 x operation:
        ConditionCheckRead: possible-error=DidServices_0xfd0d/E_PENDING
          arg ErrorCode: type=Dcm_NegativeResponseCodeType, direction=OUT
        ReadData: possible-error=[DidServices_0xfd0d/E_NOT_OK, DidServices_0xfd0d/E_PENDING]
          arg data: type=Dcm_2Byte_Type, direction=INOUT
        ReturnControlToECU: possible-error=DidServices_0xfd0d/E_PENDING
          4 x arg:
            RequestData: type=Dcm_0Byte_Type, direction=INOUT
            RequestDataLength: type=UInt16, direction=IN
            ResponseData: type=Dcm_2Byte_Type, direction=INOUT
            ErrorCode: type=Dcm_NegativeResponseCodeType, direction=OUT
        ShortTermAdjustment: possible-error=DidServices_0xfd0d/E_PENDING
          4 x arg:
            RequestData: type=Dcm_2Byte_Type, direction=INOUT
            RequestDataLength: type=UInt16, direction=IN
            ResponseData: type=Dcm_2Byte_Type, direction=INOUT
            ErrorCode: type=Dcm_NegativeResponseCodeType, direction=OUT
      error E_NOT_OK: error-code=1
      error E_PENDING: error-code=10
    DidServices_0xfd0e
      operation ConditionCheckRead: possible-error=DidServices_0xfd0e/E_PENDING
        arg ErrorCode: type=Dcm_NegativeResponseCodeType, direction=OUT
      operation ReadData: possible-error=[DidServices_0xfd0e/E_NOT_OK, DidServices_0xfd0e/E_PENDING]
        arg data: type=Dcm_8Byte_Type, direction=INOUT
      error E_NOT_OK: error-code=1
      error E_PENDING: error-code=10
    DidServices_0xfd10
      operation ConditionCheckRead: possible-error=DidServices_0xfd10/E_PENDING
        arg ErrorCode: type=Dcm_NegativeResponseCodeType, direction=OUT
      operation ReadData: possible-error=[DidServices_0xfd10/E_NOT_OK, DidServices_0xfd10/E_PENDING]
        arg data: type=Dcm_10Byte_Type, direction=INOUT
      error E_NOT_OK: error-code=1
      error E_PENDING: error-code=10
    DidServices_0xfd11
      4 x operation:
        ConditionCheckRead: possible-error=DidServices_0xfd11/E_PENDING
          arg ErrorCode: type=Dcm_NegativeResponseCodeType, direction=OUT
        ReadData: possible-error=[DidServices_0xfd11/E_NOT_OK, DidServices_0xfd11/E_PENDING]
          arg data: type=Dcm_2Byte_Type, direction=INOUT
        ReturnControlToECU: possible-error=DidServices_0xfd11/E_PENDING
          4 x arg:
            RequestData: type=Dcm_0Byte_Type, direction=INOUT
            RequestDataLength: type=UInt16, direction=IN
            ResponseData: type=Dcm_2Byte_Type, direction=INOUT
            ErrorCode: type=Dcm_NegativeResponseCodeType, direction=OUT
        ShortTermAdjustment: possible-error=DidServices_0xfd11/E_PENDING
          4 x arg:
            RequestData: type=Dcm_2Byte_Type, direction=INOUT
            RequestDataLength: type=UInt16, direction=IN
            ResponseData: type=Dcm_2Byte_Type, direction=INOUT
            ErrorCode: type=Dcm_NegativeResponseCodeType, direction=OUT
      error E_NOT_OK: error-code=1
      error E_PENDING: error-code=10
    DidServices_0xfd12
      4 x operation:
        ConditionCheckRead: possible-error=DidServices_0xfd12/E_PENDING
          arg ErrorCode: type=Dcm_NegativeResponseCodeType, direction=OUT
        ReadData: possible-error=[DidServices_0xfd12/E_NOT_OK, DidServices_0xfd12/E_PENDING]
          arg data: type=Dcm_28Byte_Type, direction=INOUT
        ConditionCheckWrite: possible-error=DidServices_0xfd12/E_PENDING
          arg ErrorCode: type=Dcm_NegativeResponseCodeType, direction=OUT
        WriteData: possible-error=DidServices_0xfd12/E_PENDING
          arg data: type=Dcm_28Byte_Type, direction=INOUT
          arg dataLength: type=UInt16, direction=IN
          arg ErrorCode: type=Dcm_NegativeResponseCodeType, direction=OUT
      error E_NOT_OK: error-code=1
      error E_PENDING: error-code=10
    DidServices_0xfd13
      operation ConditionCheckRead: possible-error=DidServices_0xfd13/E_PENDING
        arg ErrorCode: type=Dcm_NegativeResponseCodeType, direction=OUT
      operation ReadData: possible-error=[DidServices_0xfd13/E_NOT_OK, DidServices_0xfd13/E_PENDING]
        arg data: type=Dcm_75Byte_Type, direction=INOUT
      error E_NOT_OK: error-code=1
      error E_PENDING: error-code=10
    DidServices_0xfd14
      operation ConditionCheckRead: possible-error=DidServices_0xfd14/E_PENDING
        arg ErrorCode: type=Dcm_NegativeResponseCodeType, direction=OUT
      operation ReadData: possible-error=[DidServices_0xfd14/E_NOT_OK, DidServices_0xfd14/E_PENDING]
        arg data: type=Dcm_2Byte_Type, direction=INOUT
      error E_NOT_OK: error-code=1
      error E_PENDING: error-code=10
    DidServices_0xfd17
      operation ConditionCheckRead: possible-error=DidServices_0xfd17/E_PENDING
        arg ErrorCode: type=Dcm_NegativeResponseCodeType, direction=OUT
      operation ReadData: possible-error=[DidServices_0xfd17/E_NOT_OK, DidServices_0xfd17/E_PENDING]
        arg data: type=Dcm_2Byte_Type, direction=INOUT
      error E_NOT_OK: error-code=1
      error E_PENDING: error-code=10
    DidServices_0xfd19
      4 x operation:
        ConditionCheckRead: possible-error=DidServices_0xfd19/E_PENDING
          arg ErrorCode: type=Dcm_NegativeResponseCodeType, direction=OUT
        ReadData: possible-error=[DidServices_0xfd19/E_NOT_OK, DidServices_0xfd19/E_PENDING]
          arg data: type=Dcm_1Byte_Type, direction=INOUT
        ConditionCheckWrite: possible-error=DidServices_0xfd19/E_PENDING
          arg ErrorCode: type=Dcm_NegativeResponseCodeType, direction=OUT
        WriteData: possible-error=DidServices_0xfd19/E_PENDING
          arg data: type=Dcm_1Byte_Type, direction=INOUT
          arg dataLength: type=UInt16, direction=IN
          arg ErrorCode: type=Dcm_NegativeResponseCodeType, direction=OUT
      error E_NOT_OK: error-code=1
      error E_PENDING: error-code=10
    DidServices_0xfd1a
      operation ConditionCheckRead: possible-error=DidServices_0xfd1a/E_PENDING
        arg ErrorCode: type=Dcm_NegativeResponseCodeType, direction=OUT
      operation ReadData: possible-error=[DidServices_0xfd1a/E_NOT_OK, DidServices_0xfd1a/E_PENDING]
        arg data: type=Dcm_1Byte_Type, direction=INOUT
      error E_NOT_OK: error-code=1
      error E_PENDING: error-code=10
    DidServices_0xfd1b
      4 x operation:
        ConditionCheckRead: possible-error=DidServices_0xfd1b/E_PENDING
          arg ErrorCode: type=Dcm_NegativeResponseCodeType, direction=OUT
        ReadData: possible-error=[DidServices_0xfd1b/E_NOT_OK, DidServices_0xfd1b/E_PENDING]
          arg data: type=Dcm_1Byte_Type, direction=INOUT
        ConditionCheckWrite: possible-error=DidServices_0xfd1b/E_PENDING
          arg ErrorCode: type=Dcm_NegativeResponseCodeType, direction=OUT
        WriteData: possible-error=DidServices_0xfd1b/E_PENDING
          arg data: type=Dcm_1Byte_Type, direction=INOUT
          arg dataLength: type=UInt16, direction=IN
          arg ErrorCode: type=Dcm_NegativeResponseCodeType, direction=OUT
      error E_NOT_OK: error-code=1
      error E_PENDING: error-code=10
    DidServices_0xfd1c
      operation ConditionCheckRead: possible-error=DidServices_0xfd1c/E_PENDING
        arg ErrorCode: type=Dcm_NegativeResponseCodeType, direction=OUT
      operation ReadData: possible-error=[DidServices_0xfd1c/E_NOT_OK, DidServices_0xfd1c/E_PENDING]
        arg data: type=Dcm_3Byte_Type, direction=INOUT
      error E_NOT_OK: error-code=1
      error E_PENDING: error-code=10
    DidServices_0xfd1e
      4 x operation:
        ConditionCheckRead: possible-error=DidServices_0xfd1e/E_PENDING
          arg ErrorCode: type=Dcm_NegativeResponseCodeType, direction=OUT
        ReadData: possible-error=[DidServices_0xfd1e/E_NOT_OK, DidServices_0xfd1e/E_PENDING]
          arg data: type=Dcm_2Byte_Type, direction=INOUT
        ConditionCheckWrite: possible-error=DidServices_0xfd1e/E_PENDING
          arg ErrorCode: type=Dcm_NegativeResponseCodeType, direction=OUT
        WriteData: possible-error=DidServices_0xfd1e/E_PENDING
          arg data: type=Dcm_2Byte_Type, direction=INOUT
          arg dataLength: type=UInt16, direction=IN
          arg ErrorCode: type=Dcm_NegativeResponseCodeType, direction=OUT
      error E_NOT_OK: error-code=1
      error E_PENDING: error-code=10
    DidServices_0xfd20
      operation ConditionCheckRead: possible-error=DidServices_0xfd20/E_PENDING
        arg ErrorCode: type=Dcm_NegativeResponseCodeType, direction=OUT
      operation ReadData: possible-error=[DidServices_0xfd20/E_NOT_OK, DidServices_0xfd20/E_PENDING]
        arg data: type=Dcm_3Byte_Type, direction=INOUT
      error E_NOT_OK: error-code=1
      error E_PENDING: error-code=10
    DidServices_0xfd21
      4 x operation:
        ConditionCheckRead: possible-error=DidServices_0xfd21/E_PENDING
          arg ErrorCode: type=Dcm_NegativeResponseCodeType, direction=OUT
        ReadData: possible-error=[DidServices_0xfd21/E_NOT_OK, DidServices_0xfd21/E_PENDING]
          arg data: type=Dcm_1Byte_Type, direction=INOUT
        ConditionCheckWrite: possible-error=DidServices_0xfd21/E_PENDING
          arg ErrorCode: type=Dcm_NegativeResponseCodeType, direction=OUT
        WriteData: possible-error=DidServices_0xfd21/E_PENDING
          arg data: type=Dcm_1Byte_Type, direction=INOUT
          arg dataLength: type=UInt16, direction=IN
          arg ErrorCode: type=Dcm_NegativeResponseCodeType, direction=OUT
      error E_NOT_OK: error-code=1
      error E_PENDING: error-code=10
    DidServices_0xfd23
      4 x operation:
        ConditionCheckRead: possible-error=DidServices_0xfd23/E_PENDING
          arg ErrorCode: type=Dcm_NegativeResponseCodeType, direction=OUT
        ReadData: possible-error=[DidServices_0xfd23/E_NOT_OK, DidServices_0xfd23/E_PENDING]
          arg data: type=Dcm_1Byte_Type, direction=INOUT
        ConditionCheckWrite: possible-error=DidServices_0xfd23/E_PENDING
          arg ErrorCode: type=Dcm_NegativeResponseCodeType, direction=OUT
        WriteData: possible-error=DidServices_0xfd23/E_PENDING
          arg data: type=Dcm_1Byte_Type, direction=INOUT
          arg dataLength: type=UInt16, direction=IN
          arg ErrorCode: type=Dcm_NegativeResponseCodeType, direction=OUT
      error E_NOT_OK: error-code=1
      error E_PENDING: error-code=10
    DidServices_0xfd25
      4 x operation:
        ConditionCheckRead: possible-error=DidServices_0xfd25/E_PENDING
          arg ErrorCode: type=Dcm_NegativeResponseCodeType, direction=OUT
        ReadData: possible-error=[DidServices_0xfd25/E_NOT_OK, DidServices_0xfd25/E_PENDING]
          arg data: type=Dcm_2Byte_Type, direction=INOUT
        ConditionCheckWrite: possible-error=DidServices_0xfd25/E_PENDING
          arg ErrorCode: type=Dcm_NegativeResponseCodeType, direction=OUT
        WriteData: possible-error=DidServices_0xfd25/E_PENDING
          arg data: type=Dcm_2Byte_Type, direction=INOUT
          arg dataLength: type=UInt16, direction=IN
          arg ErrorCode: type=Dcm_NegativeResponseCodeType, direction=OUT
      error E_NOT_OK: error-code=1
      error E_PENDING: error-code=10
    DidServices_0xfd26
      4 x operation:
        ConditionCheckRead: possible-error=DidServices_0xfd26/E_PENDING
          arg ErrorCode: type=Dcm_NegativeResponseCodeType, direction=OUT
        ReadData: possible-error=[DidServices_0xfd26/E_NOT_OK, DidServices_0xfd26/E_PENDING]
          arg data: type=Dcm_3Byte_Type, direction=INOUT
        ConditionCheckWrite: possible-error=DidServices_0xfd26/E_PENDING
          arg ErrorCode: type=Dcm_NegativeResponseCodeType, direction=OUT
        WriteData: possible-error=DidServices_0xfd26/E_PENDING
          arg data: type=Dcm_3Byte_Type, direction=INOUT
          arg dataLength: type=UInt16, direction=IN
          arg ErrorCode: type=Dcm_NegativeResponseCodeType, direction=OUT
      error E_NOT_OK: error-code=1
      error E_PENDING: error-code=10
    DidServices_0xfd27
      4 x operation:
        ConditionCheckRead: possible-error=DidServices_0xfd27/E_PENDING
          arg ErrorCode: type=Dcm_NegativeResponseCodeType, direction=OUT
        ReadData: possible-error=[DidServices_0xfd27/E_NOT_OK, DidServices_0xfd27/E_PENDING]
          arg data: type=Dcm_1Byte_Type, direction=INOUT
        ConditionCheckWrite: possible-error=DidServices_0xfd27/E_PENDING
          arg ErrorCode: type=Dcm_NegativeResponseCodeType, direction=OUT
        WriteData: possible-error=DidServices_0xfd27/E_PENDING
          arg data: type=Dcm_1Byte_Type, direction=INOUT
          arg dataLength: type=UInt16, direction=IN
          arg ErrorCode: type=Dcm_NegativeResponseCodeType, direction=OUT
      error E_NOT_OK: error-code=1
      error E_PENDING: error-code=10
    DidServices_0xfd29
      4 x operation:
        ConditionCheckRead: possible-error=DidServices_0xfd29/E_PENDING
          arg ErrorCode: type=Dcm_NegativeResponseCodeType, direction=OUT
        ReadData: possible-error=[DidServices_0xfd29/E_NOT_OK, DidServices_0xfd29/E_PENDING]
          arg data: type=Dcm_2Byte_Type, direction=INOUT
        ConditionCheckWrite: possible-error=DidServices_0xfd29/E_PENDING
          arg ErrorCode: type=Dcm_NegativeResponseCodeType, direction=OUT
        WriteData: possible-error=DidServices_0xfd29/E_PENDING
          arg data: type=Dcm_2Byte_Type, direction=INOUT
          arg dataLength: type=UInt16, direction=IN
          arg ErrorCode: type=Dcm_NegativeResponseCodeType, direction=OUT
      error E_NOT_OK: error-code=1
      error E_PENDING: error-code=10
    DidServices_0xfd30
      4 x operation:
        ConditionCheckRead: possible-error=DidServices_0xfd30/E_PENDING
          arg ErrorCode: type=Dcm_NegativeResponseCodeType, direction=OUT
        ReadData: possible-error=[DidServices_0xfd30/E_NOT_OK, DidServices_0xfd30/E_PENDING]
          arg data: type=Dcm_5Byte_Type, direction=INOUT
        ConditionCheckWrite: possible-error=DidServices_0xfd30/E_PENDING
          arg ErrorCode: type=Dcm_NegativeResponseCodeType, direction=OUT
        WriteData: possible-error=DidServices_0xfd30/E_PENDING
          arg data: type=Dcm_5Byte_Type, direction=INOUT
          arg dataLength: type=UInt16, direction=IN
          arg ErrorCode: type=Dcm_NegativeResponseCodeType, direction=OUT
      error E_NOT_OK: error-code=1
      error E_PENDING: error-code=10
    DidServices_0xfd31
      operation ConditionCheckRead: possible-error=DidServices_0xfd31/E_PENDING
        arg ErrorCode: type=Dcm_NegativeResponseCodeType, direction=OUT
      operation ReadData: possible-error=[DidServices_0xfd31/E_NOT_OK, DidServices_0xfd31/E_PENDING]
        arg data: type=Dcm_12Byte_Type, direction=INOUT
      error E_NOT_OK: error-code=1
      error E_PENDING: error-code=10
    DidServices_0xfda1
      4 x operation:
        ConditionCheckRead: possible-error=DidServices_0xfda1/E_PENDING
          arg ErrorCode: type=Dcm_NegativeResponseCodeType, direction=OUT
        ReadData: possible-error=[DidServices_0xfda1/E_NOT_OK, DidServices_0xfda1/E_PENDING]
          arg data: type=Dcm_4Byte_Type, direction=INOUT
        ConditionCheckWrite: possible-error=DidServices_0xfda1/E_PENDING
          arg ErrorCode: type=Dcm_NegativeResponseCodeType, direction=OUT
        WriteData: possible-error=DidServices_0xfda1/E_PENDING
          arg data: type=Dcm_4Byte_Type, direction=INOUT
          arg dataLength: type=UInt16, direction=IN
          arg ErrorCode: type=Dcm_NegativeResponseCodeType, direction=OUT
      error E_NOT_OK: error-code=1
      error E_PENDING: error-code=10
    DidServices_0xfda2
      4 x operation:
        ConditionCheckRead: possible-error=DidServices_0xfda2/E_PENDING
          arg ErrorCode: type=Dcm_NegativeResponseCodeType, direction=OUT
        ReadData: possible-error=[DidServices_0xfda2/E_NOT_OK, DidServices_0xfda2/E_PENDING]
          arg data: type=Dcm_4Byte_Type, direction=INOUT
        ConditionCheckWrite: possible-error=DidServices_0xfda2/E_PENDING
          arg ErrorCode: type=Dcm_NegativeResponseCodeType, direction=OUT
        WriteData: possible-error=DidServices_0xfda2/E_PENDING
          arg data: type=Dcm_4Byte_Type, direction=INOUT
          arg dataLength: type=UInt16, direction=IN
          arg ErrorCode: type=Dcm_NegativeResponseCodeType, direction=OUT
      error E_NOT_OK: error-code=1
      error E_PENDING: error-code=10
    DidServices_0xfda3
      4 x operation:
        ConditionCheckRead: possible-error=DidServices_0xfda3/E_PENDING
          arg ErrorCode: type=Dcm_NegativeResponseCodeType, direction=OUT
        ReadData: possible-error=[DidServices_0xfda3/E_NOT_OK, DidServices_0xfda3/E_PENDING]
          arg data: type=Dcm_12Byte_Type, direction=INOUT
        ConditionCheckWrite: possible-error=DidServices_0xfda3/E_PENDING
          arg ErrorCode: type=Dcm_NegativeResponseCodeType, direction=OUT
        WriteData: possible-error=DidServices_0xfda3/E_PENDING
          arg data: type=Dcm_12Byte_Type, direction=INOUT
          arg dataLength: type=UInt16, direction=IN
          arg ErrorCode: type=Dcm_NegativeResponseCodeType, direction=OUT
      error E_NOT_OK: error-code=1
      error E_PENDING: error-code=10
    DidServices_0xfdac
      4 x operation:
        ConditionCheckRead: possible-error=DidServices_0xfdac/E_PENDING
          arg ErrorCode: type=Dcm_NegativeResponseCodeType, direction=OUT
        ReadData: possible-error=[DidServices_0xfdac/E_NOT_OK, DidServices_0xfdac/E_PENDING]
          arg data: type=Dcm_64Byte_Type, direction=INOUT
        ConditionCheckWrite: possible-error=DidServices_0xfdac/E_PENDING
          arg ErrorCode: type=Dcm_NegativeResponseCodeType, direction=OUT
        WriteData: possible-error=DidServices_0xfdac/E_PENDING
          arg data: type=Dcm_64Byte_Type, direction=INOUT
          arg dataLength: type=UInt16, direction=IN
          arg ErrorCode: type=Dcm_NegativeResponseCodeType, direction=OUT
      error E_NOT_OK: error-code=1
      error E_PENDING: error-code=10
    DidServices_0xfdad
      operation ConditionCheckRead: possible-error=DidServices_0xfdad/E_PENDING
        arg ErrorCode: type=Dcm_NegativeResponseCodeType, direction=OUT
      operation ReadData: possible-error=[DidServices_0xfdad/E_NOT_OK, DidServices_0xfdad/E_PENDING]
        arg data: type=Dcm_7Byte_Type, direction=INOUT
      error E_NOT_OK: error-code=1
      error E_PENDING: error-code=10
    DidServices_0xfdae
      4 x operation:
        ConditionCheckRead: possible-error=DidServices_0xfdae/E_PENDING
          arg ErrorCode: type=Dcm_NegativeResponseCodeType, direction=OUT
        ReadData: possible-error=[DidServices_0xfdae/E_NOT_OK, DidServices_0xfdae/E_PENDING]
          arg data: type=Dcm_2Byte_Type, direction=INOUT
        ConditionCheckWrite: possible-error=DidServices_0xfdae/E_PENDING
          arg ErrorCode: type=Dcm_NegativeResponseCodeType, direction=OUT
        WriteData: possible-error=DidServices_0xfdae/E_PENDING
          arg data: type=Dcm_2Byte_Type, direction=INOUT
          arg dataLength: type=UInt16, direction=IN
          arg ErrorCode: type=Dcm_NegativeResponseCodeType, direction=OUT
      error E_NOT_OK: error-code=1
      error E_PENDING: error-code=10
    DidServices_0xfdaf
      operation ConditionCheckRead: possible-error=DidServices_0xfdaf/E_PENDING
        arg ErrorCode: type=Dcm_NegativeResponseCodeType, direction=OUT
      operation ReadData: possible-error=[DidServices_0xfdaf/E_NOT_OK, DidServices_0xfdaf/E_PENDING]
        arg data: type=Dcm_176Byte_Type, direction=INOUT
      error E_NOT_OK: error-code=1
      error E_PENDING: error-code=10
    DidServices_0xfdb0
      4 x operation:
        ConditionCheckRead: possible-error=DidServices_0xfdb0/E_PENDING
          arg ErrorCode: type=Dcm_NegativeResponseCodeType, direction=OUT
        ReadData: possible-error=[DidServices_0xfdb0/E_NOT_OK, DidServices_0xfdb0/E_PENDING]
          arg data: type=Dcm_256Byte_Type, direction=INOUT
        ConditionCheckWrite: possible-error=DidServices_0xfdb0/E_PENDING
          arg ErrorCode: type=Dcm_NegativeResponseCodeType, direction=OUT
        WriteData: possible-error=DidServices_0xfdb0/E_PENDING
          arg data: type=Dcm_256Byte_Type, direction=INOUT
          arg dataLength: type=UInt16, direction=IN
          arg ErrorCode: type=Dcm_NegativeResponseCodeType, direction=OUT
      error E_NOT_OK: error-code=1
      error E_PENDING: error-code=10
    DidServices_0xfdb1
      4 x operation:
        ConditionCheckRead: possible-error=DidServices_0xfdb1/E_PENDING
          arg ErrorCode: type=Dcm_NegativeResponseCodeType, direction=OUT
        ReadData: possible-error=[DidServices_0xfdb1/E_NOT_OK, DidServices_0xfdb1/E_PENDING]
          arg data: type=Dcm_256Byte_Type, direction=INOUT
        ConditionCheckWrite: possible-error=DidServices_0xfdb1/E_PENDING
          arg ErrorCode: type=Dcm_NegativeResponseCodeType, direction=OUT
        WriteData: possible-error=DidServices_0xfdb1/E_PENDING
          arg data: type=Dcm_256Byte_Type, direction=INOUT
          arg dataLength: type=UInt16, direction=IN
          arg ErrorCode: type=Dcm_NegativeResponseCodeType, direction=OUT
      error E_NOT_OK: error-code=1
      error E_PENDING: error-code=10
    DidServices_0xfdb2
      4 x operation:
        ConditionCheckRead: possible-error=DidServices_0xfdb2/E_PENDING
          arg ErrorCode: type=Dcm_NegativeResponseCodeType, direction=OUT
        ReadData: possible-error=[DidServices_0xfdb2/E_NOT_OK, DidServices_0xfdb2/E_PENDING]
          arg data: type=Dcm_256Byte_Type, direction=INOUT
        ConditionCheckWrite: possible-error=DidServices_0xfdb2/E_PENDING
          arg ErrorCode: type=Dcm_NegativeResponseCodeType, direction=OUT
        WriteData: possible-error=DidServices_0xfdb2/E_PENDING
          arg data: type=Dcm_256Byte_Type, direction=INOUT
          arg dataLength: type=UInt16, direction=IN
          arg ErrorCode: type=Dcm_NegativeResponseCodeType, direction=OUT
      error E_NOT_OK: error-code=1
      error E_PENDING: error-code=10
    DidServices_0xfdb3
      4 x operation:
        ConditionCheckRead: possible-error=DidServices_0xfdb3/E_PENDING
          arg ErrorCode: type=Dcm_NegativeResponseCodeType, direction=OUT
        ReadData: possible-error=[DidServices_0xfdb3/E_NOT_OK, DidServices_0xfdb3/E_PENDING]
          arg data: type=Dcm_256Byte_Type, direction=INOUT
        ConditionCheckWrite: possible-error=DidServices_0xfdb3/E_PENDING
          arg ErrorCode: type=Dcm_NegativeResponseCodeType, direction=OUT
        WriteData: possible-error=DidServices_0xfdb3/E_PENDING
          arg data: type=Dcm_256Byte_Type, direction=INOUT
          arg dataLength: type=UInt16, direction=IN
          arg ErrorCode: type=Dcm_NegativeResponseCodeType, direction=OUT
      error E_NOT_OK: error-code=1
      error E_PENDING: error-code=10
    DidServices_0xfdb4
      4 x operation:
        ConditionCheckRead: possible-error=DidServices_0xfdb4/E_PENDING
          arg ErrorCode: type=Dcm_NegativeResponseCodeType, direction=OUT
        ReadData: possible-error=[DidServices_0xfdb4/E_NOT_OK, DidServices_0xfdb4/E_PENDING]
          arg data: type=Dcm_8Byte_Type, direction=INOUT
        ConditionCheckWrite: possible-error=DidServices_0xfdb4/E_PENDING
          arg ErrorCode: type=Dcm_NegativeResponseCodeType, direction=OUT
        WriteData: possible-error=DidServices_0xfdb4/E_PENDING
          arg data: type=Dcm_8Byte_Type, direction=INOUT
          arg dataLength: type=UInt16, direction=IN
          arg ErrorCode: type=Dcm_NegativeResponseCodeType, direction=OUT
      error E_NOT_OK: error-code=1
      error E_PENDING: error-code=10
    DidServices_0xfdb5
      4 x operation:
        ConditionCheckRead: possible-error=DidServices_0xfdb5/E_PENDING
          arg ErrorCode: type=Dcm_NegativeResponseCodeType, direction=OUT
        ReadData: possible-error=[DidServices_0xfdb5/E_NOT_OK, DidServices_0xfdb5/E_PENDING]
          arg data: type=Dcm_4Byte_Type, direction=INOUT
        ConditionCheckWrite: possible-error=DidServices_0xfdb5/E_PENDING
          arg ErrorCode: type=Dcm_NegativeResponseCodeType, direction=OUT
        WriteData: possible-error=DidServices_0xfdb5/E_PENDING
          arg data: type=Dcm_4Byte_Type, direction=INOUT
          arg dataLength: type=UInt16, direction=IN
          arg ErrorCode: type=Dcm_NegativeResponseCodeType, direction=OUT
      error E_NOT_OK: error-code=1
      error E_PENDING: error-code=10
    DidServices_0xfdb6
      4 x operation:
        ConditionCheckRead: possible-error=DidServices_0xfdb6/E_PENDING
          arg ErrorCode: type=Dcm_NegativeResponseCodeType, direction=OUT
        ReadData: possible-error=[DidServices_0xfdb6/E_NOT_OK, DidServices_0xfdb6/E_PENDING]
          arg data: type=Dcm_4Byte_Type, direction=INOUT
        ConditionCheckWrite: possible-error=DidServices_0xfdb6/E_PENDING
          arg ErrorCode: type=Dcm_NegativeResponseCodeType, direction=OUT
        WriteData: possible-error=DidServices_0xfdb6/E_PENDING
          arg data: type=Dcm_4Byte_Type, direction=INOUT
          arg dataLength: type=UInt16, direction=IN
          arg ErrorCode: type=Dcm_NegativeResponseCodeType, direction=OUT
      error E_NOT_OK: error-code=1
      error E_PENDING: error-code=10
    DidServices_0xfdb7
      4 x operation:
        ConditionCheckRead: possible-error=DidServices_0xfdb7/E_PENDING
          arg ErrorCode: type=Dcm_NegativeResponseCodeType, direction=OUT
        ReadData: possible-error=[DidServices_0xfdb7/E_NOT_OK, DidServices_0xfdb7/E_PENDING]
          arg data: type=Dcm_18Byte_Type, direction=INOUT
        ConditionCheckWrite: possible-error=DidServices_0xfdb7/E_PENDING
          arg ErrorCode: type=Dcm_NegativeResponseCodeType, direction=OUT
        WriteData: possible-error=DidServices_0xfdb7/E_PENDING
          arg data: type=Dcm_18Byte_Type, direction=INOUT
          arg dataLength: type=UInt16, direction=IN
          arg ErrorCode: type=Dcm_NegativeResponseCodeType, direction=OUT
      error E_NOT_OK: error-code=1
      error E_PENDING: error-code=10
    DidServices_0xfe00
      4 x operation:
        ConditionCheckRead: possible-error=DidServices_0xfe00/E_PENDING
          arg ErrorCode: type=Dcm_NegativeResponseCodeType, direction=OUT
        ReadData: possible-error=[DidServices_0xfe00/E_NOT_OK, DidServices_0xfe00/E_PENDING]
          arg data: type=Dcm_3Byte_Type, direction=INOUT
        ReturnControlToECU: possible-error=DidServices_0xfe00/E_PENDING
          4 x arg:
            RequestData: type=Dcm_0Byte_Type, direction=INOUT
            RequestDataLength: type=UInt16, direction=IN
            ResponseData: type=Dcm_3Byte_Type, direction=INOUT
            ErrorCode: type=Dcm_NegativeResponseCodeType, direction=OUT
        ShortTermAdjustment: possible-error=DidServices_0xfe00/E_PENDING
          4 x arg:
            RequestData: type=Dcm_3Byte_Type, direction=INOUT
            RequestDataLength: type=UInt16, direction=IN
            ResponseData: type=Dcm_3Byte_Type, direction=INOUT
            ErrorCode: type=Dcm_NegativeResponseCodeType, direction=OUT
      error E_NOT_OK: error-code=1
      error E_PENDING: error-code=10
    RoutineServices_0xf000
      operation Start: possible-error=RoutineServices_0xf000/E_PENDING
        5 x arg:
          RequestData: type=Dcm_3Byte_Type, direction=INOUT
          RequestDataLength: type=UInt16, direction=IN
          ResponseData: type=Dcm_0Byte_Type, direction=INOUT
          ResponseDataLength: type=UInt16, direction=OUT
          ErrorCode: type=Dcm_NegativeResponseCodeType, direction=OUT
      error E_PENDING: error-code=10
    RoutineServices_0xf001
      operation Start: possible-error=RoutineServices_0xf001/E_PENDING
        5 x arg:
          RequestData: type=Dcm_2Byte_Type, direction=INOUT
          RequestDataLength: type=UInt16, direction=IN
          ResponseData: type=Dcm_0Byte_Type, direction=INOUT
          ResponseDataLength: type=UInt16, direction=OUT
          ErrorCode: type=Dcm_NegativeResponseCodeType, direction=OUT
      error E_PENDING: error-code=10
    RoutineServices_0xf003
      operation Start: possible-error=RoutineServices_0xf003/E_PENDING
        5 x arg:
          RequestData: type=Dcm_1Byte_Type, direction=INOUT
          RequestDataLength: type=UInt16, direction=IN
          ResponseData: type=Dcm_0Byte_Type, direction=INOUT
          ResponseDataLength: type=UInt16, direction=OUT
          ErrorCode: type=Dcm_NegativeResponseCodeType, direction=OUT
      error E_PENDING: error-code=10
    RoutineServices_0xf004
      operation Start: possible-error=RoutineServices_0xf004/E_PENDING
        5 x arg:
          RequestData: type=Dcm_1Byte_Type, direction=INOUT
          RequestDataLength: type=UInt16, direction=IN
          ResponseData: type=Dcm_0Byte_Type, direction=INOUT
          ResponseDataLength: type=UInt16, direction=OUT
          ErrorCode: type=Dcm_NegativeResponseCodeType, direction=OUT
      error E_PENDING: error-code=10
    RoutineServices_0xf005
      operation Start: possible-error=RoutineServices_0xf005/E_PENDING
        5 x arg:
          RequestData: type=Dcm_2Byte_Type, direction=INOUT
          RequestDataLength: type=UInt16, direction=IN
          ResponseData: type=Dcm_3Byte_Type, direction=INOUT
          ResponseDataLength: type=UInt16, direction=OUT
          ErrorCode: type=Dcm_NegativeResponseCodeType, direction=OUT
      error E_PENDING: error-code=10
    RoutineServices_0xf008
      operation Start: possible-error=RoutineServices_0xf008/E_PENDING
        5 x arg:
          RequestData: type=Dcm_1Byte_Type, direction=INOUT
          RequestDataLength: type=UInt16, direction=IN
          ResponseData: type=Dcm_0Byte_Type, direction=INOUT
          ResponseDataLength: type=UInt16, direction=OUT
          ErrorCode: type=Dcm_NegativeResponseCodeType, direction=OUT
      error E_PENDING: error-code=10
    RoutineServices_0xf009
      operation Start: possible-error=RoutineServices_0xf009/E_PENDING
        5 x arg:
          RequestData: type=Dcm_0Byte_Type, direction=INOUT
          RequestDataLength: type=UInt16, direction=IN
          ResponseData: type=Dcm_0Byte_Type, direction=INOUT
          ResponseDataLength: type=UInt16, direction=OUT
          ErrorCode: type=Dcm_NegativeResponseCodeType, direction=OUT
      operation Stop: possible-error=RoutineServices_0xf009/E_PENDING
        5 x arg:
          RequestData: type=Dcm_0Byte_Type, direction=INOUT
          RequestDataLength: type=UInt16, direction=IN
          ResponseData: type=Dcm_0Byte_Type, direction=INOUT
          ResponseDataLength: type=UInt16, direction=OUT
          ErrorCode: type=Dcm_NegativeResponseCodeType, direction=OUT
      operation RequestResults: possible-error=RoutineServices_0xf009/E_PENDING
        5 x arg:
          RequestData: type=Dcm_0Byte_Type, direction=INOUT
          RequestDataLength: type=UInt16, direction=IN
          ResponseData: type=Dcm_1Byte_Type, direction=INOUT
          ResponseDataLength: type=UInt16, direction=OUT
          ErrorCode: type=Dcm_NegativeResponseCodeType, direction=OUT
      error E_PENDING: error-code=10
    RoutineServices_0xf0ff
      operation Start: possible-error=RoutineServices_0xf0ff/E_PENDING
        5 x arg:
          RequestData: type=Dcm_6Byte_Type, direction=INOUT
          RequestDataLength: type=UInt16, direction=IN
          ResponseData: type=Dcm_0Byte_Type, direction=INOUT
          ResponseDataLength: type=UInt16, direction=OUT
          ErrorCode: type=Dcm_NegativeResponseCodeType, direction=OUT
      error E_PENDING: error-code=10
    RoutineServices_0xfee0
      operation Start: possible-error=RoutineServices_0xfee0/E_PENDING
        5 x arg:
          RequestData: type=Dcm_1Byte_Type, direction=INOUT
          RequestDataLength: type=UInt16, direction=IN
          ResponseData: type=Dcm_0Byte_Type, direction=INOUT
          ResponseDataLength: type=UInt16, direction=OUT
          ErrorCode: type=Dcm_NegativeResponseCodeType, direction=OUT
      error E_PENDING: error-code=10
    SecurityAccess_1
      operation GetSeed: possible-error=[SecurityAccess_1/E_NOT_OK, SecurityAccess_1/E_PENDING]
        arg securityAccessDataRecord: type=Dcm_SecAccess_1_DataRecType, direction=INOUT
        arg Seed: type=Dcm_SecAccess_1_SeedType, direction=INOUT
        arg ErrorCode: type=Dcm_NegativeResponseCodeType, direction=OUT
      operation CompareKey: possible-error=[SecurityAccess_1/E_NOT_OK, SecurityAccess_1/E_PENDING, E_COMPARE_KEY_FAILED]
        arg Key: type=Dcm_SecAccess_1_KeyType, direction=INOUT
      error E_NOT_OK: error-code=1
      error E_PENDING: error-code=10
      error E_COMPARE_KEY_FAILED: error-code=11
    SessionControl
      operation GetSesChgPermission: possible-error=[SessionControl/E_NOT_OK, SessionControl/E_PENDING, E_SESSION_NOT_ALLOWED, E_FORCE_RCRRP]
        arg SesCtrlTypeActive: type=Dcm_SesCtrlType, direction=IN
        arg SesCtrlTypeNew: type=Dcm_SesCtrlType, direction=IN
      operation ChangeIndication: possible-error=SessionControl/E_NOT_OK
        arg SesCtrlTypeOld: type=Dcm_SesCtrlType, direction=IN
        arg SesCtrlTypeNew: type=Dcm_SesCtrlType, direction=IN
      operation ConfirmationRespPending: possible-error=SessionControl/E_NOT_OK
        arg status: type=Dcm_ConfirmationStatusType, direction=IN
      4 x error:
        E_NOT_OK: error-code=1
        E_SESSION_NOT_ALLOWED: error-code=4
        E_PENDING: error-code=10
        E_FORCE_RCRRP: error-code=12
package /DataType
  integer type Dcm_NegativeResponseCodeType:
    compu {16=DCM_E_GENERALREJECT, 17=DCM_E_SERVICENOTSUPPORTED, 18=DCM_E_SUBFUNCTIONNOTSUPPORTED, 19=DCM_E_INCORRECTMESSAGELENGTHORINVALIDFORMAT, 20=DCM_E_RESPONSE_TOO_LONG, 33=DCM_E_BUSYREPEATREQUEST, 34=DCM_E_CONDITIONSNOTCORRECT, 36=DCM_E_REQUESTSEQUENCEERROR, 49=DCM_E_REQUESTOUTOFRANGE, 51=DCM_E_SECURITYACCESSDENIED, 53=DCM_E_INVALIDKEY, 54=DCM_E_EXCEEDNUMBEROFATTEMPTS, 55=DCM_E_REQUIREDTIMEDELAYNOTEXPIRED, 112=DCM_E_UPLOADDOWNLOADNOTACCEPTED, 113=DCM_E_TRANSFERDATASUSPENDED, 114=DCM_E_GENERALPROGRAMMINGFAILURE, 115=DCM_E_WRONGBLOCKSEQUENCECOUNTER, 120=DCM_E_REQUESTCORRECTLYRECEIVED_RESPONSEPENDING, 126=DCM_E_SUBFUNCTIONNOTSUPPORTEDINACTIVESESSION, 127=DCM_E_SERVICENOTSUPPORTEDINACTIVESESSION, 129=DCM_E_RPMTOOHIGH, 130=DCM_E_RPMTOOLOW, 131=DCM_E_ENGINEISRUNNING, 132=DCM_E_ENGINEISNOTRUNNING, 133=DCM_E_ENGINERUNTIMETOOLOW, 134=DCM_E_TEMPERATURETOOHIGH, 135=DCM_E_TEMPERATURETOOLOW, 136=DCM_E_VEHICLESPEEDTOOHIGH, 137=DCM_E_VEHICLESPEEDTOOLOW, 138=DCM_E_THROTTLE_PEDALTOOHIGH, 139=DCM_E_THROTTLE_PEDALTOOLOW, 140=DCM_E_TRANSMISSIONRANGENOTINNEUTRAL, 141=DCM_E_TRANSMISSIONRANGENOTINGEAR, 143=DCM_E_BRAKESWITCH_NOTCLOSED, 144=DCM_E_SHIFTERLEVERNOTINPARK, 145=DCM_E_TORQUECONVERTERCLUTCHLOCKED, 146=DCM_E_VOLTAGETOOHIGH, 147=DCM_E_VOLTAGETOOLOW}
    lower-limit=0
    upper-limit=255
  integer type Dcm_ProtocolType: compu {0=DCM_OBD_ON_CAN, 1=DCM_UDS_ON_CAN, 2=DCM_UDS_ON_FLEXRAY, 3=DCM_ROE_ON_CAN, 4=DCM_ROE_ON_FLEXRAY, 5=DCM_PERIODICTRANS_ON_CAN, 6=DCM_PERIODICTRANS_ON_FLEXRAY}, lower-limit=0, upper-limit=255
  integer type Dcm_ConfirmationStatusType: compu {0=DCM_RES_POS_OK, 1=DCM_RES_POS_NOT_OK, 2=DCM_RES_NEG_OK, 3=DCM_RES_NEG_NOT_OK}, lower-limit=0, upper-limit=3
  integer type Dcm_SesCtrlType: compu {1=DCM_DEFAULT_SESSION, 2=DCM_PROGRAMMING_SESSION, 3=DCM_EXTENDED_DIAGNOSTIC_SESSION, 4=DCM_SAFETY_SYSTEM_DIAGNOSTIC_SESSION, 126=NEXTEER, 255=DCM_ALL_SESSION_LEVEL}, lower-limit=1, upper-limit=255
  integer type Dcm_SecLevelType: compu {0=DCM_SEC_LEV_LOCKED, 1=DCM_SEC_LEV_L1, 255=DCM_SEC_LEV_ALL}, lower-limit=0, upper-limit=255
  23 x array type:
    Dcm_1Byte_Type
      element Dcm_1Byte_Type: type=UInt8, max-number-of-elements=1
    Dcm_25Byte_Type
      element Dcm_25Byte_Type: type=UInt8, max-number-of-elements=25
    Dcm_10Byte_Type
      element Dcm_10Byte_Type: type=UInt8, max-number-of-elements=10
    Dcm_16Byte_Type
      element Dcm_16Byte_Type: type=UInt8, max-number-of-elements=16
    Dcm_322Byte_Type
      element Dcm_322Byte_Type: type=UInt8, max-number-of-elements=322
    Dcm_4Byte_Type
      element Dcm_4Byte_Type: type=UInt8, max-number-of-elements=4
    Dcm_2Byte_Type
      element Dcm_2Byte_Type: type=UInt8, max-number-of-elements=2
    Dcm_0Byte_Type
      element Dcm_0Byte_Type: type=UInt8, max-number-of-elements=1
    Dcm_8Byte_Type
      element Dcm_8Byte_Type: type=UInt8, max-number-of-elements=8
    Dcm_28Byte_Type
      element Dcm_28Byte_Type: type=UInt8, max-number-of-elements=28
    Dcm_75Byte_Type
      element Dcm_75Byte_Type: type=UInt8, max-number-of-elements=75
    Dcm_3Byte_Type
      element Dcm_3Byte_Type: type=UInt8, max-number-of-elements=3
    Dcm_5Byte_Type
      element Dcm_5Byte_Type: type=UInt8, max-number-of-elements=5
    Dcm_12Byte_Type
      element Dcm_12Byte_Type: type=UInt8, max-number-of-elements=12
    Dcm_64Byte_Type
      element Dcm_64Byte_Type: type=UInt8, max-number-of-elements=64
    Dcm_7Byte_Type
      element Dcm_7Byte_Type: type=UInt8, max-number-of-elements=7
    Dcm_176Byte_Type
      element Dcm_176Byte_Type: type=UInt8, max-number-of-elements=176
    Dcm_256Byte_Type
      element Dcm_256Byte_Type: type=UInt8, max-number-of-elements=256
    Dcm_18Byte_Type
      element Dcm_18Byte_Type: type=UInt8, max-number-of-elements=18
    Dcm_6Byte_Type
      element Dcm_6Byte_Type: type=UInt8, max-number-of-elements=6
    Dcm_SecAccess_1_DataRecType
      element Dcm_SecAccess_1_DataRecType: type=UInt8, max-number-of-elements=1
    Dcm_SecAccess_1_SeedType
      element Dcm_SecAccess_1_SeedType: type=UInt8, max-number-of-elements=3
    Dcm_SecAccess_1_KeyType
      element Dcm_SecAccess_1_KeyType: type=UInt8, max-number-of-elements=3
