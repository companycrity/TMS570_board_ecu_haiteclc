AUTOSAR XML (schema 314)
package /ModeDclrGroup
  mode declaration group ComMMode: initial-mode=NO_COMMUNICATION
    mode FULL_COMMUNICATION
    mode NO_COMMUNICATION
    mode SILENT_COMMUNICATION
  mode declaration group StaMd_Mode: initial-mode=WARMINIT  # EPS System State mode declaration
    4 x mode:
      DISABLE
      OFF
      OPERATE
      WARMINIT
package /PortInterface
  122 x client server interface:
    AbsHwPos_SCom
      4 x operation:
        CustClrTrim
        CustSetTrim: possible-error=TrimNotPerformed
        NxtClearTrim
        NxtSetTrim: possible-error=[TrimNotPerformed, ValueNotAccepted]
          arg Offset_HwDeg_T_f32: type=Float, direction=IN
      error TrimNotPerformed: error-code=34
      error ValueNotAccepted: error-code=49
    ActivePull_SCom  # Serial communication port for setting and getting a sdoftware component parameter. The parameter is typically an EOL parameter.
      4 x operation:
        ReadParam
          4 x arg, all with direction=OUT:
            PullCompCmd_HwNm_f32: type=Float
            STComp_HwNm_f32: type=Float
            LTComp_HwNm_f32: type=Float
            EnableLearn_Cnt_lgc: type=Boolean
        Reset
        SetLTComp
          arg LTComp_HwNm_f32: type=Float, direction=IN
        SetSTComp
          arg STComp_HwNm_f32: type=Float, direction=IN
    AssistLmtFunc_Scom
      operation GetSteeringAssistDefeat
        arg SteeringAsstDefeat_Cnt_lgc: type=Boolean, direction=OUT
      operation ManualTrqCmd: possible-error=[RTE_E_MtrTrqLmt_SCom_VSTH, RTE_E_OK]
        arg EnableManualCtrl: type=Boolean, direction=IN
        arg MtrTrqCmd_MtrNm_f32: type=Float, direction=IN
      operation SetSteeringAssistDefeat
        arg SteeringAsstDefeat_Cnt_lgc: type=Boolean, direction=IN
      error RTE_E_MtrTrqLmt_SCom_VSTH: error-code=34
      error RTE_E_OK: error-code=1
    AvgFricLrn_SCom
      9 x operation:
        CaptureOnTheFly
        GetEOLFric
          arg EOLFric_HwNm_f32: type=Float, direction=OUT
        GetOffsetOutputDefeat
          arg DefeatOffsetOutput_Cnt_lgc: type=Boolean, direction=OUT
        GetSelect
          arg EnableFricLearning_Cnt_lgc: type=Boolean, direction=OUT
          arg EnableOffsetOutput_Cnt_lgc: type=Boolean, direction=OUT
          arg OpMode_Uls_u08: type=UInt8, direction=OUT
        InitLearnedTables
        ResetToZero
        SetEOLFric
          arg EOLFric_HwNm_f32: type=Float, direction=IN
        SetOffsetOutputDefeat
          arg DefeatOffsetOutput_Cnt_lgc: type=Boolean, direction=IN
        SetSelect
          arg EnableFricLearning_Cnt_lgc: type=Boolean, direction=IN
          arg EnableOffsetOutput_Cnt_lgc: type=Boolean, direction=IN
          arg OpMode_Uls_u08: type=UInt8, direction=IN
    BatteryVoltage_SCom
      operation ClearTransOvData
      operation ReadTransOvData
        arg OvervoltageCounter_Cnt_u16: type=UInt16, direction=OUT
        arg MaxBattVoltage_Volts_f32: type=Float, direction=OUT
    CDDPorts: is-service=true
      operation ApplyMtrElecMechPol
        arg MtrElecMechPol_Cnt_s8: type=SInt8, direction=IN
      operation ClearPhsReasSum
        arg DataAccessBfr_Cnt_T_u16: type=UInt16, direction=IN
    CmMtrCurr_SCom
      5 x operation:
        CalGain: possible-error=[ConditionNotCorrect, CurrentOutOfRange, VehSpdOutofRange]
        CalOffset: possible-error=[ConditionNotCorrect, CurrentOutOfRange, VehSpdOutofRange]
        MtrCurrOffReadStatus
          arg CurrOffStatus: type=MtrCurrOffProcessFlag, direction=OUT
        ReadMtrCurrCals
          arg ShCurrCalPtr: type=PhaseCurrCal_DataType, direction=OUT
        SetMtrCurrCals
          arg ShCurrCalPtr: type=PhaseCurrCal_DataType, direction=IN
      error ConditionNotCorrect: error-code=34
      error CurrentOutOfRange: error-code=20
      error VehSpdOutofRange: error-code=21
    ComM_ChannelLimitation: is-service=true
      operation GetInhibitionStatus: possible-error=ComM_ChannelLimitation/E_NOT_OK
        arg Status: type=ComM_InhibitionStatusType, direction=OUT
      operation LimitChannelToNoComMode: possible-error=ComM_ChannelLimitation/E_NOT_OK
        arg Status: type=Boolean, direction=IN
      error E_NOT_OK: error-code=1
    ComM_ChannelWakeUp: is-service=true
      operation PreventWakeUp: possible-error=ComM_ChannelWakeUp/E_NOT_OK
        arg Status: type=Boolean, direction=IN
      error E_NOT_OK: error-code=1
    ComM_ECUModeLimitation: is-service=true
      4 x operation, all with possible-error=ComM_ECUModeLimitation/E_NOT_OK:
        LimitECUToNoComMode
          arg Status: type=Boolean, direction=IN
        ReadInhibitCounter
          arg CounterValue: type=UInt16, direction=OUT
        ResetInhibitCounter
        SetECUGroupClassification
          arg Status: type=ComM_InhibitionStatusType, direction=IN
      error E_NOT_OK: error-code=1
    ComM_UserRequest: is-service=true
      4 x operation:
        GetCurrentComMode: possible-error=ComM_UserRequest/E_NOT_OK
          arg ComMode: type=ComM_ModeType, direction=OUT
        GetMaxComMode: possible-error=ComM_UserRequest/E_NOT_OK
          arg ComMode: type=ComM_ModeType, direction=OUT
        GetRequestedComMode: possible-error=ComM_UserRequest/E_NOT_OK
          arg ComMode: type=ComM_ModeType, direction=OUT
        RequestComMode: possible-error=[COMM_E_MODE_LIMITATION, ComM_UserRequest/E_NOT_OK]
          arg ComMode: type=ComM_ModeType, direction=IN
      error COMM_E_MODE_LIMITATION: error-code=2
      error E_NOT_OK: error-code=1
    DCMServices: is-service=true
      operation GetSecurityLevel: possible-error=DCMServices/E_NOT_OK
        arg SecLevel: type=Dcm_SecLevelType, direction=OUT
      operation GetSesCtrlType: possible-error=DCMServices/E_NOT_OK
        arg SessionCtrlType: type=Dcm_SesCtrlType, direction=OUT
      error E_NOT_OK: error-code=1
      error E_PENDING: error-code=10
    DemIf
      4 x operation:
        DemShutdown
        RestartDem
        SetEventStatus: possible-error=DemIf/E_NOT_OK
          arg EventId: type=UInt8, direction=IN
          arg EventStatus: type=NxtrDiagMgrStatus, direction=IN
        SetOperationCycleState
          arg NxtrOperationCycleId: type=NxtrOpCycle, direction=IN
          arg NxtrCycleState: type=NxtrOpCycleState, direction=IN
      error E_NOT_OK: error-code=1
    DiagMgr_StaCtrl
      operation Shutdown
    DiagnosticMonitor: is-service=true
      7 x operation:
        GetDTCOfEvent: possible-error=[DEM_GET_DTCOFEVENT_WRONG_DTCKIND, DEM_GET_DTCOFEVENT_WRONG_EVENTID, DiagnosticMonitor/E_NOT_OK]
          arg DTCKind: type=Dem_DTCKindType, direction=IN
          arg DTC: type=Dem_DTCType, direction=OUT
        GetEventFailed: possible-error=DiagnosticMonitor/E_NOT_OK
          arg Failed: type=Boolean, direction=OUT
        GetEventStatus: possible-error=DiagnosticMonitor/E_NOT_OK
          arg EventStatus: type=Dem_EventStatusExtendedType, direction=OUT
        GetEventTested: possible-error=DiagnosticMonitor/E_NOT_OK
          arg Failed: type=Boolean, direction=OUT
        GetFaultDetectionCounter: possible-error=DiagnosticMonitor/E_NOT_OK
          arg EventIdFaultDetectionCounter: type=Dem_FaultDetectionCounterType, direction=OUT
        ResetEventStatus: possible-error=[DiagnosticMonitor/DEM_E_QUEUE_OVERFLOW, DiagnosticMonitor/E_NOT_OK]
        SetEventStatus: possible-error=[DiagnosticMonitor/DEM_E_QUEUE_OVERFLOW, DiagnosticMonitor/E_NOT_OK]
          arg EventStatus: type=Dem_EventStatusType, direction=IN
      4 x error:
        DEM_E_QUEUE_OVERFLOW: error-code=15
        DEM_GET_DTCOFEVENT_WRONG_DTCKIND: error-code=4
        DEM_GET_DTCOFEVENT_WRONG_EVENTID: error-code=5
        E_NOT_OK: error-code=1
    DiagSvc_SCom
      operation GetTuningSet
        arg TuningSet_Cnt_T_u08: type=UInt8, direction=OUT
      operation SetTuningSet: possible-error=E_OUTOFRANGE
        arg TuningSet_Cnt_T_u08: type=UInt8, direction=IN
      error E_OUTOFRANGE: error-code=49
    DidServices_0x0100: is-service=true
      4 x operation:
        ConditionCheckRead: possible-error=DidServices_0x0100/E_PENDING
          arg ErrorCode: type=Dcm_NegativeResponseCodeType, direction=OUT
        ConditionCheckWrite: possible-error=DidServices_0x0100/E_PENDING
          arg ErrorCode: type=Dcm_NegativeResponseCodeType, direction=OUT
        ReadData: possible-error=[DidServices_0x0100/E_NOT_OK, DidServices_0x0100/E_PENDING]
          arg data: type=Dcm_1Byte_Type, direction=INOUT
        WriteData: possible-error=DidServices_0x0100/E_PENDING
          arg data: type=Dcm_1Byte_Type, direction=INOUT
          arg dataLength: type=UInt16, direction=IN
          arg ErrorCode: type=Dcm_NegativeResponseCodeType, direction=OUT
      error E_NOT_OK: error-code=1
      error E_PENDING: error-code=10
    DidServices_0xf180: is-service=true
      operation ConditionCheckRead: possible-error=DidServices_0xf180/E_PENDING
        arg ErrorCode: type=Dcm_NegativeResponseCodeType, direction=OUT
      operation ReadData: possible-error=[DidServices_0xf180/E_NOT_OK, DidServices_0xf180/E_PENDING]
        arg data: type=Dcm_25Byte_Type, direction=INOUT
      error E_NOT_OK: error-code=1
      error E_PENDING: error-code=10
    DidServices_0xf187: is-service=true
      4 x operation:
        ConditionCheckRead: possible-error=DidServices_0xf187/E_PENDING
          arg ErrorCode: type=Dcm_NegativeResponseCodeType, direction=OUT
        ConditionCheckWrite: possible-error=DidServices_0xf187/E_PENDING
          arg ErrorCode: type=Dcm_NegativeResponseCodeType, direction=OUT
        ReadData: possible-error=[DidServices_0xf187/E_NOT_OK, DidServices_0xf187/E_PENDING]
          arg data: type=Dcm_10Byte_Type, direction=INOUT
        WriteData: possible-error=DidServices_0xf187/E_PENDING
          arg data: type=Dcm_10Byte_Type, direction=INOUT
          arg dataLength: type=UInt16, direction=IN
          arg ErrorCode: type=Dcm_NegativeResponseCodeType, direction=OUT
      error E_NOT_OK: error-code=1
      error E_PENDING: error-code=10
    DidServices_0xf18a: is-service=true
      4 x operation:
        ConditionCheckRead: possible-error=DidServices_0xf18a/E_PENDING
          arg ErrorCode: type=Dcm_NegativeResponseCodeType, direction=OUT
        ConditionCheckWrite: possible-error=DidServices_0xf18a/E_PENDING
          arg ErrorCode: type=Dcm_NegativeResponseCodeType, direction=OUT
        ReadData: possible-error=[DidServices_0xf18a/E_NOT_OK, DidServices_0xf18a/E_PENDING]
          arg data: type=Dcm_10Byte_Type, direction=INOUT
        WriteData: possible-error=DidServices_0xf18a/E_PENDING
          arg data: type=Dcm_10Byte_Type, direction=INOUT
          arg dataLength: type=UInt16, direction=IN
          arg ErrorCode: type=Dcm_NegativeResponseCodeType, direction=OUT
      error E_NOT_OK: error-code=1
      error E_PENDING: error-code=10
    DidServices_0xf18c: is-service=true
      operation ConditionCheckRead: possible-error=DidServices_0xf18c/E_PENDING
        arg ErrorCode: type=Dcm_NegativeResponseCodeType, direction=OUT
      operation ReadData: possible-error=[DidServices_0xf18c/E_NOT_OK, DidServices_0xf18c/E_PENDING]
        arg data: type=Dcm_16Byte_Type, direction=INOUT
      error E_NOT_OK: error-code=1
      error E_PENDING: error-code=10
    DidServices_0xf191: is-service=true
      operation ConditionCheckRead: possible-error=DidServices_0xf191/E_PENDING
        arg ErrorCode: type=Dcm_NegativeResponseCodeType, direction=OUT
      operation ReadData: possible-error=[DidServices_0xf191/E_NOT_OK, DidServices_0xf191/E_PENDING]
        arg data: type=Dcm_16Byte_Type, direction=INOUT
      error E_NOT_OK: error-code=1
      error E_PENDING: error-code=10
    DidServices_0xf193: is-service=true
      operation ConditionCheckRead: possible-error=DidServices_0xf193/E_PENDING
        arg ErrorCode: type=Dcm_NegativeResponseCodeType, direction=OUT
      operation ReadData: possible-error=[DidServices_0xf193/E_NOT_OK, DidServices_0xf193/E_PENDING]
        arg data: type=Dcm_10Byte_Type, direction=INOUT
      error E_NOT_OK: error-code=1
      error E_PENDING: error-code=10
    DidServices_0xf194: is-service=true
      operation ConditionCheckRead: possible-error=DidServices_0xf194/E_PENDING
        arg ErrorCode: type=Dcm_NegativeResponseCodeType, direction=OUT
      operation ReadData: possible-error=[DidServices_0xf194/E_NOT_OK, DidServices_0xf194/E_PENDING]
        arg data: type=Dcm_10Byte_Type, direction=INOUT
      error E_NOT_OK: error-code=1
      error E_PENDING: error-code=10
    DidServices_0xf195: is-service=true
      operation ConditionCheckRead: possible-error=DidServices_0xf195/E_PENDING
        arg ErrorCode: type=Dcm_NegativeResponseCodeType, direction=OUT
      operation ReadData: possible-error=[DidServices_0xf195/E_NOT_OK, DidServices_0xf195/E_PENDING]
        arg data: type=Dcm_10Byte_Type, direction=INOUT
      error E_NOT_OK: error-code=1
      error E_PENDING: error-code=10
    DidServices_0xfd01: is-service=true
      operation ConditionCheckRead: possible-error=DidServices_0xfd01/E_PENDING
        arg ErrorCode: type=Dcm_NegativeResponseCodeType, direction=OUT
      operation ReadData: possible-error=[DidServices_0xfd01/E_NOT_OK, DidServices_0xfd01/E_PENDING]
        arg data: type=Dcm_322Byte_Type, direction=INOUT
      error E_NOT_OK: error-code=1
      error E_PENDING: error-code=10
    DidServices_0xfd02: is-service=true
      4 x operation:
        ConditionCheckRead: possible-error=DidServices_0xfd02/E_PENDING
          arg ErrorCode: type=Dcm_NegativeResponseCodeType, direction=OUT
        ConditionCheckWrite: possible-error=DidServices_0xfd02/E_PENDING
          arg ErrorCode: type=Dcm_NegativeResponseCodeType, direction=OUT
        ReadData: possible-error=[DidServices_0xfd02/E_NOT_OK, DidServices_0xfd02/E_PENDING]
          arg data: type=Dcm_4Byte_Type, direction=INOUT
        WriteData: possible-error=DidServices_0xfd02/E_PENDING
          arg data: type=Dcm_4Byte_Type, direction=INOUT
          arg dataLength: type=UInt16, direction=IN
          arg ErrorCode: type=Dcm_NegativeResponseCodeType, direction=OUT
      error E_NOT_OK: error-code=1
      error E_PENDING: error-code=10
    DidServices_0xfd07: is-service=true
      4 x operation:
        ConditionCheckRead: possible-error=DidServices_0xfd07/E_PENDING
          arg ErrorCode: type=Dcm_NegativeResponseCodeType, direction=OUT
        ConditionCheckWrite: possible-error=DidServices_0xfd07/E_PENDING
          arg ErrorCode: type=Dcm_NegativeResponseCodeType, direction=OUT
        ReadData: possible-error=[DidServices_0xfd07/E_NOT_OK, DidServices_0xfd07/E_PENDING]
          arg data: type=Dcm_1Byte_Type, direction=INOUT
        WriteData: possible-error=DidServices_0xfd07/E_PENDING
          arg data: type=Dcm_1Byte_Type, direction=INOUT
          arg dataLength: type=UInt16, direction=IN
          arg ErrorCode: type=Dcm_NegativeResponseCodeType, direction=OUT
      error E_NOT_OK: error-code=1
      error E_PENDING: error-code=10
    DidServices_0xfd0d: is-service=true
      4 x operation:
        ConditionCheckRead: possible-error=DidServices_0xfd0d/E_PENDING
          arg ErrorCode: type=Dcm_NegativeResponseCodeType, direction=OUT
        ReadData: possible-error=[DidServices_0xfd0d/E_NOT_OK, DidServices_0xfd0d/E_PENDING]
          arg data: type=Dcm_2Byte_Type, direction=INOUT
        ReturnControlToECU: possible-error=DidServices_0xfd0d/E_PENDING
          4 x arg:
            RequestData: type=Dcm_0Byte_Type, direction=INOUT
            RequestDataLength: type=UInt16, direction=IN
            ResponseData: type=Dcm_2Byte_Type, direction=INOUT
            ErrorCode: type=Dcm_NegativeResponseCodeType, direction=OUT
        ShortTermAdjustment: possible-error=DidServices_0xfd0d/E_PENDING
          4 x arg:
            RequestData: type=Dcm_2Byte_Type, direction=INOUT
            RequestDataLength: type=UInt16, direction=IN
            ResponseData: type=Dcm_2Byte_Type, direction=INOUT
            ErrorCode: type=Dcm_NegativeResponseCodeType, direction=OUT
      error E_NOT_OK: error-code=1
      error E_PENDING: error-code=10
    DidServices_0xfd0e: is-service=true
      operation ConditionCheckRead: possible-error=DidServices_0xfd0e/E_PENDING
        arg ErrorCode: type=Dcm_NegativeResponseCodeType, direction=OUT
      operation ReadData: possible-error=[DidServices_0xfd0e/E_NOT_OK, DidServices_0xfd0e/E_PENDING]
        arg data: type=Dcm_8Byte_Type, direction=INOUT
      error E_NOT_OK: error-code=1
      error E_PENDING: error-code=10
    DidServices_0xfd10: is-service=true
      operation ConditionCheckRead: possible-error=DidServices_0xfd10/E_PENDING
        arg ErrorCode: type=Dcm_NegativeResponseCodeType, direction=OUT
      operation ReadData: possible-error=[DidServices_0xfd10/E_NOT_OK, DidServices_0xfd10/E_PENDING]
        arg data: type=Dcm_10Byte_Type, direction=INOUT
      error E_NOT_OK: error-code=1
      error E_PENDING: error-code=10
    DidServices_0xfd11: is-service=true
      4 x operation:
        ConditionCheckRead: possible-error=DidServices_0xfd11/E_PENDING
          arg ErrorCode: type=Dcm_NegativeResponseCodeType, direction=OUT
        ReadData: possible-error=[DidServices_0xfd11/E_NOT_OK, DidServices_0xfd11/E_PENDING]
          arg data: type=Dcm_2Byte_Type, direction=INOUT
        ReturnControlToECU: possible-error=DidServices_0xfd11/E_PENDING
          4 x arg:
            RequestData: type=Dcm_0Byte_Type, direction=INOUT
            RequestDataLength: type=UInt16, direction=IN
            ResponseData: type=Dcm_2Byte_Type, direction=INOUT
            ErrorCode: type=Dcm_NegativeResponseCodeType, direction=OUT
        ShortTermAdjustment: possible-error=DidServices_0xfd11/E_PENDING
          4 x arg:
            RequestData: type=Dcm_2Byte_Type, direction=INOUT
            RequestDataLength: type=UInt16, direction=IN
            ResponseData: type=Dcm_2Byte_Type, direction=INOUT
            ErrorCode: type=Dcm_NegativeResponseCodeType, direction=OUT
      error E_NOT_OK: error-code=1
      error E_PENDING: error-code=10
    DidServices_0xfd12: is-service=true
      4 x operation:
        ConditionCheckRead: possible-error=DidServices_0xfd12/E_PENDING
          arg ErrorCode: type=Dcm_NegativeResponseCodeType, direction=OUT
        ConditionCheckWrite: possible-error=DidServices_0xfd12/E_PENDING
          arg ErrorCode: type=Dcm_NegativeResponseCodeType, direction=OUT
        ReadData: possible-error=[DidServices_0xfd12/E_NOT_OK, DidServices_0xfd12/E_PENDING]
          arg data: type=Dcm_28Byte_Type, direction=INOUT
        WriteData: possible-error=DidServices_0xfd12/E_PENDING
          arg data: type=Dcm_28Byte_Type, direction=INOUT
          arg dataLength: type=UInt16, direction=IN
          arg ErrorCode: type=Dcm_NegativeResponseCodeType, direction=OUT
      error E_NOT_OK: error-code=1
      error E_PENDING: error-code=10
    DidServices_0xfd13: is-service=true
      operation ConditionCheckRead: possible-error=DidServices_0xfd13/E_PENDING
        arg ErrorCode: type=Dcm_NegativeResponseCodeType, direction=OUT
      operation ReadData: possible-error=[DidServices_0xfd13/E_NOT_OK, DidServices_0xfd13/E_PENDING]
        arg data: type=Dcm_75Byte_Type, direction=INOUT
      error E_NOT_OK: error-code=1
      error E_PENDING: error-code=10
    DidServices_0xfd14: is-service=true
      operation ConditionCheckRead: possible-error=DidServices_0xfd14/E_PENDING
        arg ErrorCode: type=Dcm_NegativeResponseCodeType, direction=OUT
      operation ReadData: possible-error=[DidServices_0xfd14/E_NOT_OK, DidServices_0xfd14/E_PENDING]
        arg data: type=Dcm_2Byte_Type, direction=INOUT
      error E_NOT_OK: error-code=1
      error E_PENDING: error-code=10
    DidServices_0xfd17: is-service=true
      operation ConditionCheckRead: possible-error=DidServices_0xfd17/E_PENDING
        arg ErrorCode: type=Dcm_NegativeResponseCodeType, direction=OUT
      operation ReadData: possible-error=[DidServices_0xfd17/E_NOT_OK, DidServices_0xfd17/E_PENDING]
        arg data: type=Dcm_2Byte_Type, direction=INOUT
      error E_NOT_OK: error-code=1
      error E_PENDING: error-code=10
    DidServices_0xfd19: is-service=true
      4 x operation:
        ConditionCheckRead: possible-error=DidServices_0xfd19/E_PENDING
          arg ErrorCode: type=Dcm_NegativeResponseCodeType, direction=OUT
        ConditionCheckWrite: possible-error=DidServices_0xfd19/E_PENDING
          arg ErrorCode: type=Dcm_NegativeResponseCodeType, direction=OUT
        ReadData: possible-error=[DidServices_0xfd19/E_NOT_OK, DidServices_0xfd19/E_PENDING]
          arg data: type=Dcm_1Byte_Type, direction=INOUT
        WriteData: possible-error=DidServices_0xfd19/E_PENDING
          arg data: type=Dcm_1Byte_Type, direction=INOUT
          arg dataLength: type=UInt16, direction=IN
          arg ErrorCode: type=Dcm_NegativeResponseCodeType, direction=OUT
      error E_NOT_OK: error-code=1
      error E_PENDING: error-code=10
    DidServices_0xfd1a: is-service=true
      operation ConditionCheckRead: possible-error=DidServices_0xfd1a/E_PENDING
        arg ErrorCode: type=Dcm_NegativeResponseCodeType, direction=OUT
      operation ReadData: possible-error=[DidServices_0xfd1a/E_NOT_OK, DidServices_0xfd1a/E_PENDING]
        arg data: type=Dcm_1Byte_Type, direction=INOUT
      error E_NOT_OK: error-code=1
      error E_PENDING: error-code=10
    DidServices_0xfd1b: is-service=true
      4 x operation:
        ConditionCheckRead: possible-error=DidServices_0xfd1b/E_PENDING
          arg ErrorCode: type=Dcm_NegativeResponseCodeType, direction=OUT
        ConditionCheckWrite: possible-error=DidServices_0xfd1b/E_PENDING
          arg ErrorCode: type=Dcm_NegativeResponseCodeType, direction=OUT
        ReadData: possible-error=[DidServices_0xfd1b/E_NOT_OK, DidServices_0xfd1b/E_PENDING]
          arg data: type=Dcm_1Byte_Type, direction=INOUT
        WriteData: possible-error=DidServices_0xfd1b/E_PENDING
          arg data: type=Dcm_1Byte_Type, direction=INOUT
          arg dataLength: type=UInt16, direction=IN
          arg ErrorCode: type=Dcm_NegativeResponseCodeType, direction=OUT
      error E_NOT_OK: error-code=1
      error E_PENDING: error-code=10
    DidServices_0xfd1c: is-service=true
      operation ConditionCheckRead: possible-error=DidServices_0xfd1c/E_PENDING
        arg ErrorCode: type=Dcm_NegativeResponseCodeType, direction=OUT
      operation ReadData: possible-error=[DidServices_0xfd1c/E_NOT_OK, DidServices_0xfd1c/E_PENDING]
        arg data: type=Dcm_3Byte_Type, direction=INOUT
      error E_NOT_OK: error-code=1
      error E_PENDING: error-code=10
    DidServices_0xfd1e: is-service=true
      4 x operation:
        ConditionCheckRead: possible-error=DidServices_0xfd1e/E_PENDING
          arg ErrorCode: type=Dcm_NegativeResponseCodeType, direction=OUT
        ConditionCheckWrite: possible-error=DidServices_0xfd1e/E_PENDING
          arg ErrorCode: type=Dcm_NegativeResponseCodeType, direction=OUT
        ReadData: possible-error=[DidServices_0xfd1e/E_NOT_OK, DidServices_0xfd1e/E_PENDING]
          arg data: type=Dcm_2Byte_Type, direction=INOUT
        WriteData: possible-error=DidServices_0xfd1e/E_PENDING
          arg data: type=Dcm_2Byte_Type, direction=INOUT
          arg dataLength: type=UInt16, direction=IN
          arg ErrorCode: type=Dcm_NegativeResponseCodeType, direction=OUT
      error E_NOT_OK: error-code=1
      error E_PENDING: error-code=10
    DidServices_0xfd20: is-service=true
      operation ConditionCheckRead: possible-error=DidServices_0xfd20/E_PENDING
        arg ErrorCode: type=Dcm_NegativeResponseCodeType, direction=OUT
      operation ReadData: possible-error=[DidServices_0xfd20/E_NOT_OK, DidServices_0xfd20/E_PENDING]
        arg data: type=Dcm_3Byte_Type, direction=INOUT
      error E_NOT_OK: error-code=1
      error E_PENDING: error-code=10
    DidServices_0xfd21: is-service=true
      4 x operation:
        ConditionCheckRead: possible-error=DidServices_0xfd21/E_PENDING
          arg ErrorCode: type=Dcm_NegativeResponseCodeType, direction=OUT
        ConditionCheckWrite: possible-error=DidServices_0xfd21/E_PENDING
          arg ErrorCode: type=Dcm_NegativeResponseCodeType, direction=OUT
        ReadData: possible-error=[DidServices_0xfd21/E_NOT_OK, DidServices_0xfd21/E_PENDING]
          arg data: type=Dcm_1Byte_Type, direction=INOUT
        WriteData: possible-error=DidServices_0xfd21/E_PENDING
          arg data: type=Dcm_1Byte_Type, direction=INOUT
          arg dataLength: type=UInt16, direction=IN
          arg ErrorCode: type=Dcm_NegativeResponseCodeType, direction=OUT
      error E_NOT_OK: error-code=1
      error E_PENDING: error-code=10
    DidServices_0xfd23: is-service=true
      4 x operation:
        ConditionCheckRead: possible-error=DidServices_0xfd23/E_PENDING
          arg ErrorCode: type=Dcm_NegativeResponseCodeType, direction=OUT
        ConditionCheckWrite: possible-error=DidServices_0xfd23/E_PENDING
          arg ErrorCode: type=Dcm_NegativeResponseCodeType, direction=OUT
        ReadData: possible-error=[DidServices_0xfd23/E_NOT_OK, DidServices_0xfd23/E_PENDING]
          arg data: type=Dcm_1Byte_Type, direction=INOUT
        WriteData: possible-error=DidServices_0xfd23/E_PENDING
          arg data: type=Dcm_1Byte_Type, direction=INOUT
          arg dataLength: type=UInt16, direction=IN
          arg ErrorCode: type=Dcm_NegativeResponseCodeType, direction=OUT
      error E_NOT_OK: error-code=1
      error E_PENDING: error-code=10
    DidServices_0xfd25: is-service=true
      4 x operation:
        ConditionCheckRead: possible-error=DidServices_0xfd25/E_PENDING
          arg ErrorCode: type=Dcm_NegativeResponseCodeType, direction=OUT
        ConditionCheckWrite: possible-error=DidServices_0xfd25/E_PENDING
          arg ErrorCode: type=Dcm_NegativeResponseCodeType, direction=OUT
        ReadData: possible-error=[DidServices_0xfd25/E_NOT_OK, DidServices_0xfd25/E_PENDING]
          arg data: type=Dcm_2Byte_Type, direction=INOUT
        WriteData: possible-error=DidServices_0xfd25/E_PENDING
          arg data: type=Dcm_2Byte_Type, direction=INOUT
          arg dataLength: type=UInt16, direction=IN
          arg ErrorCode: type=Dcm_NegativeResponseCodeType, direction=OUT
      error E_NOT_OK: error-code=1
      error E_PENDING: error-code=10
    DidServices_0xfd26: is-service=true
      4 x operation:
        ConditionCheckRead: possible-error=DidServices_0xfd26/E_PENDING
          arg ErrorCode: type=Dcm_NegativeResponseCodeType, direction=OUT
        ConditionCheckWrite: possible-error=DidServices_0xfd26/E_PENDING
          arg ErrorCode: type=Dcm_NegativeResponseCodeType, direction=OUT
        ReadData: possible-error=[DidServices_0xfd26/E_NOT_OK, DidServices_0xfd26/E_PENDING]
          arg data: type=Dcm_3Byte_Type, direction=INOUT
        WriteData: possible-error=DidServices_0xfd26/E_PENDING
          arg data: type=Dcm_3Byte_Type, direction=INOUT
          arg dataLength: type=UInt16, direction=IN
          arg ErrorCode: type=Dcm_NegativeResponseCodeType, direction=OUT
      error E_NOT_OK: error-code=1
      error E_PENDING: error-code=10
    DidServices_0xfd27: is-service=true
      4 x operation:
        ConditionCheckRead: possible-error=DidServices_0xfd27/E_PENDING
          arg ErrorCode: type=Dcm_NegativeResponseCodeType, direction=OUT
        ConditionCheckWrite: possible-error=DidServices_0xfd27/E_PENDING
          arg ErrorCode: type=Dcm_NegativeResponseCodeType, direction=OUT
        ReadData: possible-error=[DidServices_0xfd27/E_NOT_OK, DidServices_0xfd27/E_PENDING]
          arg data: type=Dcm_1Byte_Type, direction=INOUT
        WriteData: possible-error=DidServices_0xfd27/E_PENDING
          arg data: type=Dcm_1Byte_Type, direction=INOUT
          arg dataLength: type=UInt16, direction=IN
          arg ErrorCode: type=Dcm_NegativeResponseCodeType, direction=OUT
      error E_NOT_OK: error-code=1
      error E_PENDING: error-code=10
    DidServices_0xfd29: is-service=true
      4 x operation:
        ConditionCheckRead: possible-error=DidServices_0xfd29/E_PENDING
          arg ErrorCode: type=Dcm_NegativeResponseCodeType, direction=OUT
        ConditionCheckWrite: possible-error=DidServices_0xfd29/E_PENDING
          arg ErrorCode: type=Dcm_NegativeResponseCodeType, direction=OUT
        ReadData: possible-error=[DidServices_0xfd29/E_NOT_OK, DidServices_0xfd29/E_PENDING]
          arg data: type=Dcm_2Byte_Type, direction=INOUT
        WriteData: possible-error=DidServices_0xfd29/E_PENDING
          arg data: type=Dcm_2Byte_Type, direction=INOUT
          arg dataLength: type=UInt16, direction=IN
          arg ErrorCode: type=Dcm_NegativeResponseCodeType, direction=OUT
      error E_NOT_OK: error-code=1
      error E_PENDING: error-code=10
    DidServices_0xfd30: is-service=true
      4 x operation:
        ConditionCheckRead: possible-error=DidServices_0xfd30/E_PENDING
          arg ErrorCode: type=Dcm_NegativeResponseCodeType, direction=OUT
        ConditionCheckWrite: possible-error=DidServices_0xfd30/E_PENDING
          arg ErrorCode: type=Dcm_NegativeResponseCodeType, direction=OUT
        ReadData: possible-error=[DidServices_0xfd30/E_NOT_OK, DidServices_0xfd30/E_PENDING]
          arg data: type=Dcm_5Byte_Type, direction=INOUT
        WriteData: possible-error=DidServices_0xfd30/E_PENDING
          arg data: type=Dcm_5Byte_Type, direction=INOUT
          arg dataLength: type=UInt16, direction=IN
          arg ErrorCode: type=Dcm_NegativeResponseCodeType, direction=OUT
      error E_NOT_OK: error-code=1
      error E_PENDING: error-code=10
    DidServices_0xfd31: is-service=true
      operation ConditionCheckRead: possible-error=DidServices_0xfd31/E_PENDING
        arg ErrorCode: type=Dcm_NegativeResponseCodeType, direction=OUT
      operation ReadData: possible-error=[DidServices_0xfd31/E_NOT_OK, DidServices_0xfd31/E_PENDING]
        arg data: type=Dcm_12Byte_Type, direction=INOUT
      error E_NOT_OK: error-code=1
      error E_PENDING: error-code=10
    DidServices_0xfda1: is-service=true
      4 x operation:
        ConditionCheckRead: possible-error=DidServices_0xfda1/E_PENDING
          arg ErrorCode: type=Dcm_NegativeResponseCodeType, direction=OUT
        ConditionCheckWrite: possible-error=DidServices_0xfda1/E_PENDING
          arg ErrorCode: type=Dcm_NegativeResponseCodeType, direction=OUT
        ReadData: possible-error=[DidServices_0xfda1/E_NOT_OK, DidServices_0xfda1/E_PENDING]
          arg data: type=Dcm_4Byte_Type, direction=INOUT
        WriteData: possible-error=DidServices_0xfda1/E_PENDING
          arg data: type=Dcm_4Byte_Type, direction=INOUT
          arg dataLength: type=UInt16, direction=IN
          arg ErrorCode: type=Dcm_NegativeResponseCodeType, direction=OUT
      error E_NOT_OK: error-code=1
      error E_PENDING: error-code=10
    DidServices_0xfda2: is-service=true
      4 x operation:
        ConditionCheckRead: possible-error=DidServices_0xfda2/E_PENDING
          arg ErrorCode: type=Dcm_NegativeResponseCodeType, direction=OUT
        ConditionCheckWrite: possible-error=DidServices_0xfda2/E_PENDING
          arg ErrorCode: type=Dcm_NegativeResponseCodeType, direction=OUT
        ReadData: possible-error=[DidServices_0xfda2/E_NOT_OK, DidServices_0xfda2/E_PENDING]
          arg data: type=Dcm_4Byte_Type, direction=INOUT
        WriteData: possible-error=DidServices_0xfda2/E_PENDING
          arg data: type=Dcm_4Byte_Type, direction=INOUT
          arg dataLength: type=UInt16, direction=IN
          arg ErrorCode: type=Dcm_NegativeResponseCodeType, direction=OUT
      error E_NOT_OK: error-code=1
      error E_PENDING: error-code=10
    DidServices_0xfda3: is-service=true
      4 x operation:
        ConditionCheckRead: possible-error=DidServices_0xfda3/E_PENDING
          arg ErrorCode: type=Dcm_NegativeResponseCodeType, direction=OUT
        ConditionCheckWrite: possible-error=DidServices_0xfda3/E_PENDING
          arg ErrorCode: type=Dcm_NegativeResponseCodeType, direction=OUT
        ReadData: possible-error=[DidServices_0xfda3/E_NOT_OK, DidServices_0xfda3/E_PENDING]
          arg data: type=Dcm_12Byte_Type, direction=INOUT
        WriteData: possible-error=DidServices_0xfda3/E_PENDING
          arg data: type=Dcm_12Byte_Type, direction=INOUT
          arg dataLength: type=UInt16, direction=IN
          arg ErrorCode: type=Dcm_NegativeResponseCodeType, direction=OUT
      error E_NOT_OK: error-code=1
      error E_PENDING: error-code=10
    DidServices_0xfdac: is-service=true
      4 x operation:
        ConditionCheckRead: possible-error=DidServices_0xfdac/E_PENDING
          arg ErrorCode: type=Dcm_NegativeResponseCodeType, direction=OUT
        ConditionCheckWrite: possible-error=DidServices_0xfdac/E_PENDING
          arg ErrorCode: type=Dcm_NegativeResponseCodeType, direction=OUT
        ReadData: possible-error=[DidServices_0xfdac/E_NOT_OK, DidServices_0xfdac/E_PENDING]
          arg data: type=Dcm_64Byte_Type, direction=INOUT
        WriteData: possible-error=DidServices_0xfdac/E_PENDING
          arg data: type=Dcm_64Byte_Type, direction=INOUT
          arg dataLength: type=UInt16, direction=IN
          arg ErrorCode: type=Dcm_NegativeResponseCodeType, direction=OUT
      error E_NOT_OK: error-code=1
      error E_PENDING: error-code=10
    DidServices_0xfdad: is-service=true
      operation ConditionCheckRead: possible-error=DidServices_0xfdad/E_PENDING
        arg ErrorCode: type=Dcm_NegativeResponseCodeType, direction=OUT
      operation ReadData: possible-error=[DidServices_0xfdad/E_NOT_OK, DidServices_0xfdad/E_PENDING]
        arg data: type=Dcm_7Byte_Type, direction=INOUT
      error E_NOT_OK: error-code=1
      error E_PENDING: error-code=10
    DidServices_0xfdae: is-service=true
      4 x operation:
        ConditionCheckRead: possible-error=DidServices_0xfdae/E_PENDING
          arg ErrorCode: type=Dcm_NegativeResponseCodeType, direction=OUT
        ConditionCheckWrite: possible-error=DidServices_0xfdae/E_PENDING
          arg ErrorCode: type=Dcm_NegativeResponseCodeType, direction=OUT
        ReadData: possible-error=[DidServices_0xfdae/E_NOT_OK, DidServices_0xfdae/E_PENDING]
          arg data: type=Dcm_2Byte_Type, direction=INOUT
        WriteData: possible-error=DidServices_0xfdae/E_PENDING
          arg data: type=Dcm_2Byte_Type, direction=INOUT
          arg dataLength: type=UInt16, direction=IN
          arg ErrorCode: type=Dcm_NegativeResponseCodeType, direction=OUT
      error E_NOT_OK: error-code=1
      error E_PENDING: error-code=10
    DidServices_0xfdaf: is-service=true
      operation ConditionCheckRead: possible-error=DidServices_0xfdaf/E_PENDING
        arg ErrorCode: type=Dcm_NegativeResponseCodeType, direction=OUT
      operation ReadData: possible-error=[DidServices_0xfdaf/E_NOT_OK, DidServices_0xfdaf/E_PENDING]
        arg data: type=Dcm_176Byte_Type, direction=INOUT
      error E_NOT_OK: error-code=1
      error E_PENDING: error-code=10
    DidServices_0xfdb0: is-service=true
      4 x operation:
        ConditionCheckRead: possible-error=DidServices_0xfdb0/E_PENDING
          arg ErrorCode: type=Dcm_NegativeResponseCodeType, direction=OUT
        ConditionCheckWrite: possible-error=DidServices_0xfdb0/E_PENDING
          arg ErrorCode: type=Dcm_NegativeResponseCodeType, direction=OUT
        ReadData: possible-error=[DidServices_0xfdb0/E_NOT_OK, DidServices_0xfdb0/E_PENDING]
          arg data: type=Dcm_256Byte_Type, direction=INOUT
        WriteData: possible-error=DidServices_0xfdb0/E_PENDING
          arg data: type=Dcm_256Byte_Type, direction=INOUT
          arg dataLength: type=UInt16, direction=IN
          arg ErrorCode: type=Dcm_NegativeResponseCodeType, direction=OUT
      error E_NOT_OK: error-code=1
      error E_PENDING: error-code=10
    DidServices_0xfdb1: is-service=true
      4 x operation:
        ConditionCheckRead: possible-error=DidServices_0xfdb1/E_PENDING
          arg ErrorCode: type=Dcm_NegativeResponseCodeType, direction=OUT
        ConditionCheckWrite: possible-error=DidServices_0xfdb1/E_PENDING
          arg ErrorCode: type=Dcm_NegativeResponseCodeType, direction=OUT
        ReadData: possible-error=[DidServices_0xfdb1/E_NOT_OK, DidServices_0xfdb1/E_PENDING]
          arg data: type=Dcm_256Byte_Type, direction=INOUT
        WriteData: possible-error=DidServices_0xfdb1/E_PENDING
          arg data: type=Dcm_256Byte_Type, direction=INOUT
          arg dataLength: type=UInt16, direction=IN
          arg ErrorCode: type=Dcm_NegativeResponseCodeType, direction=OUT
      error E_NOT_OK: error-code=1
      error E_PENDING: error-code=10
    DidServices_0xfdb2: is-service=true
      4 x operation:
        ConditionCheckRead: possible-error=DidServices_0xfdb2/E_PENDING
          arg ErrorCode: type=Dcm_NegativeResponseCodeType, direction=OUT
        ConditionCheckWrite: possible-error=DidServices_0xfdb2/E_PENDING
          arg ErrorCode: type=Dcm_NegativeResponseCodeType, direction=OUT
        ReadData: possible-error=[DidServices_0xfdb2/E_NOT_OK, DidServices_0xfdb2/E_PENDING]
          arg data: type=Dcm_256Byte_Type, direction=INOUT
        WriteData: possible-error=DidServices_0xfdb2/E_PENDING
          arg data: type=Dcm_256Byte_Type, direction=INOUT
          arg dataLength: type=UInt16, direction=IN
          arg ErrorCode: type=Dcm_NegativeResponseCodeType, direction=OUT
      error E_NOT_OK: error-code=1
      error E_PENDING: error-code=10
    DidServices_0xfdb3: is-service=true
      4 x operation:
        ConditionCheckRead: possible-error=DidServices_0xfdb3/E_PENDING
          arg ErrorCode: type=Dcm_NegativeResponseCodeType, direction=OUT
        ConditionCheckWrite: possible-error=DidServices_0xfdb3/E_PENDING
          arg ErrorCode: type=Dcm_NegativeResponseCodeType, direction=OUT
        ReadData: possible-error=[DidServices_0xfdb3/E_NOT_OK, DidServices_0xfdb3/E_PENDING]
          arg data: type=Dcm_256Byte_Type, direction=INOUT
        WriteData: possible-error=DidServices_0xfdb3/E_PENDING
          arg data: type=Dcm_256Byte_Type, direction=INOUT
          arg dataLength: type=UInt16, direction=IN
          arg ErrorCode: type=Dcm_NegativeResponseCodeType, direction=OUT
      error E_NOT_OK: error-code=1
      error E_PENDING: error-code=10
    DidServices_0xfdb4: is-service=true
      4 x operation:
        ConditionCheckRead: possible-error=DidServices_0xfdb4/E_PENDING
          arg ErrorCode: type=Dcm_NegativeResponseCodeType, direction=OUT
        ConditionCheckWrite: possible-error=DidServices_0xfdb4/E_PENDING
          arg ErrorCode: type=Dcm_NegativeResponseCodeType, direction=OUT
        ReadData: possible-error=[DidServices_0xfdb4/E_NOT_OK, DidServices_0xfdb4/E_PENDING]
          arg data: type=Dcm_8Byte_Type, direction=INOUT
        WriteData: possible-error=DidServices_0xfdb4/E_PENDING
          arg data: type=Dcm_8Byte_Type, direction=INOUT
          arg dataLength: type=UInt16, direction=IN
          arg ErrorCode: type=Dcm_NegativeResponseCodeType, direction=OUT
      error E_NOT_OK: error-code=1
      error E_PENDING: error-code=10
    DidServices_0xfdb5: is-service=true
      4 x operation:
        ConditionCheckRead: possible-error=DidServices_0xfdb5/E_PENDING
          arg ErrorCode: type=Dcm_NegativeResponseCodeType, direction=OUT
        ConditionCheckWrite: possible-error=DidServices_0xfdb5/E_PENDING
          arg ErrorCode: type=Dcm_NegativeResponseCodeType, direction=OUT
        ReadData: possible-error=[DidServices_0xfdb5/E_NOT_OK, DidServices_0xfdb5/E_PENDING]
          arg data: type=Dcm_4Byte_Type, direction=INOUT
        WriteData: possible-error=DidServices_0xfdb5/E_PENDING
          arg data: type=Dcm_4Byte_Type, direction=INOUT
          arg dataLength: type=UInt16, direction=IN
          arg ErrorCode: type=Dcm_NegativeResponseCodeType, direction=OUT
      error E_NOT_OK: error-code=1
      error E_PENDING: error-code=10
    DidServices_0xfdb6: is-service=true
      4 x operation:
        ConditionCheckRead: possible-error=DidServices_0xfdb6/E_PENDING
          arg ErrorCode: type=Dcm_NegativeResponseCodeType, direction=OUT
        ConditionCheckWrite: possible-error=DidServices_0xfdb6/E_PENDING
          arg ErrorCode: type=Dcm_NegativeResponseCodeType, direction=OUT
        ReadData: possible-error=[DidServices_0xfdb6/E_NOT_OK, DidServices_0xfdb6/E_PENDING]
          arg data: type=Dcm_4Byte_Type, direction=INOUT
        WriteData: possible-error=DidServices_0xfdb6/E_PENDING
          arg data: type=Dcm_4Byte_Type, direction=INOUT
          arg dataLength: type=UInt16, direction=IN
          arg ErrorCode: type=Dcm_NegativeResponseCodeType, direction=OUT
      error E_NOT_OK: error-code=1
      error E_PENDING: error-code=10
    DidServices_0xfdb7: is-service=true
      4 x operation:
        ConditionCheckRead: possible-error=DidServices_0xfdb7/E_PENDING
          arg ErrorCode: type=Dcm_NegativeResponseCodeType, direction=OUT
        ConditionCheckWrite: possible-error=DidServices_0xfdb7/E_PENDING
          arg ErrorCode: type=Dcm_NegativeResponseCodeType, direction=OUT
        ReadData: possible-error=[DidServices_0xfdb7/E_NOT_OK, DidServices_0xfdb7/E_PENDING]
          arg data: type=Dcm_18Byte_Type, direction=INOUT
        WriteData: possible-error=DidServices_0xfdb7/E_PENDING
          arg data: type=Dcm_18Byte_Type, direction=INOUT
          arg dataLength: type=UInt16, direction=IN
          arg ErrorCode: type=Dcm_NegativeResponseCodeType, direction=OUT
      error E_NOT_OK: error-code=1
      error E_PENDING: error-code=10
    DidServices_0xfe00: is-service=true
      4 x operation:
        ConditionCheckRead: possible-error=DidServices_0xfe00/E_PENDING
          arg ErrorCode: type=Dcm_NegativeResponseCodeType, direction=OUT
        ReadData: possible-error=[DidServices_0xfe00/E_NOT_OK, DidServices_0xfe00/E_PENDING]
          arg data: type=Dcm_3Byte_Type, direction=INOUT
        ReturnControlToECU: possible-error=DidServices_0xfe00/E_PENDING
          4 x arg:
            RequestData: type=Dcm_0Byte_Type, direction=INOUT
            RequestDataLength: type=UInt16, direction=IN
            ResponseData: type=Dcm_3Byte_Type, direction=INOUT
            ErrorCode: type=Dcm_NegativeResponseCodeType, direction=OUT
        ShortTermAdjustment: possible-error=DidServices_0xfe00/E_PENDING
          4 x arg:
            RequestData: type=Dcm_3Byte_Type, direction=INOUT
            RequestDataLength: type=UInt16, direction=IN
            ResponseData: type=Dcm_3Byte_Type, direction=INOUT
            ErrorCode: type=Dcm_NegativeResponseCodeType, direction=OUT
      error E_NOT_OK: error-code=1
      error E_PENDING: error-code=10
    DigHwTrqSENT_SCom
      4 x operation:
        ClrTrqTrim: possible-error=DigHwTrqSENT_SCom/ConditionsNotCorrect
        SetTrqTrim: possible-error=DigHwTrqSENT_SCom/ConditionsNotCorrect
        TrimData
          arg EOLHwTrqTrim_HwNm_f32: type=Float, direction=OUT
          arg EOLHwTrqTrimPerformed_Cnt_Lgc: type=Boolean, direction=OUT
        WriteData
          arg HwTrqTrim_HwNm_f32: type=Float, direction=IN
      error ConditionsNotCorrect: error-code=34
    DigitalIn
      operation OP_SET: possible-error=DigitalIn/E_NOT_OK
        arg signal: type=IoHwAb_BoolType, direction=IN
      error E_NOT_OK: error-code=1
    DigitalInOut
      operation OP_GET: possible-error=DigitalInOut/E_NOT_OK
        arg signal: type=IoHwAb_BoolType, direction=OUT
      operation OP_SET: possible-error=DigitalInOut/E_NOT_OK
        arg signal: type=IoHwAb_BoolType, direction=IN
      error E_NOT_OK: error-code=1
    DigitalOut
      operation OP_SET: possible-error=DigitalOut/E_NOT_OK
        arg signal: type=IoHwAb_BoolType, direction=IN
      error E_NOT_OK: error-code=1
    EpsEn
      operation OP_GET: possible-error=EpsEn/E_NOT_OK
        arg signal: type=IoHwAb_BoolType, direction=OUT
      error E_NOT_OK: error-code=1
    FaultInjection_SCom
      operation FltInjection
        arg SignalPath_Uls_f32: type=Float, direction=INOUT
        arg LocationKey_Cnt_enum: type=FltInjectionLocType, direction=IN
    FetDrvCntl
      operation OP_GET: possible-error=FetDrvCntl/E_NOT_OK
        arg signal: type=IoHwAb_BoolType, direction=OUT
      error E_NOT_OK: error-code=1
    FetDrvReset
      operation OP_GET: possible-error=FetDrvReset/E_NOT_OK
        arg signal: type=IoHwAb_BoolType, direction=OUT
      operation OP_SET: possible-error=FetDrvReset/E_NOT_OK
        arg signal: type=IoHwAb_BoolType, direction=IN
      error E_NOT_OK: error-code=1
    FetFlt1Data
      operation OP_GET: possible-error=FetFlt1Data/E_NOT_OK
        arg signal: type=IoHwAb_BoolType, direction=OUT
      error E_NOT_OK: error-code=1
    FetFlt2Clk
      operation OP_GET: possible-error=FetFlt2Clk/E_NOT_OK
        arg signal: type=IoHwAb_BoolType, direction=OUT
      operation OP_SET: possible-error=FetFlt2Clk/E_NOT_OK
        arg signal: type=IoHwAb_BoolType, direction=IN
      error E_NOT_OK: error-code=1
    FltInjection_SCom
      operation FltInjection
        arg SignalPath_Uls_f32: type=Float, direction=INOUT
        arg LocationKey_Cnt_enum: type=FltInjectionLocType, direction=IN
    HaitecTrqCmd_SCom
      operation StartCtrl: possible-error=HaitecTrqCmd_SCom/E_NOT_OK
        arg Param_ManTrqCmd_MtrNm_f32: type=Float, direction=IN
        arg Param_DefeatHwTrq_Cnt_lgc: type=Boolean, direction=IN
        arg Param_DefeatTemp_Cnt_lgc: type=Boolean, direction=IN
      operation StopCtrl
      error E_NOT_OK: error-code=1
    IndicatorStatus: is-service=true
      operation GetIndicatorStatus: possible-error=IndicatorStatus/E_NOT_OK
        arg IndicatorStatus: type=Dem_IndicatorStatusType, direction=OUT
      error E_NOT_OK: error-code=1
    IoHwAbPortConfig
      operation SetFetFlt2ToOutput: possible-error=IoHwAbPortConfig/E_NOT_OK
        arg signal: type=IoHwAb_BoolType, direction=IN
      error E_NOT_OK: error-code=1
    LrnEOT_Scom
      operation ResetEOT
    MilestoneRequest
      operation WarmInitMilestoneComplete
        arg user: type=StaMd_Users, direction=IN
      operation WarmInitMilestoneNotComplete
        arg user: type=StaMd_Users, direction=IN
    MtrCurrTempOffset_Scom
      operation Get
        arg CurrTempOffCal: type=CurrTempOffsetType, direction=OUT
      operation Set
        arg CurrTempOffCal: type=CurrTempOffsetType, direction=IN
    NvM_AC3_SRBS_Srv: is-service=true  # Port Interface for NVRAM Blocks of Management Types "NATIVE" or "REDUNDANT" without default values.
      6 x operation:
        EraseBlock: possible-error=NvM_AC3_SRBS_Srv/E_NOT_OK
        GetErrorStatus
          arg ErrorStatus: type=NvM_RequestResultType, direction=OUT
        InvalidateNvBlock: possible-error=NvM_AC3_SRBS_Srv/E_NOT_OK
        ReadBlock: possible-error=NvM_AC3_SRBS_Srv/E_NOT_OK
          arg DstPtr: type=NvM_DestPtr, direction=OUT
        SetRamBlockStatus
          arg RamBlockStatus: type=Boolean, direction=IN
        WriteBlock: possible-error=NvM_AC3_SRBS_Srv/E_NOT_OK
          arg DstPtr: type=NvM_DestPtr, direction=IN
      error E_NOT_OK: error-code=1
    NvM_AC3_SRBS_Srv_Defs: is-service=true  # Port Interface for NVRAM Blocks of Management Types "NATIVE" or "REDUNDANT" with default values.
      7 x operation:
        EraseBlock: possible-error=NvM_AC3_SRBS_Srv_Defs/E_NOT_OK
        GetErrorStatus
          arg ErrorStatus: type=NvM_RequestResultType, direction=OUT
        InvalidateNvBlock: possible-error=NvM_AC3_SRBS_Srv_Defs/E_NOT_OK
        ReadBlock: possible-error=NvM_AC3_SRBS_Srv_Defs/E_NOT_OK
          arg DstPtr: type=NvM_DestPtr, direction=OUT
        RestoreBlockDefaults: possible-error=NvM_AC3_SRBS_Srv_Defs/E_NOT_OK
          arg DstPtr: type=NvM_DestPtr, direction=OUT
        SetRamBlockStatus
          arg RamBlockStatus: type=Boolean, direction=IN
        WriteBlock: possible-error=NvM_AC3_SRBS_Srv_Defs/E_NOT_OK
          arg DstPtr: type=NvM_DestPtr, direction=IN
      error E_NOT_OK: error-code=1
    NvM_Administration: is-service=true
      operation SetBlockProtection
        arg ProtectionEnabled: type=Boolean, direction=IN
    NxtrDiagMgr
      4 x operation, all with possible-error=NxtrDiagMgr/E_NOT_OK:
        GetNTCActive
          arg NTC_Cnt_T_enum: type=NTCNumber, direction=IN
          arg NTCActive_Ptr_T_lgc: type=Boolean, direction=OUT
        GetNTCFailed
          arg NTC_Cnt_T_enum: type=NTCNumber, direction=IN
          arg NTCFailed_Ptr_T_lgc: type=Boolean, direction=OUT
        GetNTCStatus
          arg NTC_Cnt_T_enum: type=NTCNumber, direction=IN
          arg Status_Ptr_T_u08: type=UInt8, direction=OUT
        SetNTCStatus
          arg NTC_Cnt_T_enum: type=NTCNumber, direction=IN
          arg Param_Cnt_T_u08: type=UInt8, direction=IN
          arg Status_Cnt_T_enum: type=NxtrDiagMgrStatus, direction=IN
      error E_NOT_OK: error-code=1
    OperationCycle: is-service=true
      operation SetOperationCycleState: possible-error=[OperationCycle/DEM_E_QUEUE_OVERFLOW, OperationCycle/E_NOT_OK]
        arg CycleState: type=Dem_OperationCycleStateType, direction=IN
      error DEM_E_QUEUE_OVERFLOW: error-code=15
      error E_NOT_OK: error-code=1
    OvrVoltFdbk
      operation OP_GET: possible-error=OvrVoltFdbk/E_NOT_OK
        arg signal: type=IoHwAb_BoolType, direction=OUT
      error E_NOT_OK: error-code=1
    Polarity_SCom
      operation ReadPolarity
        arg Polarity_Ptr_T_b08: type=UInt8, direction=OUT
      operation SetPolarity
        arg Polarity_Cnt_T_b08: type=UInt8, direction=IN
    PwrSwitchEn
      operation OP_GET: possible-error=PwrSwitchEn/E_NOT_OK
        arg signal: type=IoHwAb_BoolType, direction=OUT
      error E_NOT_OK: error-code=1
    RoutineServices_0xf000: is-service=true
      operation Start: possible-error=RoutineServices_0xf000/E_PENDING
        5 x arg:
          RequestData: type=Dcm_3Byte_Type, direction=INOUT
          RequestDataLength: type=UInt16, direction=IN
          ResponseData: type=Dcm_0Byte_Type, direction=INOUT
          ResponseDataLength: type=UInt16, direction=OUT
          ErrorCode: type=Dcm_NegativeResponseCodeType, direction=OUT
      error E_PENDING: error-code=10
    RoutineServices_0xf001: is-service=true
      operation Start: possible-error=RoutineServices_0xf001/E_PENDING
        5 x arg:
          RequestData: type=Dcm_2Byte_Type, direction=INOUT
          RequestDataLength: type=UInt16, direction=IN
          ResponseData: type=Dcm_0Byte_Type, direction=INOUT
          ResponseDataLength: type=UInt16, direction=OUT
          ErrorCode: type=Dcm_NegativeResponseCodeType, direction=OUT
      error E_PENDING: error-code=10
    RoutineServices_0xf003: is-service=true
      operation Start: possible-error=RoutineServices_0xf003/E_PENDING
        5 x arg:
          RequestData: type=Dcm_1Byte_Type, direction=INOUT
          RequestDataLength: type=UInt16, direction=IN
          ResponseData: type=Dcm_0Byte_Type, direction=INOUT
          ResponseDataLength: type=UInt16, direction=OUT
          ErrorCode: type=Dcm_NegativeResponseCodeType, direction=OUT
      error E_PENDING: error-code=10
    RoutineServices_0xf004: is-service=true
      operation Start: possible-error=RoutineServices_0xf004/E_PENDING
        5 x arg:
          RequestData: type=Dcm_1Byte_Type, direction=INOUT
          RequestDataLength: type=UInt16, direction=IN
          ResponseData: type=Dcm_0Byte_Type, direction=INOUT
          ResponseDataLength: type=UInt16, direction=OUT
          ErrorCode: type=Dcm_NegativeResponseCodeType, direction=OUT
      error E_PENDING: error-code=10
    RoutineServices_0xf005: is-service=true
      operation Start: possible-error=RoutineServices_0xf005/E_PENDING
        5 x arg:
          RequestData: type=Dcm_2Byte_Type, direction=INOUT
          RequestDataLength: type=UInt16, direction=IN
          ResponseData: type=Dcm_3Byte_Type, direction=INOUT
          ResponseDataLength: type=UInt16, direction=OUT
          ErrorCode: type=Dcm_NegativeResponseCodeType, direction=OUT
      error E_PENDING: error-code=10
    RoutineServices_0xf008: is-service=true
      operation Start: possible-error=RoutineServices_0xf008/E_PENDING
        5 x arg:
          RequestData: type=Dcm_1Byte_Type, direction=INOUT
          RequestDataLength: type=UInt16, direction=IN
          ResponseData: type=Dcm_0Byte_Type, direction=INOUT
          ResponseDataLength: type=UInt16, direction=OUT
          ErrorCode: type=Dcm_NegativeResponseCodeType, direction=OUT
      error E_PENDING: error-code=10
    RoutineServices_0xf009: is-service=true
      operation RequestResults: possible-error=RoutineServices_0xf009/E_PENDING
        5 x arg:
          RequestData: type=Dcm_0Byte_Type, direction=INOUT
          RequestDataLength: type=UInt16, direction=IN
          ResponseData: type=Dcm_1Byte_Type, direction=INOUT
          ResponseDataLength: type=UInt16, direction=OUT
          ErrorCode: type=Dcm_NegativeResponseCodeType, direction=OUT
      operation Start: possible-error=RoutineServices_0xf009/E_PENDING
        5 x arg:
          RequestData: type=Dcm_0Byte_Type, direction=INOUT
          RequestDataLength: type=UInt16, direction=IN
          ResponseData: type=Dcm_0Byte_Type, direction=INOUT
          ResponseDataLength: type=UInt16, direction=OUT
          ErrorCode: type=Dcm_NegativeResponseCodeType, direction=OUT
      operation Stop: possible-error=RoutineServices_0xf009/E_PENDING
        5 x arg:
          RequestData: type=Dcm_0Byte_Type, direction=INOUT
          RequestDataLength: type=UInt16, direction=IN
          ResponseData: type=Dcm_0Byte_Type, direction=INOUT
          ResponseDataLength: type=UInt16, direction=OUT
          ErrorCode: type=Dcm_NegativeResponseCodeType, direction=OUT
      error E_PENDING: error-code=10
    RoutineServices_0xf0ff: is-service=true
      operation Start: possible-error=RoutineServices_0xf0ff/E_PENDING
        5 x arg:
          RequestData: type=Dcm_6Byte_Type, direction=INOUT
          RequestDataLength: type=UInt16, direction=IN
          ResponseData: type=Dcm_0Byte_Type, direction=INOUT
          ResponseDataLength: type=UInt16, direction=OUT
          ErrorCode: type=Dcm_NegativeResponseCodeType, direction=OUT
      error E_PENDING: error-code=10
    RoutineServices_0xfee0: is-service=true
      operation Start: possible-error=RoutineServices_0xfee0/E_PENDING
        5 x arg:
          RequestData: type=Dcm_1Byte_Type, direction=INOUT
          RequestDataLength: type=UInt16, direction=IN
          ResponseData: type=Dcm_0Byte_Type, direction=INOUT
          ResponseDataLength: type=UInt16, direction=OUT
          ErrorCode: type=Dcm_NegativeResponseCodeType, direction=OUT
      error E_PENDING: error-code=10
    SCom_AnaMSBArbn_MtrPos
      operation ReadEOLMtrCals
        arg MtrCalDataPtr: type=MtrPosCal_DataType, direction=OUT
        arg Mtr2CalDataPtr: type=MtrPos2Cal_DataType, direction=OUT
      operation SetEOLMtrCals
        arg MtrCalDataPtr: type=MtrPosCal_DataType, direction=IN
        arg Mtr2CalDataPtr: type=MtrPos2Cal_DataType, direction=IN
    SCom_AnaMSBArbn_MtrPos3
      operation ReadEOLMtrCals
        arg Mtr3CalDataPtr: type=MtrPos3Cal_DataType, direction=OUT
      operation SetEOLMtrCals
        arg Mtr3CalDataPtr: type=MtrPos3Cal_DataType, direction=IN
    SCom_EOLNomMtrParam  # Serial communication port for setting and getting a sdoftware component parameter. The parameter is typically an EOL parameter.
      operation Get
        arg NomKe_VpRadpS_f32: type=Float, direction=OUT
        arg NomRmtr_Ohm_f32: type=Float, direction=OUT
      operation Set
        arg NomKe_VpRadpS_f32: type=Float, direction=IN
        arg NomRmtr_Ohm_f32: type=Float, direction=IN
      error ConditionsNotCorrect: error-code=34
      error RequestOutOfRange: error-code=49
    SCom_NxtrDiagMgr
      5 x operation:
        ClearBlackBox
        ClearLatchCounters
        GetNTCInfo
          4 x arg:
            NTC_Cnt_T_enum: type=NTCNumber, direction=IN
            Param_Ptr_T_u08: type=UInt8, direction=OUT
            Status_Ptr_T_u08: type=UInt8, direction=OUT
            AgingCounter_Ptr_T_u08: type=UInt8, direction=OUT
        ReadStrgArray
        ResetNTCStatus
    SCom_ParEng  # Serial communication port for setting and getting a sdoftware component parameter. The parameter is typically an EOL parameter.
      operation Get
        arg Par_f32: type=Float, direction=OUT
      operation Set
        arg Par_f32: type=Float, direction=IN
      error ConditionsNotCorrect: error-code=34
      error RequestOutOfRange: error-code=49
    SecurityAccess_1: is-service=true
      operation CompareKey: possible-error=[E_COMPARE_KEY_FAILED, SecurityAccess_1/E_NOT_OK, SecurityAccess_1/E_PENDING]
        arg Key: type=Dcm_SecAccess_1_KeyType, direction=INOUT
      operation GetSeed: possible-error=[SecurityAccess_1/E_NOT_OK, SecurityAccess_1/E_PENDING]
        arg securityAccessDataRecord: type=Dcm_SecAccess_1_DataRecType, direction=INOUT
        arg Seed: type=Dcm_SecAccess_1_SeedType, direction=INOUT
        arg ErrorCode: type=Dcm_NegativeResponseCodeType, direction=OUT
      error E_COMPARE_KEY_FAILED: error-code=11
      error E_NOT_OK: error-code=1
      error E_PENDING: error-code=10
    SessionControl: is-service=true
      operation ChangeIndication: possible-error=SessionControl/E_NOT_OK
        arg SesCtrlTypeOld: type=Dcm_SesCtrlType, direction=IN
        arg SesCtrlTypeNew: type=Dcm_SesCtrlType, direction=IN
      operation ConfirmationRespPending: possible-error=SessionControl/E_NOT_OK
        arg status: type=Dcm_ConfirmationStatusType, direction=IN
      operation GetSesChgPermission: possible-error=[E_FORCE_RCRRP, SessionControl/E_NOT_OK, SessionControl/E_PENDING, E_SESSION_NOT_ALLOWED]
        arg SesCtrlTypeActive: type=Dcm_SesCtrlType, direction=IN
        arg SesCtrlTypeNew: type=Dcm_SesCtrlType, direction=IN
      4 x error:
        E_FORCE_RCRRP: error-code=12
        E_NOT_OK: error-code=1
        E_PENDING: error-code=10
        E_SESSION_NOT_ALLOWED: error-code=4
    SrlComInput_SCom
      operation ManualVehSpd
        arg VehSpd_Kph_T_f32: type=Float, direction=IN
    StaMd_SCom
      operation EcuReset
      operation FBLTransitionReq
    StateRequest: is-service=true
      5 x operation, all with possible-error=StateRequest/E_NOT_OK:
        GetState
          arg state: type=EcuM_StateType, direction=OUT
        ReleasePOSTRUN
        ReleaseRUN
        RequestPOSTRUN
        RequestRUN
      error E_NOT_OK: error-code=1
    SysFault2
      operation OP_GET: possible-error=SysFault2/E_NOT_OK
        arg signal: type=IoHwAb_BoolType, direction=OUT
      operation OP_SET: possible-error=SysFault2/E_NOT_OK
        arg signal: type=IoHwAb_BoolType, direction=IN
      error E_NOT_OK: error-code=1
    SysFault3
      operation OP_GET: possible-error=SysFault3/E_NOT_OK
        arg signal: type=IoHwAb_BoolType, direction=OUT
      operation OP_SET: possible-error=SysFault3/E_NOT_OK
        arg signal: type=IoHwAb_BoolType, direction=IN
      error E_NOT_OK: error-code=1
    SystemTime: is-service=true
      6 x operation:
        DtrmnElapsedTime_mS_u16  # Nexteer SystemTime Service
          arg InitialTime: type=UInt32, direction=IN
          arg ElapsedTime: type=UInt16, direction=OUT
        DtrmnElapsedTime_mS_u32
          arg InitialTime: type=UInt32, direction=IN
          arg ElapsedTime: type=UInt32, direction=OUT
        DtrmnElapsedTime_uS_u16
          arg InitialTime: type=UInt32, direction=IN
          arg ElapsedTime: type=UInt16, direction=OUT
        DtrmnElapsedTime_uS_u32
          arg InitialTime: type=UInt32, direction=IN
          arg ElapsedTime: type=UInt32, direction=OUT
        GetSystemTime_mS_u32
          arg CurrentTime: type=UInt32, direction=OUT
        GetSystemTime_uS_u32
          arg CurrentTime: type=UInt32, direction=OUT
    TODReset
      operation OP_SET: possible-error=TODReset/E_NOT_OK
        arg signal: type=IoHwAb_BoolType, direction=IN
      error E_NOT_OK: error-code=1
    TrqCanc_Scom
      4 x operation:
        ReadCogTrqCal
          arg CogTrqCalPtr: type=CoggingCancTrq, direction=OUT
          arg ID: type=UInt16, direction=IN
        ReadCogTrqCalComp
          arg ID: type=UInt16, direction=IN
          arg CogTrqCalPtr: type=CoggingCancTrq, direction=OUT
        SetCogTrqCal
          arg CogTrqCalPtr: type=CoggingCancTrq, direction=IN
          arg ID: type=UInt16, direction=IN
        SetCogTrqCalComp
          arg ID: type=UInt16, direction=IN
          arg CogTrqCalPtr: type=CoggingCancTrq, direction=OUT
    VehDyn_SCom
      operation ResetCenter
    WdgM_AliveSupervision: is-service=true
      operation CheckpointReached: possible-error=WdgM_AliveSupervision/E_NOT_OK  # Indicates to the Watchdog Manager that a Checkpoint within a Supervised Entity has been reached.
      error E_NOT_OK: error-code=1
    WdgM_CheckpointReached: is-service=true
      operation CheckpointReached: possible-error=WdgM_CheckpointReached/E_NOT_OK  # Indicates to the Watchdog Manager that a Checkpoint within a Supervised Entity has been reached.
      error E_NOT_OK: error-code=1
    WdgM_GlobalMode: is-service=true
      7 x operation, all with possible-error=WdgM_GlobalMode/E_NOT_OK:
        GetGlobalStatus  # Returns the global monitoring status of the Watchdog Manager.
          arg Status: type=WdgM_GlobalStatusType, direction=OUT
        GetMode  # Returns the current mode of the Watchdog Manager.
          arg Mode: type=WdgM_ModeType, direction=OUT
        GlobalStateChangeCbk  # Global state change callback notification
          arg Status: type=WdgM_GlobalStatusType, direction=IN
        LocalStateChangeCbk  # Local state change callback notification
          arg Status: type=WdgM_LocalStatusType, direction=IN
        MainFunction  # Performs the processing of the cyclic Watchdog Manager jobs.
        PerformReset  # Instructs the Watchdog Manager to cause a watchdog reset.
        SetMode  # Sets the mode of the Watchdog Manager if the caller is allowed to do so.
      error E_NOT_OK: error-code=1
    WdgM_IndividualMode: is-service=true
      operation ActivateSupervisionEntity: possible-error=WdgM_IndividualMode/E_NOT_OK  # This function activates the monitoring of the given Supervised Entity
      operation DeactivateSupervisionEntity: possible-error=WdgM_IndividualMode/E_NOT_OK  # This function deactivates the monitoring of the given Supervised Entity
      operation GetLocalStatus: possible-error=WdgM_IndividualMode/E_NOT_OK  # Returns the monitoring status of an individual Supervised Entity.
        arg Status: type=WdgM_LocalStatusType, direction=OUT
      error E_NOT_OK: error-code=1
    WdMonitor
      operation OP_SET: possible-error=WdMonitor/E_NOT_OK
        arg signal: type=IoHwAb_BoolType, direction=IN
      error E_NOT_OK: error-code=1
    WdReset
      operation OP_SET: possible-error=WdReset/E_NOT_OK
        arg signal: type=IoHwAb_BoolType, direction=IN
      error E_NOT_OK: error-code=1
  96 x sender receiver interface:
    AltFaultActive_Cnt_lgc
      data Cnt_lgc: type=Boolean
    APA_State_enum
      data State_enum: type=APA_State_enum
    Authority
      data Uls_f32: sw-calibration-access=READ-ONLY, type=Float
    Authority_Uls_f32
      data Uls_f32: sw-calibration-access=READ-ONLY, type=Float
    BattSwdVltgCorrSts_Cnt_enum
      data Cnt_enum: type=BattSwdVltgCorrSts_Cnt_enum
    BoolStatusFlag
      data Cnt_lgc: sw-calibration-access=READ-ONLY, type=Boolean
    BoolStatusFlag_Cnt_lgc
      data Cnt_lgc: sw-calibration-access=READ-ONLY, type=Boolean
    BoolStatusFlagCnt_lgc
      data Cnt_lgc: sw-calibration-access=READ-ONLY, type=Boolean
    Com_BCM_Key_Sta
      data Cnt_enum: type=DT_BCM_Key_Sta
    Com_CAN_N
      data Cnt_u16: type=DT_CAN_N
    Com_Elect_PWR_Consumpt
      data Cnt_u08: type=DT_Elect_PWR_Consumpt
    Com_EpasFailed
      data Cnt_lgc: type=DT_EpasFailed
    Com_LV_CAN_N_ERR
      data Cnt_lgc: type=DT_LV_CAN_N_ERR
    Com_Rel_Steer_Wheel_Ang
      data Cnt_u16: type=DT_Rel_Steer_Wheel_Ang
    Com_Rel_Steer_Wheel_Ang_Validity
      data Cnt_lgc: type=DT_Rel_Steer_Wheel_Ang_Validity
    Com_SAS_Angle
      data Cnt_u16: type=DT_SAS_Angle
    Com_SAS_CAL
      data Cnt_lgc: type=DT_SAS_CAL
    Com_SAS_CheckSum
      data Cnt_u08: type=DT_SAS_CheckSum
    Com_SAS_Init
      data Cnt_lgc: type=DT_SAS_Init
    Com_SAS_MsgCount
      data Cnt_u08: type=DT_SAS_MsgCount
    Com_SAS_OK
      data Cnt_lgc: type=DT_SAS_OK
    Com_Steering_Torque
      data Cnt_u08: type=DT_Steering_Torque
    Com_Steering_Torque_V
      data Cnt_lgc: type=DT_Steering_Torque_V
    Com_VehSpeed
      data Cnt_u16: type=DT_VehSpeed
    Count_Cnt_s08
      data Cnt_s08: sw-calibration-access=READ-ONLY, type=SInt8
    Count_Cnt_s16
      data Cnt_s16: sw-calibration-access=READ-ONLY, type=SInt16
    Count_Cnt_s32
      data Cnt_s32: sw-calibration-access=READ-ONLY, type=SInt32
    Count_Cnt_u08
      data Cnt_u08: sw-calibration-access=READ-ONLY, type=UInt8
    Count_Cnt_u16
      data Cnt_u16: sw-calibration-access=READ-ONLY, type=UInt16
    Count_Cnt_u32
      data Cnt_u32: sw-calibration-access=READ-ONLY, type=UInt32
    Current_Amp_f32
      data Amp_f32: sw-calibration-access=READ-ONLY, type=Float
    DefeatFricLearning
      data Cnt_lgc: sw-calibration-access=READ-ONLY, type=Boolean
    Direction_Cnt_s08
      data Cnt_s08: sw-calibration-access=READ-ONLY, type=SInt8
    Enable
      data Cnt_lgc: sw-calibration-access=READ-ONLY, type=Boolean
    Enable_Cnt_lgc
      data Cnt_lgc: sw-calibration-access=READ-ONLY, type=Boolean
    EnergyModeState_Cnt_enum
      data Cnt_enum: type=EnergyModeStateType
    EngineSpeed_Rpm_f32
      data Rpm_f32: type=Float
    EOTDisable_Cnt_T_lgc
      data Cnt_lgc: sw-calibration-access=READ-ONLY, type=Boolean
    ESC_State_enum
      data State_enum: type=ESC_State_enum
    FETFaultPhase
      data Cnt_enum: sw-calibration-access=READ-ONLY, type=FETPHASETYPE_ENUM
    FETFaultType
      data Cnt_enum: sw-calibration-access=READ-ONLY, type=FETFAULTTYPE_ENUM
    Force_kN_f32
      data kN_f32: sw-calibration-access=READ-ONLY, type=Float
    Frequency_Hz_f32
      data Hz_f32: sw-calibration-access=READ-ONLY, type=Float
    Haptic_State_enum
      data State_enum: type=Haptic_State_enum
    HwAccel_HwDegpSecSqr_f32
      data HwDegpSecSqr_f32: sw-calibration-access=READ-ONLY, type=Float
    HwPos
      data HwDeg_f32: sw-calibration-access=READ-ONLY, type=Float
    HwPos_HwDeg_f32
      data HwDeg_f32: sw-calibration-access=READ-ONLY, type=Float
    HwTrq
      data HwNm_f32: sw-calibration-access=READ-ONLY, type=Float
    HwTrq_HwNm_f32
      data HwNm_f32: sw-calibration-access=READ-ONLY, type=Float
    HwVel
      data HwRadpS_f32: sw-calibration-access=READ-ONLY, type=Float
    HwVel_HwDegpSec_f32
      data HwDegpSec_f32: sw-calibration-access=READ-ONLY, type=Float
    HwVel_HwRadpS_f32
      data HwRadpS_f32: sw-calibration-access=READ-ONLY, type=Float
    IgnCnt_Cnt_u16
      data Cnt_u16: sw-calibration-access=READ-ONLY, type=UInt16
    Inductance_Henry_f32
      data Henry_f32: sw-calibration-access=READ-ONLY, type=Float
    LatAccel_g_f32
      data g_f32: type=Float
    LKA_State_enum
      data State_enum: type=LKA_State_enum
    LOA_State_enum
      data State_enum: type=LOA_State_enum
    ManufModes_Cnt_enum
      data Cnt_enum: sw-calibration-access=READ-ONLY, type=ManufModeType
    MtrPos_Deg_f32
      data Deg_f32: sw-calibration-access=READ-ONLY, type=Float
    MtrPos_Rad_f32
      data Rad_f32: sw-calibration-access=READ-ONLY, type=Float
    MtrPos_Rev_f32
      data Rev_f32: sw-calibration-access=READ-ONLY, type=Float
    MtrPos_Rev_u0p16
      data Rev_u0p16: sw-calibration-access=READ-ONLY, type=UInt16
    MtrQuad_Cnt_u08
      data Cnt_u08: sw-calibration-access=READ-ONLY, type=UInt8
    MtrTrq
      data MtrNm_f32: sw-calibration-access=READ-ONLY, type=Float
    MtrTrq_MtrNm_f32
      data MtrNm_f32: sw-calibration-access=READ-ONLY, type=Float
    MtrVel
      data MtrRadpS_f32: sw-calibration-access=READ-ONLY, type=Float
    MtrVel_MtrRadpS_f32
      data MtrRadpS_f32: sw-calibration-access=READ-ONLY, type=Float
    MtrVltConstant_VpRadpS_f32
      data VpRadpS_f32: sw-calibration-access=READ-ONLY, type=Float
    PhsAdv_Cnt_s16
      data Cnt_s16: sw-calibration-access=READ-ONLY, type=SInt16
    PI_RawADCSig
      data Volts_f32: sw-calibration-access=READ-ONLY, type=Float
    PkCurr_AmpSq_f32
      data AmpSq_f32: sw-calibration-access=READ-ONLY, type=Float
    Power_Watt_f32
      data Watt_f32: sw-calibration-access=READ-ONLY, type=Float
    RampRate
      data XpmS_f32: sw-calibration-access=READ-ONLY, type=Float
    RampRate_UlspS_f32
      data UlspS_f32: sw-calibration-access=READ-ONLY, type=Float
    RampRate_XpmS_f32
      data XpmS_f32: sw-calibration-access=READ-ONLY, type=Float
    Resistance_Ohm_f32
      data Ohm_f32: sw-calibration-access=READ-ONLY, type=Float
    ScaleFactor_Uls_f32
      data Uls_f32: sw-calibration-access=READ-ONLY, type=Float
    SigQlfr_State_enum
      data State_enum: sw-calibration-access=READ-ONLY, type=SigQlfr_State_enum
    SrlComSvcDft
      data Cnt_b32: sw-calibration-access=READ-ONLY, type=UInt32
    SystemState
      mode declaration group prototype Mode: type=StaMd_Mode
    Temperature
      data DegC_f32: sw-calibration-access=READ-ONLY, type=Float
    Temperature_DegC_f32
      data DegC_f32: sw-calibration-access=READ-ONLY, type=Float
    Time_USec_u32
      data USec_u32: sw-calibration-access=READ-ONLY, type=UInt32
    TuningSessionActPtr
      data Cnt_u8: type=TuningSessionAddrPtrEnum
    UnityScalar
      data Uls_f32: sw-calibration-access=READ-ONLY, type=Float
    UnityScalar_Uls_f32
      data Uls_f32: sw-calibration-access=READ-ONLY, type=Float
    Validity_Cnt_lgc
      data Cnt_lgc: sw-calibration-access=READ-ONLY, type=Boolean
    Vecu_Volt_f32
      data Volt_f32: sw-calibration-access=READ-ONLY, range raw >5..<31, type=Float  # This port prototype is inteded to communicate voltage signals that represent the ecu supplied voltage. This signal has a lower limit, which is non-zero, to allow users of the signal to use it as a denominator in an expression without requiring a divide by 0 check.
    VehAccel_KphpS_f32
      data KphpS_f32: sw-calibration-access=READ-ONLY, type=Float
    VehAccel_MpSecSq_f32
      data MpSecSq_f32: sw-calibration-access=READ-ONLY, type=Float
    VehSpd
      data Kph_f32: sw-calibration-access=READ-ONLY, type=Float
    VehSpd_Kph_f32
      data Kph_f32: sw-calibration-access=READ-ONLY, type=Float
    VltgCtrlTerm_Uls_f32
      data Uls_f32: sw-calibration-access=READ-ONLY, type=Float
    Voltage_Volt_f32
      data Volt_f32: sw-calibration-access=READ-ONLY, range raw >0..<31, type=Float  # This signal is intended to communicate any type voltage signal measured by the ecu. This signal has a lower limit of 0 which reequires users of the signal to provide divide by 0 protection if it is used as a denominator in a calculation. See Vecu port prototype if a port with a lower limit is desired.
    Voltage_Volt_u3p13
      data Volt_u3p13: type=UInt16
    YawRate_DegpS_f32
      data DegpS_f32: sw-calibration-access=READ-ONLY, type=Float
