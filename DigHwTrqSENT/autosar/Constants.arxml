AUTOSAR XML (schema 314)
package /Constant
  6 x constant specification:
    D_2MS_SEC_F32
      value:
        real literal D_2MS_SEC_F32: type=Float, value=0.002
    D_FALSE_CNT_LGC
      value:
        boolean literal D_FALSE_CNT_LGC: type=Boolean, value=false
    D_MANUFMODEINIT_CNT_ENUM
      value:
        integer literal D_MANUFMODEINIT_CNT_ENUM: type=ManufModeType, value=0
    D_TRUE_CNT_LGC
      value:
        boolean literal D_TRUE_CNT_LGC: type=Boolean, value=true
    D_ZERO_CNT_S16
      value:
        integer literal D_ZERO_CNT_S16: type=SInt16, value=0
    D_ZERO_ULS_F32
      value:
        real literal D_ZERO_ULS_F32: type=Float, value=0
