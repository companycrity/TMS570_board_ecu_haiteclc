AUTOSAR XML (schema 314)
package /ComponentType
  internal behavior NvM_InternalBehavior: component=NvM
    132 x operation invoked event:
      OIT_EraseBlock_PS_ConfigBlock_EraseBlock: start-on-event=EraseBlock, operation=PS_ConfigBlock.EraseBlock
      OIT_EraseBlock_PS_Deprecated_NVM_BLOCK_DEM_EraseBlock: start-on-event=EraseBlock, operation=PS_Deprecated_NVM_BLOCK_DEM.EraseBlock
      OIT_EraseBlock_PS_Deprecated_NvmBlock_AbsHwPos_EOLVehCntrOffset_EraseBlock: start-on-event=EraseBlock, operation=PS_Deprecated_NvmBlock_AbsHwPos_EOLVehCntrOffset.EraseBlock
      OIT_EraseBlock_PS_Deprecated_NvmBlock_AbsHwPos_EOLVehCntrOffset1_EraseBlock: start-on-event=EraseBlock, operation=PS_Deprecated_NvmBlock_AbsHwPos_EOLVehCntrOffset1.EraseBlock
      OIT_EraseBlock_PS_Deprecated_NvmBlock_AstLmt_SteerAsstDefeat_EraseBlock: start-on-event=EraseBlock, operation=PS_Deprecated_NvmBlock_AstLmt_SteerAsstDefeat.EraseBlock
      OIT_EraseBlock_PS_Deprecated_NvmBlock_AvgFricLrn_AvgFricLrnData_EraseBlock: start-on-event=EraseBlock, operation=PS_Deprecated_NvmBlock_AvgFricLrn_AvgFricLrnData.EraseBlock
      OIT_EraseBlock_PS_Deprecated_NvmBlock_CmMtrCurr_CurrTempOffset_EraseBlock: start-on-event=EraseBlock, operation=PS_Deprecated_NvmBlock_CmMtrCurr_CurrTempOffset.EraseBlock
      OIT_EraseBlock_PS_Deprecated_NvmBlock_CmMtrCurr_ShCurrCal_EraseBlock: start-on-event=EraseBlock, operation=PS_Deprecated_NvmBlock_CmMtrCurr_ShCurrCal.EraseBlock
      OIT_EraseBlock_PS_Deprecated_NvmBlock_DigHwTrqSENT_DigTrqTrim_EraseBlock: start-on-event=EraseBlock, operation=PS_Deprecated_NvmBlock_DigHwTrqSENT_DigTrqTrim.EraseBlock
      OIT_EraseBlock_PS_Deprecated_NvmBlock_LrnEOT_LearnedEOT_EraseBlock: start-on-event=EraseBlock, operation=PS_Deprecated_NvmBlock_LrnEOT_LearnedEOT.EraseBlock
      OIT_EraseBlock_PS_Deprecated_NvmBlock_TrqCanc_CogTrqCal_EraseBlock: start-on-event=EraseBlock, operation=PS_Deprecated_NvmBlock_TrqCanc_CogTrqCal.EraseBlock
      OIT_EraseBlock_PS_Deprecated_NvmBlock_TrqCanc_CogTrqRplComp_EraseBlock: start-on-event=EraseBlock, operation=PS_Deprecated_NvmBlock_TrqCanc_CogTrqRplComp.EraseBlock
      OIT_EraseBlock_PS_Deprecated_NvmBlock_TrqCmdScl_TorqueCmdSF_Uls_f32_EraseBlock: start-on-event=EraseBlock, operation=PS_Deprecated_NvmBlock_TrqCmdScl_TorqueCmdSF_Uls_f32.EraseBlock
      OIT_EraseBlock_PS_NVM_BLOCK_CMS_ECUHWPN_EraseBlock: start-on-event=EraseBlock, operation=PS_NVM_BLOCK_CMS_ECUHWPN.EraseBlock
      OIT_EraseBlock_PS_NVM_BLOCK_CMS_ECUSRLNUM_EraseBlock: start-on-event=EraseBlock, operation=PS_NVM_BLOCK_CMS_ECUSRLNUM.EraseBlock
      OIT_EraseBlock_PS_NVM_BLOCK_CMS_EPSSRLNUM_EraseBlock: start-on-event=EraseBlock, operation=PS_NVM_BLOCK_CMS_EPSSRLNUM.EraseBlock
      OIT_EraseBlock_PS_NVM_BLOCK_CMS_IGNCNTR_EraseBlock: start-on-event=EraseBlock, operation=PS_NVM_BLOCK_CMS_IGNCNTR.EraseBlock
      OIT_EraseBlock_PS_NVM_BLOCK_CMS_NXTRMANUFSCRATCHPAD_EraseBlock: start-on-event=EraseBlock, operation=PS_NVM_BLOCK_CMS_NXTRMANUFSCRATCHPAD.EraseBlock
      OIT_EraseBlock_PS_NVM_BLOCK_CMS_NXTRMEC_EraseBlock: start-on-event=EraseBlock, operation=PS_NVM_BLOCK_CMS_NXTRMEC.EraseBlock
      OIT_EraseBlock_PS_NVM_BLOCK_DIAGMGR_BLACKBOX_EraseBlock: start-on-event=EraseBlock, operation=PS_NVM_BLOCK_DIAGMGR_BLACKBOX.EraseBlock
      OIT_EraseBlock_PS_NVM_BLOCK_DIAGMGR_LATCHCNTRS_EraseBlock: start-on-event=EraseBlock, operation=PS_NVM_BLOCK_DIAGMGR_LATCHCNTRS.EraseBlock
      OIT_EraseBlock_PS_NVM_BLOCK_DIAGMGR_NTCSTRG_EraseBlock: start-on-event=EraseBlock, operation=PS_NVM_BLOCK_DIAGMGR_NTCSTRG.EraseBlock
      OIT_EraseBlock_PS_NVM_BLOCK_EPSDEFEATS_EraseBlock: start-on-event=EraseBlock, operation=PS_NVM_BLOCK_EPSDEFEATS.EraseBlock
      OIT_EraseBlock_PS_Rte_NvmBlock_AbsHwPos_EOLVehCntrOffset_EraseBlock: start-on-event=EraseBlock, operation=PS_Rte_NvmBlock_AbsHwPos_EOLVehCntrOffset.EraseBlock
      OIT_EraseBlock_PS_Rte_NvmBlock_AstLmt_SteerAsstDefeat_EraseBlock: start-on-event=EraseBlock, operation=PS_Rte_NvmBlock_AstLmt_SteerAsstDefeat.EraseBlock
      OIT_EraseBlock_PS_Rte_NvmBlock_AvgFricLrn_AvgFricLrnData_EraseBlock: start-on-event=EraseBlock, operation=PS_Rte_NvmBlock_AvgFricLrn_AvgFricLrnData.EraseBlock
      OIT_EraseBlock_PS_Rte_NvmBlock_BatteryVoltage_OvervoltageData_EraseBlock: start-on-event=EraseBlock, operation=PS_Rte_NvmBlock_BatteryVoltage_OvervoltageData.EraseBlock
      OIT_EraseBlock_PS_Rte_NvmBlock_CmMtrCurr_CurrTempOffset_EraseBlock: start-on-event=EraseBlock, operation=PS_Rte_NvmBlock_CmMtrCurr_CurrTempOffset.EraseBlock
      OIT_EraseBlock_PS_Rte_NvmBlock_CmMtrCurr_ShCurrCal_EraseBlock: start-on-event=EraseBlock, operation=PS_Rte_NvmBlock_CmMtrCurr_ShCurrCal.EraseBlock
      OIT_EraseBlock_PS_Rte_NvmBlock_CurrParamComp_EOLNomMtrParam_EraseBlock: start-on-event=EraseBlock, operation=PS_Rte_NvmBlock_CurrParamComp_EOLNomMtrParam.EraseBlock
      OIT_EraseBlock_PS_Rte_NvmBlock_DiagSvc_SparePartNumberData_EraseBlock: start-on-event=EraseBlock, operation=PS_Rte_NvmBlock_DiagSvc_SparePartNumberData.EraseBlock
      OIT_EraseBlock_PS_Rte_NvmBlock_DiagSvc_SupplierIdentifierData_EraseBlock: start-on-event=EraseBlock, operation=PS_Rte_NvmBlock_DiagSvc_SupplierIdentifierData.EraseBlock
      OIT_EraseBlock_PS_Rte_NvmBlock_DiagSvc_TuningSetSelectData_EraseBlock: start-on-event=EraseBlock, operation=PS_Rte_NvmBlock_DiagSvc_TuningSetSelectData.EraseBlock
      OIT_EraseBlock_PS_Rte_NvmBlock_DigHwTrqSENT_DigTrqTrim_EraseBlock: start-on-event=EraseBlock, operation=PS_Rte_NvmBlock_DigHwTrqSENT_DigTrqTrim.EraseBlock
      OIT_EraseBlock_PS_Rte_NvmBlock_DigMSB_DigMSBEOLData_EraseBlock: start-on-event=EraseBlock, operation=PS_Rte_NvmBlock_DigMSB_DigMSBEOLData.EraseBlock
      OIT_EraseBlock_PS_Rte_NvmBlock_LrnEOT_LearnedEOT_EraseBlock: start-on-event=EraseBlock, operation=PS_Rte_NvmBlock_LrnEOT_LearnedEOT.EraseBlock
      OIT_EraseBlock_PS_Rte_NvmBlock_Polarity_Polarity_Cnt_Str_EraseBlock: start-on-event=EraseBlock, operation=PS_Rte_NvmBlock_Polarity_Polarity_Cnt_Str.EraseBlock
      OIT_EraseBlock_PS_Rte_NvmBlock_StaMd_CloseCheckData_EraseBlock: start-on-event=EraseBlock, operation=PS_Rte_NvmBlock_StaMd_CloseCheckData.EraseBlock
      OIT_EraseBlock_PS_Rte_NvmBlock_StaMd_TypeHRamBuffer_EraseBlock: start-on-event=EraseBlock, operation=PS_Rte_NvmBlock_StaMd_TypeHRamBuffer.EraseBlock
      OIT_EraseBlock_PS_Rte_NvmBlock_ThrmlDutyCycle_ThrmlDutyCycle_FltStVal_EraseBlock: start-on-event=EraseBlock, operation=PS_Rte_NvmBlock_ThrmlDutyCycle_ThrmlDutyCycle_FltStVal.EraseBlock
      OIT_EraseBlock_PS_Rte_NvmBlock_TrqCanc_CogTrqCal_EraseBlock: start-on-event=EraseBlock, operation=PS_Rte_NvmBlock_TrqCanc_CogTrqCal.EraseBlock
      OIT_EraseBlock_PS_Rte_NvmBlock_TrqCanc_CogTrqRplComp_EraseBlock: start-on-event=EraseBlock, operation=PS_Rte_NvmBlock_TrqCanc_CogTrqRplComp.EraseBlock
      OIT_EraseBlock_PS_Rte_NvmBlock_TrqCmdScl_TorqueCmdSF_Uls_f32_EraseBlock: start-on-event=EraseBlock, operation=PS_Rte_NvmBlock_TrqCmdScl_TorqueCmdSF_Uls_f32.EraseBlock
      OIT_EraseBlock_PS_Rte_NvmBlock_VehDyn_MotPosReset_EraseBlock: start-on-event=EraseBlock, operation=PS_Rte_NvmBlock_VehDyn_MotPosReset.EraseBlock
      OIT_GetErrorStatus_PS_ConfigBlock_GetErrorStatus: start-on-event=GetErrorStatus, operation=PS_ConfigBlock.GetErrorStatus
      OIT_GetErrorStatus_PS_Deprecated_NVM_BLOCK_DEM_GetErrorStatus: start-on-event=GetErrorStatus, operation=PS_Deprecated_NVM_BLOCK_DEM.GetErrorStatus
      OIT_GetErrorStatus_PS_Deprecated_NvmBlock_AbsHwPos_EOLVehCntrOffset_GetErrorStatus: start-on-event=GetErrorStatus, operation=PS_Deprecated_NvmBlock_AbsHwPos_EOLVehCntrOffset.GetErrorStatus
      OIT_GetErrorStatus_PS_Deprecated_NvmBlock_AbsHwPos_EOLVehCntrOffset1_GetErrorStatus: start-on-event=GetErrorStatus, operation=PS_Deprecated_NvmBlock_AbsHwPos_EOLVehCntrOffset1.GetErrorStatus
      OIT_GetErrorStatus_PS_Deprecated_NvmBlock_AstLmt_SteerAsstDefeat_GetErrorStatus: start-on-event=GetErrorStatus, operation=PS_Deprecated_NvmBlock_AstLmt_SteerAsstDefeat.GetErrorStatus
      OIT_GetErrorStatus_PS_Deprecated_NvmBlock_AvgFricLrn_AvgFricLrnData_GetErrorStatus: start-on-event=GetErrorStatus, operation=PS_Deprecated_NvmBlock_AvgFricLrn_AvgFricLrnData.GetErrorStatus
      OIT_GetErrorStatus_PS_Deprecated_NvmBlock_CmMtrCurr_CurrTempOffset_GetErrorStatus: start-on-event=GetErrorStatus, operation=PS_Deprecated_NvmBlock_CmMtrCurr_CurrTempOffset.GetErrorStatus
      OIT_GetErrorStatus_PS_Deprecated_NvmBlock_CmMtrCurr_ShCurrCal_GetErrorStatus: start-on-event=GetErrorStatus, operation=PS_Deprecated_NvmBlock_CmMtrCurr_ShCurrCal.GetErrorStatus
      OIT_GetErrorStatus_PS_Deprecated_NvmBlock_DigHwTrqSENT_DigTrqTrim_GetErrorStatus: start-on-event=GetErrorStatus, operation=PS_Deprecated_NvmBlock_DigHwTrqSENT_DigTrqTrim.GetErrorStatus
      OIT_GetErrorStatus_PS_Deprecated_NvmBlock_LrnEOT_LearnedEOT_GetErrorStatus: start-on-event=GetErrorStatus, operation=PS_Deprecated_NvmBlock_LrnEOT_LearnedEOT.GetErrorStatus
      OIT_GetErrorStatus_PS_Deprecated_NvmBlock_TrqCanc_CogTrqCal_GetErrorStatus: start-on-event=GetErrorStatus, operation=PS_Deprecated_NvmBlock_TrqCanc_CogTrqCal.GetErrorStatus
      OIT_GetErrorStatus_PS_Deprecated_NvmBlock_TrqCanc_CogTrqRplComp_GetErrorStatus: start-on-event=GetErrorStatus, operation=PS_Deprecated_NvmBlock_TrqCanc_CogTrqRplComp.GetErrorStatus
      OIT_GetErrorStatus_PS_Deprecated_NvmBlock_TrqCmdScl_TorqueCmdSF_Uls_f32_GetErrorStatus: start-on-event=GetErrorStatus, operation=PS_Deprecated_NvmBlock_TrqCmdScl_TorqueCmdSF_Uls_f32.GetErrorStatus
      OIT_GetErrorStatus_PS_NVM_BLOCK_CMS_ECUHWPN_GetErrorStatus: start-on-event=GetErrorStatus, operation=PS_NVM_BLOCK_CMS_ECUHWPN.GetErrorStatus
      OIT_GetErrorStatus_PS_NVM_BLOCK_CMS_ECUSRLNUM_GetErrorStatus: start-on-event=GetErrorStatus, operation=PS_NVM_BLOCK_CMS_ECUSRLNUM.GetErrorStatus
      OIT_GetErrorStatus_PS_NVM_BLOCK_CMS_EPSSRLNUM_GetErrorStatus: start-on-event=GetErrorStatus, operation=PS_NVM_BLOCK_CMS_EPSSRLNUM.GetErrorStatus
      OIT_GetErrorStatus_PS_NVM_BLOCK_CMS_IGNCNTR_GetErrorStatus: start-on-event=GetErrorStatus, operation=PS_NVM_BLOCK_CMS_IGNCNTR.GetErrorStatus
      OIT_GetErrorStatus_PS_NVM_BLOCK_CMS_NXTRMANUFSCRATCHPAD_GetErrorStatus: start-on-event=GetErrorStatus, operation=PS_NVM_BLOCK_CMS_NXTRMANUFSCRATCHPAD.GetErrorStatus
      OIT_GetErrorStatus_PS_NVM_BLOCK_CMS_NXTRMEC_GetErrorStatus: start-on-event=GetErrorStatus, operation=PS_NVM_BLOCK_CMS_NXTRMEC.GetErrorStatus
      OIT_GetErrorStatus_PS_NVM_BLOCK_DIAGMGR_BLACKBOX_GetErrorStatus: start-on-event=GetErrorStatus, operation=PS_NVM_BLOCK_DIAGMGR_BLACKBOX.GetErrorStatus
      OIT_GetErrorStatus_PS_NVM_BLOCK_DIAGMGR_LATCHCNTRS_GetErrorStatus: start-on-event=GetErrorStatus, operation=PS_NVM_BLOCK_DIAGMGR_LATCHCNTRS.GetErrorStatus
      OIT_GetErrorStatus_PS_NVM_BLOCK_DIAGMGR_NTCSTRG_GetErrorStatus: start-on-event=GetErrorStatus, operation=PS_NVM_BLOCK_DIAGMGR_NTCSTRG.GetErrorStatus
      OIT_GetErrorStatus_PS_NVM_BLOCK_EPSDEFEATS_GetErrorStatus: start-on-event=GetErrorStatus, operation=PS_NVM_BLOCK_EPSDEFEATS.GetErrorStatus
      OIT_GetErrorStatus_PS_Rte_NvmBlock_AbsHwPos_EOLVehCntrOffset_GetErrorStatus: start-on-event=GetErrorStatus, operation=PS_Rte_NvmBlock_AbsHwPos_EOLVehCntrOffset.GetErrorStatus
      OIT_GetErrorStatus_PS_Rte_NvmBlock_AstLmt_SteerAsstDefeat_GetErrorStatus: start-on-event=GetErrorStatus, operation=PS_Rte_NvmBlock_AstLmt_SteerAsstDefeat.GetErrorStatus
      OIT_GetErrorStatus_PS_Rte_NvmBlock_AvgFricLrn_AvgFricLrnData_GetErrorStatus: start-on-event=GetErrorStatus, operation=PS_Rte_NvmBlock_AvgFricLrn_AvgFricLrnData.GetErrorStatus
      OIT_GetErrorStatus_PS_Rte_NvmBlock_BatteryVoltage_OvervoltageData_GetErrorStatus: start-on-event=GetErrorStatus, operation=PS_Rte_NvmBlock_BatteryVoltage_OvervoltageData.GetErrorStatus
      OIT_GetErrorStatus_PS_Rte_NvmBlock_CmMtrCurr_CurrTempOffset_GetErrorStatus: start-on-event=GetErrorStatus, operation=PS_Rte_NvmBlock_CmMtrCurr_CurrTempOffset.GetErrorStatus
      OIT_GetErrorStatus_PS_Rte_NvmBlock_CmMtrCurr_ShCurrCal_GetErrorStatus: start-on-event=GetErrorStatus, operation=PS_Rte_NvmBlock_CmMtrCurr_ShCurrCal.GetErrorStatus
      OIT_GetErrorStatus_PS_Rte_NvmBlock_CurrParamComp_EOLNomMtrParam_GetErrorStatus: start-on-event=GetErrorStatus, operation=PS_Rte_NvmBlock_CurrParamComp_EOLNomMtrParam.GetErrorStatus
      OIT_GetErrorStatus_PS_Rte_NvmBlock_DiagSvc_SparePartNumberData_GetErrorStatus: start-on-event=GetErrorStatus, operation=PS_Rte_NvmBlock_DiagSvc_SparePartNumberData.GetErrorStatus
      OIT_GetErrorStatus_PS_Rte_NvmBlock_DiagSvc_SupplierIdentifierData_GetErrorStatus: start-on-event=GetErrorStatus, operation=PS_Rte_NvmBlock_DiagSvc_SupplierIdentifierData.GetErrorStatus
      OIT_GetErrorStatus_PS_Rte_NvmBlock_DiagSvc_TuningSetSelectData_GetErrorStatus: start-on-event=GetErrorStatus, operation=PS_Rte_NvmBlock_DiagSvc_TuningSetSelectData.GetErrorStatus
      OIT_GetErrorStatus_PS_Rte_NvmBlock_DigHwTrqSENT_DigTrqTrim_GetErrorStatus: start-on-event=GetErrorStatus, operation=PS_Rte_NvmBlock_DigHwTrqSENT_DigTrqTrim.GetErrorStatus
      OIT_GetErrorStatus_PS_Rte_NvmBlock_DigMSB_DigMSBEOLData_GetErrorStatus: start-on-event=GetErrorStatus, operation=PS_Rte_NvmBlock_DigMSB_DigMSBEOLData.GetErrorStatus
      OIT_GetErrorStatus_PS_Rte_NvmBlock_LrnEOT_LearnedEOT_GetErrorStatus: start-on-event=GetErrorStatus, operation=PS_Rte_NvmBlock_LrnEOT_LearnedEOT.GetErrorStatus
      OIT_GetErrorStatus_PS_Rte_NvmBlock_Polarity_Polarity_Cnt_Str_GetErrorStatus: start-on-event=GetErrorStatus, operation=PS_Rte_NvmBlock_Polarity_Polarity_Cnt_Str.GetErrorStatus
      OIT_GetErrorStatus_PS_Rte_NvmBlock_StaMd_CloseCheckData_GetErrorStatus: start-on-event=GetErrorStatus, operation=PS_Rte_NvmBlock_StaMd_CloseCheckData.GetErrorStatus
      OIT_GetErrorStatus_PS_Rte_NvmBlock_StaMd_TypeHRamBuffer_GetErrorStatus: start-on-event=GetErrorStatus, operation=PS_Rte_NvmBlock_StaMd_TypeHRamBuffer.GetErrorStatus
      OIT_GetErrorStatus_PS_Rte_NvmBlock_ThrmlDutyCycle_ThrmlDutyCycle_FltStVal_GetErrorStatus: start-on-event=GetErrorStatus, operation=PS_Rte_NvmBlock_ThrmlDutyCycle_ThrmlDutyCycle_FltStVal.GetErrorStatus
      OIT_GetErrorStatus_PS_Rte_NvmBlock_TrqCanc_CogTrqCal_GetErrorStatus: start-on-event=GetErrorStatus, operation=PS_Rte_NvmBlock_TrqCanc_CogTrqCal.GetErrorStatus
      OIT_GetErrorStatus_PS_Rte_NvmBlock_TrqCanc_CogTrqRplComp_GetErrorStatus: start-on-event=GetErrorStatus, operation=PS_Rte_NvmBlock_TrqCanc_CogTrqRplComp.GetErrorStatus
      OIT_GetErrorStatus_PS_Rte_NvmBlock_TrqCmdScl_TorqueCmdSF_Uls_f32_GetErrorStatus: start-on-event=GetErrorStatus, operation=PS_Rte_NvmBlock_TrqCmdScl_TorqueCmdSF_Uls_f32.GetErrorStatus
      OIT_GetErrorStatus_PS_Rte_NvmBlock_VehDyn_MotPosReset_GetErrorStatus: start-on-event=GetErrorStatus, operation=PS_Rte_NvmBlock_VehDyn_MotPosReset.GetErrorStatus
      OIT_InvalidateNvBlock_PS_ConfigBlock_InvalidateNvBlock: start-on-event=InvalidateNvBlock, operation=PS_ConfigBlock.InvalidateNvBlock
      OIT_InvalidateNvBlock_PS_Deprecated_NVM_BLOCK_DEM_InvalidateNvBlock: start-on-event=InvalidateNvBlock, operation=PS_Deprecated_NVM_BLOCK_DEM.InvalidateNvBlock
      OIT_InvalidateNvBlock_PS_Deprecated_NvmBlock_AbsHwPos_EOLVehCntrOffset_InvalidateNvBlock: start-on-event=InvalidateNvBlock, operation=PS_Deprecated_NvmBlock_AbsHwPos_EOLVehCntrOffset.InvalidateNvBlock
      OIT_InvalidateNvBlock_PS_Deprecated_NvmBlock_AbsHwPos_EOLVehCntrOffset1_InvalidateNvBlock: start-on-event=InvalidateNvBlock, operation=PS_Deprecated_NvmBlock_AbsHwPos_EOLVehCntrOffset1.InvalidateNvBlock
      OIT_InvalidateNvBlock_PS_Deprecated_NvmBlock_AstLmt_SteerAsstDefeat_InvalidateNvBlock: start-on-event=InvalidateNvBlock, operation=PS_Deprecated_NvmBlock_AstLmt_SteerAsstDefeat.InvalidateNvBlock
      OIT_InvalidateNvBlock_PS_Deprecated_NvmBlock_AvgFricLrn_AvgFricLrnData_InvalidateNvBlock: start-on-event=InvalidateNvBlock, operation=PS_Deprecated_NvmBlock_AvgFricLrn_AvgFricLrnData.InvalidateNvBlock
      OIT_InvalidateNvBlock_PS_Deprecated_NvmBlock_CmMtrCurr_CurrTempOffset_InvalidateNvBlock: start-on-event=InvalidateNvBlock, operation=PS_Deprecated_NvmBlock_CmMtrCurr_CurrTempOffset.InvalidateNvBlock
      OIT_InvalidateNvBlock_PS_Deprecated_NvmBlock_CmMtrCurr_ShCurrCal_InvalidateNvBlock: start-on-event=InvalidateNvBlock, operation=PS_Deprecated_NvmBlock_CmMtrCurr_ShCurrCal.InvalidateNvBlock
      OIT_InvalidateNvBlock_PS_Deprecated_NvmBlock_DigHwTrqSENT_DigTrqTrim_InvalidateNvBlock: start-on-event=InvalidateNvBlock, operation=PS_Deprecated_NvmBlock_DigHwTrqSENT_DigTrqTrim.InvalidateNvBlock
      OIT_InvalidateNvBlock_PS_Deprecated_NvmBlock_LrnEOT_LearnedEOT_InvalidateNvBlock: start-on-event=InvalidateNvBlock, operation=PS_Deprecated_NvmBlock_LrnEOT_LearnedEOT.InvalidateNvBlock
      OIT_InvalidateNvBlock_PS_Deprecated_NvmBlock_TrqCanc_CogTrqCal_InvalidateNvBlock: start-on-event=InvalidateNvBlock, operation=PS_Deprecated_NvmBlock_TrqCanc_CogTrqCal.InvalidateNvBlock
      OIT_InvalidateNvBlock_PS_Deprecated_NvmBlock_TrqCanc_CogTrqRplComp_InvalidateNvBlock: start-on-event=InvalidateNvBlock, operation=PS_Deprecated_NvmBlock_TrqCanc_CogTrqRplComp.InvalidateNvBlock
      OIT_InvalidateNvBlock_PS_Deprecated_NvmBlock_TrqCmdScl_TorqueCmdSF_Uls_f32_InvalidateNvBlock: start-on-event=InvalidateNvBlock, operation=PS_Deprecated_NvmBlock_TrqCmdScl_TorqueCmdSF_Uls_f32.InvalidateNvBlock
      OIT_InvalidateNvBlock_PS_NVM_BLOCK_CMS_ECUHWPN_InvalidateNvBlock: start-on-event=InvalidateNvBlock, operation=PS_NVM_BLOCK_CMS_ECUHWPN.InvalidateNvBlock
      OIT_InvalidateNvBlock_PS_NVM_BLOCK_CMS_ECUSRLNUM_InvalidateNvBlock: start-on-event=InvalidateNvBlock, operation=PS_NVM_BLOCK_CMS_ECUSRLNUM.InvalidateNvBlock
      OIT_InvalidateNvBlock_PS_NVM_BLOCK_CMS_EPSSRLNUM_InvalidateNvBlock: start-on-event=InvalidateNvBlock, operation=PS_NVM_BLOCK_CMS_EPSSRLNUM.InvalidateNvBlock
      OIT_InvalidateNvBlock_PS_NVM_BLOCK_CMS_IGNCNTR_InvalidateNvBlock: start-on-event=InvalidateNvBlock, operation=PS_NVM_BLOCK_CMS_IGNCNTR.InvalidateNvBlock
      OIT_InvalidateNvBlock_PS_NVM_BLOCK_CMS_NXTRMANUFSCRATCHPAD_InvalidateNvBlock: start-on-event=InvalidateNvBlock, operation=PS_NVM_BLOCK_CMS_NXTRMANUFSCRATCHPAD.InvalidateNvBlock
      OIT_InvalidateNvBlock_PS_NVM_BLOCK_CMS_NXTRMEC_InvalidateNvBlock: start-on-event=InvalidateNvBlock, operation=PS_NVM_BLOCK_CMS_NXTRMEC.InvalidateNvBlock
      OIT_InvalidateNvBlock_PS_NVM_BLOCK_DIAGMGR_BLACKBOX_InvalidateNvBlock: start-on-event=InvalidateNvBlock, operation=PS_NVM_BLOCK_DIAGMGR_BLACKBOX.InvalidateNvBlock
      OIT_InvalidateNvBlock_PS_NVM_BLOCK_DIAGMGR_LATCHCNTRS_InvalidateNvBlock: start-on-event=InvalidateNvBlock, operation=PS_NVM_BLOCK_DIAGMGR_LATCHCNTRS.InvalidateNvBlock
      OIT_InvalidateNvBlock_PS_NVM_BLOCK_DIAGMGR_NTCSTRG_InvalidateNvBlock: start-on-event=InvalidateNvBlock, operation=PS_NVM_BLOCK_DIAGMGR_NTCSTRG.InvalidateNvBlock
      OIT_InvalidateNvBlock_PS_NVM_BLOCK_EPSDEFEATS_InvalidateNvBlock: start-on-event=InvalidateNvBlock, operation=PS_NVM_BLOCK_EPSDEFEATS.InvalidateNvBlock
      OIT_InvalidateNvBlock_PS_Rte_NvmBlock_AbsHwPos_EOLVehCntrOffset_InvalidateNvBlock: start-on-event=InvalidateNvBlock, operation=PS_Rte_NvmBlock_AbsHwPos_EOLVehCntrOffset.InvalidateNvBlock
      OIT_InvalidateNvBlock_PS_Rte_NvmBlock_AstLmt_SteerAsstDefeat_InvalidateNvBlock: start-on-event=InvalidateNvBlock, operation=PS_Rte_NvmBlock_AstLmt_SteerAsstDefeat.InvalidateNvBlock
      OIT_InvalidateNvBlock_PS_Rte_NvmBlock_AvgFricLrn_AvgFricLrnData_InvalidateNvBlock: start-on-event=InvalidateNvBlock, operation=PS_Rte_NvmBlock_AvgFricLrn_AvgFricLrnData.InvalidateNvBlock
      OIT_InvalidateNvBlock_PS_Rte_NvmBlock_BatteryVoltage_OvervoltageData_InvalidateNvBlock: start-on-event=InvalidateNvBlock, operation=PS_Rte_NvmBlock_BatteryVoltage_OvervoltageData.InvalidateNvBlock
      OIT_InvalidateNvBlock_PS_Rte_NvmBlock_CmMtrCurr_CurrTempOffset_InvalidateNvBlock: start-on-event=InvalidateNvBlock, operation=PS_Rte_NvmBlock_CmMtrCurr_CurrTempOffset.InvalidateNvBlock
      OIT_InvalidateNvBlock_PS_Rte_NvmBlock_CmMtrCurr_ShCurrCal_InvalidateNvBlock: start-on-event=InvalidateNvBlock, operation=PS_Rte_NvmBlock_CmMtrCurr_ShCurrCal.InvalidateNvBlock
      OIT_InvalidateNvBlock_PS_Rte_NvmBlock_CurrParamComp_EOLNomMtrParam_InvalidateNvBlock: start-on-event=InvalidateNvBlock, operation=PS_Rte_NvmBlock_CurrParamComp_EOLNomMtrParam.InvalidateNvBlock
      OIT_InvalidateNvBlock_PS_Rte_NvmBlock_DiagSvc_SparePartNumberData_InvalidateNvBlock: start-on-event=InvalidateNvBlock, operation=PS_Rte_NvmBlock_DiagSvc_SparePartNumberData.InvalidateNvBlock
      OIT_InvalidateNvBlock_PS_Rte_NvmBlock_DiagSvc_SupplierIdentifierData_InvalidateNvBlock: start-on-event=InvalidateNvBlock, operation=PS_Rte_NvmBlock_DiagSvc_SupplierIdentifierData.InvalidateNvBlock
      OIT_InvalidateNvBlock_PS_Rte_NvmBlock_DiagSvc_TuningSetSelectData_InvalidateNvBlock: start-on-event=InvalidateNvBlock, operation=PS_Rte_NvmBlock_DiagSvc_TuningSetSelectData.InvalidateNvBlock
      OIT_InvalidateNvBlock_PS_Rte_NvmBlock_DigHwTrqSENT_DigTrqTrim_InvalidateNvBlock: start-on-event=InvalidateNvBlock, operation=PS_Rte_NvmBlock_DigHwTrqSENT_DigTrqTrim.InvalidateNvBlock
      OIT_InvalidateNvBlock_PS_Rte_NvmBlock_DigMSB_DigMSBEOLData_InvalidateNvBlock: start-on-event=InvalidateNvBlock, operation=PS_Rte_NvmBlock_DigMSB_DigMSBEOLData.InvalidateNvBlock
      OIT_InvalidateNvBlock_PS_Rte_NvmBlock_LrnEOT_LearnedEOT_InvalidateNvBlock: start-on-event=InvalidateNvBlock, operation=PS_Rte_NvmBlock_LrnEOT_LearnedEOT.InvalidateNvBlock
      OIT_InvalidateNvBlock_PS_Rte_NvmBlock_Polarity_Polarity_Cnt_Str_InvalidateNvBlock: start-on-event=InvalidateNvBlock, operation=PS_Rte_NvmBlock_Polarity_Polarity_Cnt_Str.InvalidateNvBlock
      OIT_InvalidateNvBlock_PS_Rte_NvmBlock_StaMd_CloseCheckData_InvalidateNvBlock: start-on-event=InvalidateNvBlock, operation=PS_Rte_NvmBlock_StaMd_CloseCheckData.InvalidateNvBlock
      OIT_InvalidateNvBlock_PS_Rte_NvmBlock_StaMd_TypeHRamBuffer_InvalidateNvBlock: start-on-event=InvalidateNvBlock, operation=PS_Rte_NvmBlock_StaMd_TypeHRamBuffer.InvalidateNvBlock
      OIT_InvalidateNvBlock_PS_Rte_NvmBlock_ThrmlDutyCycle_ThrmlDutyCycle_FltStVal_InvalidateNvBlock: start-on-event=InvalidateNvBlock, operation=PS_Rte_NvmBlock_ThrmlDutyCycle_ThrmlDutyCycle_FltStVal.InvalidateNvBlock
      OIT_InvalidateNvBlock_PS_Rte_NvmBlock_TrqCanc_CogTrqCal_InvalidateNvBlock: start-on-event=InvalidateNvBlock, operation=PS_Rte_NvmBlock_TrqCanc_CogTrqCal.InvalidateNvBlock
      OIT_InvalidateNvBlock_PS_Rte_NvmBlock_TrqCanc_CogTrqRplComp_InvalidateNvBlock: start-on-event=InvalidateNvBlock, operation=PS_Rte_NvmBlock_TrqCanc_CogTrqRplComp.InvalidateNvBlock
      OIT_InvalidateNvBlock_PS_Rte_NvmBlock_TrqCmdScl_TorqueCmdSF_Uls_f32_InvalidateNvBlock: start-on-event=InvalidateNvBlock, operation=PS_Rte_NvmBlock_TrqCmdScl_TorqueCmdSF_Uls_f32.InvalidateNvBlock
      OIT_InvalidateNvBlock_PS_Rte_NvmBlock_VehDyn_MotPosReset_InvalidateNvBlock: start-on-event=InvalidateNvBlock, operation=PS_Rte_NvmBlock_VehDyn_MotPosReset.InvalidateNvBlock
    timing event TMT_NvM_MainFunction: start-on-event=NvM_MainFunction, period=0.01
    178 x operation invoked event:
      OIT_ReadBlock_PS_ConfigBlock_ReadBlock: start-on-event=ReadBlock, operation=PS_ConfigBlock.ReadBlock
      OIT_ReadBlock_PS_Deprecated_NVM_BLOCK_DEM_ReadBlock: start-on-event=ReadBlock, operation=PS_Deprecated_NVM_BLOCK_DEM.ReadBlock
      OIT_ReadBlock_PS_Deprecated_NvmBlock_AbsHwPos_EOLVehCntrOffset_ReadBlock: start-on-event=ReadBlock, operation=PS_Deprecated_NvmBlock_AbsHwPos_EOLVehCntrOffset.ReadBlock
      OIT_ReadBlock_PS_Deprecated_NvmBlock_AbsHwPos_EOLVehCntrOffset1_ReadBlock: start-on-event=ReadBlock, operation=PS_Deprecated_NvmBlock_AbsHwPos_EOLVehCntrOffset1.ReadBlock
      OIT_ReadBlock_PS_Deprecated_NvmBlock_AstLmt_SteerAsstDefeat_ReadBlock: start-on-event=ReadBlock, operation=PS_Deprecated_NvmBlock_AstLmt_SteerAsstDefeat.ReadBlock
      OIT_ReadBlock_PS_Deprecated_NvmBlock_AvgFricLrn_AvgFricLrnData_ReadBlock: start-on-event=ReadBlock, operation=PS_Deprecated_NvmBlock_AvgFricLrn_AvgFricLrnData.ReadBlock
      OIT_ReadBlock_PS_Deprecated_NvmBlock_CmMtrCurr_CurrTempOffset_ReadBlock: start-on-event=ReadBlock, operation=PS_Deprecated_NvmBlock_CmMtrCurr_CurrTempOffset.ReadBlock
      OIT_ReadBlock_PS_Deprecated_NvmBlock_CmMtrCurr_ShCurrCal_ReadBlock: start-on-event=ReadBlock, operation=PS_Deprecated_NvmBlock_CmMtrCurr_ShCurrCal.ReadBlock
      OIT_ReadBlock_PS_Deprecated_NvmBlock_DigHwTrqSENT_DigTrqTrim_ReadBlock: start-on-event=ReadBlock, operation=PS_Deprecated_NvmBlock_DigHwTrqSENT_DigTrqTrim.ReadBlock
      OIT_ReadBlock_PS_Deprecated_NvmBlock_LrnEOT_LearnedEOT_ReadBlock: start-on-event=ReadBlock, operation=PS_Deprecated_NvmBlock_LrnEOT_LearnedEOT.ReadBlock
      OIT_ReadBlock_PS_Deprecated_NvmBlock_TrqCanc_CogTrqCal_ReadBlock: start-on-event=ReadBlock, operation=PS_Deprecated_NvmBlock_TrqCanc_CogTrqCal.ReadBlock
      OIT_ReadBlock_PS_Deprecated_NvmBlock_TrqCanc_CogTrqRplComp_ReadBlock: start-on-event=ReadBlock, operation=PS_Deprecated_NvmBlock_TrqCanc_CogTrqRplComp.ReadBlock
      OIT_ReadBlock_PS_Deprecated_NvmBlock_TrqCmdScl_TorqueCmdSF_Uls_f32_ReadBlock: start-on-event=ReadBlock, operation=PS_Deprecated_NvmBlock_TrqCmdScl_TorqueCmdSF_Uls_f32.ReadBlock
      OIT_ReadBlock_PS_NVM_BLOCK_CMS_ECUHWPN_ReadBlock: start-on-event=ReadBlock, operation=PS_NVM_BLOCK_CMS_ECUHWPN.ReadBlock
      OIT_ReadBlock_PS_NVM_BLOCK_CMS_ECUSRLNUM_ReadBlock: start-on-event=ReadBlock, operation=PS_NVM_BLOCK_CMS_ECUSRLNUM.ReadBlock
      OIT_ReadBlock_PS_NVM_BLOCK_CMS_EPSSRLNUM_ReadBlock: start-on-event=ReadBlock, operation=PS_NVM_BLOCK_CMS_EPSSRLNUM.ReadBlock
      OIT_ReadBlock_PS_NVM_BLOCK_CMS_IGNCNTR_ReadBlock: start-on-event=ReadBlock, operation=PS_NVM_BLOCK_CMS_IGNCNTR.ReadBlock
      OIT_ReadBlock_PS_NVM_BLOCK_CMS_NXTRMANUFSCRATCHPAD_ReadBlock: start-on-event=ReadBlock, operation=PS_NVM_BLOCK_CMS_NXTRMANUFSCRATCHPAD.ReadBlock
      OIT_ReadBlock_PS_NVM_BLOCK_CMS_NXTRMEC_ReadBlock: start-on-event=ReadBlock, operation=PS_NVM_BLOCK_CMS_NXTRMEC.ReadBlock
      OIT_ReadBlock_PS_NVM_BLOCK_DIAGMGR_BLACKBOX_ReadBlock: start-on-event=ReadBlock, operation=PS_NVM_BLOCK_DIAGMGR_BLACKBOX.ReadBlock
      OIT_ReadBlock_PS_NVM_BLOCK_DIAGMGR_LATCHCNTRS_ReadBlock: start-on-event=ReadBlock, operation=PS_NVM_BLOCK_DIAGMGR_LATCHCNTRS.ReadBlock
      OIT_ReadBlock_PS_NVM_BLOCK_DIAGMGR_NTCSTRG_ReadBlock: start-on-event=ReadBlock, operation=PS_NVM_BLOCK_DIAGMGR_NTCSTRG.ReadBlock
      OIT_ReadBlock_PS_NVM_BLOCK_EPSDEFEATS_ReadBlock: start-on-event=ReadBlock, operation=PS_NVM_BLOCK_EPSDEFEATS.ReadBlock
      OIT_ReadBlock_PS_Rte_NvmBlock_AbsHwPos_EOLVehCntrOffset_ReadBlock: start-on-event=ReadBlock, operation=PS_Rte_NvmBlock_AbsHwPos_EOLVehCntrOffset.ReadBlock
      OIT_ReadBlock_PS_Rte_NvmBlock_AstLmt_SteerAsstDefeat_ReadBlock: start-on-event=ReadBlock, operation=PS_Rte_NvmBlock_AstLmt_SteerAsstDefeat.ReadBlock
      OIT_ReadBlock_PS_Rte_NvmBlock_AvgFricLrn_AvgFricLrnData_ReadBlock: start-on-event=ReadBlock, operation=PS_Rte_NvmBlock_AvgFricLrn_AvgFricLrnData.ReadBlock
      OIT_ReadBlock_PS_Rte_NvmBlock_BatteryVoltage_OvervoltageData_ReadBlock: start-on-event=ReadBlock, operation=PS_Rte_NvmBlock_BatteryVoltage_OvervoltageData.ReadBlock
      OIT_ReadBlock_PS_Rte_NvmBlock_CmMtrCurr_CurrTempOffset_ReadBlock: start-on-event=ReadBlock, operation=PS_Rte_NvmBlock_CmMtrCurr_CurrTempOffset.ReadBlock
      OIT_ReadBlock_PS_Rte_NvmBlock_CmMtrCurr_ShCurrCal_ReadBlock: start-on-event=ReadBlock, operation=PS_Rte_NvmBlock_CmMtrCurr_ShCurrCal.ReadBlock
      OIT_ReadBlock_PS_Rte_NvmBlock_CurrParamComp_EOLNomMtrParam_ReadBlock: start-on-event=ReadBlock, operation=PS_Rte_NvmBlock_CurrParamComp_EOLNomMtrParam.ReadBlock
      OIT_ReadBlock_PS_Rte_NvmBlock_DiagSvc_SparePartNumberData_ReadBlock: start-on-event=ReadBlock, operation=PS_Rte_NvmBlock_DiagSvc_SparePartNumberData.ReadBlock
      OIT_ReadBlock_PS_Rte_NvmBlock_DiagSvc_SupplierIdentifierData_ReadBlock: start-on-event=ReadBlock, operation=PS_Rte_NvmBlock_DiagSvc_SupplierIdentifierData.ReadBlock
      OIT_ReadBlock_PS_Rte_NvmBlock_DiagSvc_TuningSetSelectData_ReadBlock: start-on-event=ReadBlock, operation=PS_Rte_NvmBlock_DiagSvc_TuningSetSelectData.ReadBlock
      OIT_ReadBlock_PS_Rte_NvmBlock_DigHwTrqSENT_DigTrqTrim_ReadBlock: start-on-event=ReadBlock, operation=PS_Rte_NvmBlock_DigHwTrqSENT_DigTrqTrim.ReadBlock
      OIT_ReadBlock_PS_Rte_NvmBlock_DigMSB_DigMSBEOLData_ReadBlock: start-on-event=ReadBlock, operation=PS_Rte_NvmBlock_DigMSB_DigMSBEOLData.ReadBlock
      OIT_ReadBlock_PS_Rte_NvmBlock_LrnEOT_LearnedEOT_ReadBlock: start-on-event=ReadBlock, operation=PS_Rte_NvmBlock_LrnEOT_LearnedEOT.ReadBlock
      OIT_ReadBlock_PS_Rte_NvmBlock_Polarity_Polarity_Cnt_Str_ReadBlock: start-on-event=ReadBlock, operation=PS_Rte_NvmBlock_Polarity_Polarity_Cnt_Str.ReadBlock
      OIT_ReadBlock_PS_Rte_NvmBlock_StaMd_CloseCheckData_ReadBlock: start-on-event=ReadBlock, operation=PS_Rte_NvmBlock_StaMd_CloseCheckData.ReadBlock
      OIT_ReadBlock_PS_Rte_NvmBlock_StaMd_TypeHRamBuffer_ReadBlock: start-on-event=ReadBlock, operation=PS_Rte_NvmBlock_StaMd_TypeHRamBuffer.ReadBlock
      OIT_ReadBlock_PS_Rte_NvmBlock_ThrmlDutyCycle_ThrmlDutyCycle_FltStVal_ReadBlock: start-on-event=ReadBlock, operation=PS_Rte_NvmBlock_ThrmlDutyCycle_ThrmlDutyCycle_FltStVal.ReadBlock
      OIT_ReadBlock_PS_Rte_NvmBlock_TrqCanc_CogTrqCal_ReadBlock: start-on-event=ReadBlock, operation=PS_Rte_NvmBlock_TrqCanc_CogTrqCal.ReadBlock
      OIT_ReadBlock_PS_Rte_NvmBlock_TrqCanc_CogTrqRplComp_ReadBlock: start-on-event=ReadBlock, operation=PS_Rte_NvmBlock_TrqCanc_CogTrqRplComp.ReadBlock
      OIT_ReadBlock_PS_Rte_NvmBlock_TrqCmdScl_TorqueCmdSF_Uls_f32_ReadBlock: start-on-event=ReadBlock, operation=PS_Rte_NvmBlock_TrqCmdScl_TorqueCmdSF_Uls_f32.ReadBlock
      OIT_ReadBlock_PS_Rte_NvmBlock_VehDyn_MotPosReset_ReadBlock: start-on-event=ReadBlock, operation=PS_Rte_NvmBlock_VehDyn_MotPosReset.ReadBlock
      OIT_RestoreBlockDefaults_PS_Rte_NvmBlock_AvgFricLrn_AvgFricLrnData_RestoreBlockDefaults: start-on-event=RestoreBlockDefaults, operation=PS_Rte_NvmBlock_AvgFricLrn_AvgFricLrnData.RestoreBlockDefaults
      OIT_RestoreBlockDefaults_PS_Rte_NvmBlock_LrnEOT_LearnedEOT_RestoreBlockDefaults: start-on-event=RestoreBlockDefaults, operation=PS_Rte_NvmBlock_LrnEOT_LearnedEOT.RestoreBlockDefaults
      OIT_SetBlockProtection_PAdmin_ConfigBlock_SetBlockProtection: start-on-event=SetBlockProtection, operation=PAdmin_ConfigBlock.SetBlockProtection
      OIT_SetBlockProtection_PAdmin_Deprecated_NVM_BLOCK_DEM_SetBlockProtection: start-on-event=SetBlockProtection, operation=PAdmin_Deprecated_NVM_BLOCK_DEM.SetBlockProtection
      OIT_SetBlockProtection_PAdmin_Deprecated_NvmBlock_AbsHwPos_EOLVehCntrOffset_SetBlockProtection: start-on-event=SetBlockProtection, operation=PAdmin_Deprecated_NvmBlock_AbsHwPos_EOLVehCntrOffset.SetBlockProtection
      OIT_SetBlockProtection_PAdmin_Deprecated_NvmBlock_AbsHwPos_EOLVehCntrOffset1_SetBlockProtection: start-on-event=SetBlockProtection, operation=PAdmin_Deprecated_NvmBlock_AbsHwPos_EOLVehCntrOffset1.SetBlockProtection
      OIT_SetBlockProtection_PAdmin_Deprecated_NvmBlock_AstLmt_SteerAsstDefeat_SetBlockProtection: start-on-event=SetBlockProtection, operation=PAdmin_Deprecated_NvmBlock_AstLmt_SteerAsstDefeat.SetBlockProtection
      OIT_SetBlockProtection_PAdmin_Deprecated_NvmBlock_AvgFricLrn_AvgFricLrnData_SetBlockProtection: start-on-event=SetBlockProtection, operation=PAdmin_Deprecated_NvmBlock_AvgFricLrn_AvgFricLrnData.SetBlockProtection
      OIT_SetBlockProtection_PAdmin_Deprecated_NvmBlock_CmMtrCurr_CurrTempOffset_SetBlockProtection: start-on-event=SetBlockProtection, operation=PAdmin_Deprecated_NvmBlock_CmMtrCurr_CurrTempOffset.SetBlockProtection
      OIT_SetBlockProtection_PAdmin_Deprecated_NvmBlock_CmMtrCurr_ShCurrCal_SetBlockProtection: start-on-event=SetBlockProtection, operation=PAdmin_Deprecated_NvmBlock_CmMtrCurr_ShCurrCal.SetBlockProtection
      OIT_SetBlockProtection_PAdmin_Deprecated_NvmBlock_DigHwTrqSENT_DigTrqTrim_SetBlockProtection: start-on-event=SetBlockProtection, operation=PAdmin_Deprecated_NvmBlock_DigHwTrqSENT_DigTrqTrim.SetBlockProtection
      OIT_SetBlockProtection_PAdmin_Deprecated_NvmBlock_LrnEOT_LearnedEOT_SetBlockProtection: start-on-event=SetBlockProtection, operation=PAdmin_Deprecated_NvmBlock_LrnEOT_LearnedEOT.SetBlockProtection
      OIT_SetBlockProtection_PAdmin_Deprecated_NvmBlock_TrqCanc_CogTrqCal_SetBlockProtection: start-on-event=SetBlockProtection, operation=PAdmin_Deprecated_NvmBlock_TrqCanc_CogTrqCal.SetBlockProtection
      OIT_SetBlockProtection_PAdmin_Deprecated_NvmBlock_TrqCanc_CogTrqRplComp_SetBlockProtection: start-on-event=SetBlockProtection, operation=PAdmin_Deprecated_NvmBlock_TrqCanc_CogTrqRplComp.SetBlockProtection
      OIT_SetBlockProtection_PAdmin_Deprecated_NvmBlock_TrqCmdScl_TorqueCmdSF_Uls_f32_SetBlockProtection: start-on-event=SetBlockProtection, operation=PAdmin_Deprecated_NvmBlock_TrqCmdScl_TorqueCmdSF_Uls_f32.SetBlockProtection
      OIT_SetBlockProtection_PAdmin_NVM_BLOCK_CMS_ECUHWPN_SetBlockProtection: start-on-event=SetBlockProtection, operation=PAdmin_NVM_BLOCK_CMS_ECUHWPN.SetBlockProtection
      OIT_SetBlockProtection_PAdmin_NVM_BLOCK_CMS_ECUSRLNUM_SetBlockProtection: start-on-event=SetBlockProtection, operation=PAdmin_NVM_BLOCK_CMS_ECUSRLNUM.SetBlockProtection
      OIT_SetBlockProtection_PAdmin_NVM_BLOCK_CMS_EPSSRLNUM_SetBlockProtection: start-on-event=SetBlockProtection, operation=PAdmin_NVM_BLOCK_CMS_EPSSRLNUM.SetBlockProtection
      OIT_SetBlockProtection_PAdmin_NVM_BLOCK_CMS_IGNCNTR_SetBlockProtection: start-on-event=SetBlockProtection, operation=PAdmin_NVM_BLOCK_CMS_IGNCNTR.SetBlockProtection
      OIT_SetBlockProtection_PAdmin_NVM_BLOCK_CMS_NXTRMANUFSCRATCHPAD_SetBlockProtection: start-on-event=SetBlockProtection, operation=PAdmin_NVM_BLOCK_CMS_NXTRMANUFSCRATCHPAD.SetBlockProtection
      OIT_SetBlockProtection_PAdmin_NVM_BLOCK_CMS_NXTRMEC_SetBlockProtection: start-on-event=SetBlockProtection, operation=PAdmin_NVM_BLOCK_CMS_NXTRMEC.SetBlockProtection
      OIT_SetBlockProtection_PAdmin_NVM_BLOCK_DIAGMGR_BLACKBOX_SetBlockProtection: start-on-event=SetBlockProtection, operation=PAdmin_NVM_BLOCK_DIAGMGR_BLACKBOX.SetBlockProtection
      OIT_SetBlockProtection_PAdmin_NVM_BLOCK_DIAGMGR_LATCHCNTRS_SetBlockProtection: start-on-event=SetBlockProtection, operation=PAdmin_NVM_BLOCK_DIAGMGR_LATCHCNTRS.SetBlockProtection
      OIT_SetBlockProtection_PAdmin_NVM_BLOCK_DIAGMGR_NTCSTRG_SetBlockProtection: start-on-event=SetBlockProtection, operation=PAdmin_NVM_BLOCK_DIAGMGR_NTCSTRG.SetBlockProtection
      OIT_SetBlockProtection_PAdmin_NVM_BLOCK_EPSDEFEATS_SetBlockProtection: start-on-event=SetBlockProtection, operation=PAdmin_NVM_BLOCK_EPSDEFEATS.SetBlockProtection
      OIT_SetBlockProtection_PAdmin_Rte_NvmBlock_AbsHwPos_EOLVehCntrOffset_SetBlockProtection: start-on-event=SetBlockProtection, operation=PAdmin_Rte_NvmBlock_AbsHwPos_EOLVehCntrOffset.SetBlockProtection
      OIT_SetBlockProtection_PAdmin_Rte_NvmBlock_AstLmt_SteerAsstDefeat_SetBlockProtection: start-on-event=SetBlockProtection, operation=PAdmin_Rte_NvmBlock_AstLmt_SteerAsstDefeat.SetBlockProtection
      OIT_SetBlockProtection_PAdmin_Rte_NvmBlock_AvgFricLrn_AvgFricLrnData_SetBlockProtection: start-on-event=SetBlockProtection, operation=PAdmin_Rte_NvmBlock_AvgFricLrn_AvgFricLrnData.SetBlockProtection
      OIT_SetBlockProtection_PAdmin_Rte_NvmBlock_BatteryVoltage_OvervoltageData_SetBlockProtection: start-on-event=SetBlockProtection, operation=PAdmin_Rte_NvmBlock_BatteryVoltage_OvervoltageData.SetBlockProtection
      OIT_SetBlockProtection_PAdmin_Rte_NvmBlock_CmMtrCurr_CurrTempOffset_SetBlockProtection: start-on-event=SetBlockProtection, operation=PAdmin_Rte_NvmBlock_CmMtrCurr_CurrTempOffset.SetBlockProtection
      OIT_SetBlockProtection_PAdmin_Rte_NvmBlock_CmMtrCurr_ShCurrCal_SetBlockProtection: start-on-event=SetBlockProtection, operation=PAdmin_Rte_NvmBlock_CmMtrCurr_ShCurrCal.SetBlockProtection
      OIT_SetBlockProtection_PAdmin_Rte_NvmBlock_CurrParamComp_EOLNomMtrParam_SetBlockProtection: start-on-event=SetBlockProtection, operation=PAdmin_Rte_NvmBlock_CurrParamComp_EOLNomMtrParam.SetBlockProtection
      OIT_SetBlockProtection_PAdmin_Rte_NvmBlock_DiagSvc_SparePartNumberData_SetBlockProtection: start-on-event=SetBlockProtection, operation=PAdmin_Rte_NvmBlock_DiagSvc_SparePartNumberData.SetBlockProtection
      OIT_SetBlockProtection_PAdmin_Rte_NvmBlock_DiagSvc_SupplierIdentifierData_SetBlockProtection: start-on-event=SetBlockProtection, operation=PAdmin_Rte_NvmBlock_DiagSvc_SupplierIdentifierData.SetBlockProtection
      OIT_SetBlockProtection_PAdmin_Rte_NvmBlock_DiagSvc_TuningSetSelectData_SetBlockProtection: start-on-event=SetBlockProtection, operation=PAdmin_Rte_NvmBlock_DiagSvc_TuningSetSelectData.SetBlockProtection
      OIT_SetBlockProtection_PAdmin_Rte_NvmBlock_DigHwTrqSENT_DigTrqTrim_SetBlockProtection: start-on-event=SetBlockProtection, operation=PAdmin_Rte_NvmBlock_DigHwTrqSENT_DigTrqTrim.SetBlockProtection
      OIT_SetBlockProtection_PAdmin_Rte_NvmBlock_DigMSB_DigMSBEOLData_SetBlockProtection: start-on-event=SetBlockProtection, operation=PAdmin_Rte_NvmBlock_DigMSB_DigMSBEOLData.SetBlockProtection
      OIT_SetBlockProtection_PAdmin_Rte_NvmBlock_LrnEOT_LearnedEOT_SetBlockProtection: start-on-event=SetBlockProtection, operation=PAdmin_Rte_NvmBlock_LrnEOT_LearnedEOT.SetBlockProtection
      OIT_SetBlockProtection_PAdmin_Rte_NvmBlock_Polarity_Polarity_Cnt_Str_SetBlockProtection: start-on-event=SetBlockProtection, operation=PAdmin_Rte_NvmBlock_Polarity_Polarity_Cnt_Str.SetBlockProtection
      OIT_SetBlockProtection_PAdmin_Rte_NvmBlock_StaMd_CloseCheckData_SetBlockProtection: start-on-event=SetBlockProtection, operation=PAdmin_Rte_NvmBlock_StaMd_CloseCheckData.SetBlockProtection
      OIT_SetBlockProtection_PAdmin_Rte_NvmBlock_StaMd_TypeHRamBuffer_SetBlockProtection: start-on-event=SetBlockProtection, operation=PAdmin_Rte_NvmBlock_StaMd_TypeHRamBuffer.SetBlockProtection
      OIT_SetBlockProtection_PAdmin_Rte_NvmBlock_ThrmlDutyCycle_ThrmlDutyCycle_FltStVal_SetBlockProtection: start-on-event=SetBlockProtection, operation=PAdmin_Rte_NvmBlock_ThrmlDutyCycle_ThrmlDutyCycle_FltStVal.SetBlockProtection
      OIT_SetBlockProtection_PAdmin_Rte_NvmBlock_TrqCanc_CogTrqCal_SetBlockProtection: start-on-event=SetBlockProtection, operation=PAdmin_Rte_NvmBlock_TrqCanc_CogTrqCal.SetBlockProtection
      OIT_SetBlockProtection_PAdmin_Rte_NvmBlock_TrqCanc_CogTrqRplComp_SetBlockProtection: start-on-event=SetBlockProtection, operation=PAdmin_Rte_NvmBlock_TrqCanc_CogTrqRplComp.SetBlockProtection
      OIT_SetBlockProtection_PAdmin_Rte_NvmBlock_TrqCmdScl_TorqueCmdSF_Uls_f32_SetBlockProtection: start-on-event=SetBlockProtection, operation=PAdmin_Rte_NvmBlock_TrqCmdScl_TorqueCmdSF_Uls_f32.SetBlockProtection
      OIT_SetBlockProtection_PAdmin_Rte_NvmBlock_VehDyn_MotPosReset_SetBlockProtection: start-on-event=SetBlockProtection, operation=PAdmin_Rte_NvmBlock_VehDyn_MotPosReset.SetBlockProtection
      OIT_SetRamBlockStatus_PS_ConfigBlock_SetRamBlockStatus: start-on-event=SetRamBlockStatus, operation=PS_ConfigBlock.SetRamBlockStatus
      OIT_SetRamBlockStatus_PS_Deprecated_NVM_BLOCK_DEM_SetRamBlockStatus: start-on-event=SetRamBlockStatus, operation=PS_Deprecated_NVM_BLOCK_DEM.SetRamBlockStatus
      OIT_SetRamBlockStatus_PS_Deprecated_NvmBlock_AbsHwPos_EOLVehCntrOffset_SetRamBlockStatus: start-on-event=SetRamBlockStatus, operation=PS_Deprecated_NvmBlock_AbsHwPos_EOLVehCntrOffset.SetRamBlockStatus
      OIT_SetRamBlockStatus_PS_Deprecated_NvmBlock_AbsHwPos_EOLVehCntrOffset1_SetRamBlockStatus: start-on-event=SetRamBlockStatus, operation=PS_Deprecated_NvmBlock_AbsHwPos_EOLVehCntrOffset1.SetRamBlockStatus
      OIT_SetRamBlockStatus_PS_Deprecated_NvmBlock_AstLmt_SteerAsstDefeat_SetRamBlockStatus: start-on-event=SetRamBlockStatus, operation=PS_Deprecated_NvmBlock_AstLmt_SteerAsstDefeat.SetRamBlockStatus
      OIT_SetRamBlockStatus_PS_Deprecated_NvmBlock_AvgFricLrn_AvgFricLrnData_SetRamBlockStatus: start-on-event=SetRamBlockStatus, operation=PS_Deprecated_NvmBlock_AvgFricLrn_AvgFricLrnData.SetRamBlockStatus
      OIT_SetRamBlockStatus_PS_Deprecated_NvmBlock_CmMtrCurr_CurrTempOffset_SetRamBlockStatus: start-on-event=SetRamBlockStatus, operation=PS_Deprecated_NvmBlock_CmMtrCurr_CurrTempOffset.SetRamBlockStatus
      OIT_SetRamBlockStatus_PS_Deprecated_NvmBlock_CmMtrCurr_ShCurrCal_SetRamBlockStatus: start-on-event=SetRamBlockStatus, operation=PS_Deprecated_NvmBlock_CmMtrCurr_ShCurrCal.SetRamBlockStatus
      OIT_SetRamBlockStatus_PS_Deprecated_NvmBlock_DigHwTrqSENT_DigTrqTrim_SetRamBlockStatus: start-on-event=SetRamBlockStatus, operation=PS_Deprecated_NvmBlock_DigHwTrqSENT_DigTrqTrim.SetRamBlockStatus
      OIT_SetRamBlockStatus_PS_Deprecated_NvmBlock_LrnEOT_LearnedEOT_SetRamBlockStatus: start-on-event=SetRamBlockStatus, operation=PS_Deprecated_NvmBlock_LrnEOT_LearnedEOT.SetRamBlockStatus
      OIT_SetRamBlockStatus_PS_Deprecated_NvmBlock_TrqCanc_CogTrqCal_SetRamBlockStatus: start-on-event=SetRamBlockStatus, operation=PS_Deprecated_NvmBlock_TrqCanc_CogTrqCal.SetRamBlockStatus
      OIT_SetRamBlockStatus_PS_Deprecated_NvmBlock_TrqCanc_CogTrqRplComp_SetRamBlockStatus: start-on-event=SetRamBlockStatus, operation=PS_Deprecated_NvmBlock_TrqCanc_CogTrqRplComp.SetRamBlockStatus
      OIT_SetRamBlockStatus_PS_Deprecated_NvmBlock_TrqCmdScl_TorqueCmdSF_Uls_f32_SetRamBlockStatus: start-on-event=SetRamBlockStatus, operation=PS_Deprecated_NvmBlock_TrqCmdScl_TorqueCmdSF_Uls_f32.SetRamBlockStatus
      OIT_SetRamBlockStatus_PS_NVM_BLOCK_CMS_ECUHWPN_SetRamBlockStatus: start-on-event=SetRamBlockStatus, operation=PS_NVM_BLOCK_CMS_ECUHWPN.SetRamBlockStatus
      OIT_SetRamBlockStatus_PS_NVM_BLOCK_CMS_ECUSRLNUM_SetRamBlockStatus: start-on-event=SetRamBlockStatus, operation=PS_NVM_BLOCK_CMS_ECUSRLNUM.SetRamBlockStatus
      OIT_SetRamBlockStatus_PS_NVM_BLOCK_CMS_EPSSRLNUM_SetRamBlockStatus: start-on-event=SetRamBlockStatus, operation=PS_NVM_BLOCK_CMS_EPSSRLNUM.SetRamBlockStatus
      OIT_SetRamBlockStatus_PS_NVM_BLOCK_CMS_IGNCNTR_SetRamBlockStatus: start-on-event=SetRamBlockStatus, operation=PS_NVM_BLOCK_CMS_IGNCNTR.SetRamBlockStatus
      OIT_SetRamBlockStatus_PS_NVM_BLOCK_CMS_NXTRMANUFSCRATCHPAD_SetRamBlockStatus: start-on-event=SetRamBlockStatus, operation=PS_NVM_BLOCK_CMS_NXTRMANUFSCRATCHPAD.SetRamBlockStatus
      OIT_SetRamBlockStatus_PS_NVM_BLOCK_CMS_NXTRMEC_SetRamBlockStatus: start-on-event=SetRamBlockStatus, operation=PS_NVM_BLOCK_CMS_NXTRMEC.SetRamBlockStatus
      OIT_SetRamBlockStatus_PS_NVM_BLOCK_DIAGMGR_BLACKBOX_SetRamBlockStatus: start-on-event=SetRamBlockStatus, operation=PS_NVM_BLOCK_DIAGMGR_BLACKBOX.SetRamBlockStatus
      OIT_SetRamBlockStatus_PS_NVM_BLOCK_DIAGMGR_LATCHCNTRS_SetRamBlockStatus: start-on-event=SetRamBlockStatus, operation=PS_NVM_BLOCK_DIAGMGR_LATCHCNTRS.SetRamBlockStatus
      OIT_SetRamBlockStatus_PS_NVM_BLOCK_DIAGMGR_NTCSTRG_SetRamBlockStatus: start-on-event=SetRamBlockStatus, operation=PS_NVM_BLOCK_DIAGMGR_NTCSTRG.SetRamBlockStatus
      OIT_SetRamBlockStatus_PS_NVM_BLOCK_EPSDEFEATS_SetRamBlockStatus: start-on-event=SetRamBlockStatus, operation=PS_NVM_BLOCK_EPSDEFEATS.SetRamBlockStatus
      OIT_SetRamBlockStatus_PS_Rte_NvmBlock_AbsHwPos_EOLVehCntrOffset_SetRamBlockStatus: start-on-event=SetRamBlockStatus, operation=PS_Rte_NvmBlock_AbsHwPos_EOLVehCntrOffset.SetRamBlockStatus
      OIT_SetRamBlockStatus_PS_Rte_NvmBlock_AstLmt_SteerAsstDefeat_SetRamBlockStatus: start-on-event=SetRamBlockStatus, operation=PS_Rte_NvmBlock_AstLmt_SteerAsstDefeat.SetRamBlockStatus
      OIT_SetRamBlockStatus_PS_Rte_NvmBlock_AvgFricLrn_AvgFricLrnData_SetRamBlockStatus: start-on-event=SetRamBlockStatus, operation=PS_Rte_NvmBlock_AvgFricLrn_AvgFricLrnData.SetRamBlockStatus
      OIT_SetRamBlockStatus_PS_Rte_NvmBlock_BatteryVoltage_OvervoltageData_SetRamBlockStatus: start-on-event=SetRamBlockStatus, operation=PS_Rte_NvmBlock_BatteryVoltage_OvervoltageData.SetRamBlockStatus
      OIT_SetRamBlockStatus_PS_Rte_NvmBlock_CmMtrCurr_CurrTempOffset_SetRamBlockStatus: start-on-event=SetRamBlockStatus, operation=PS_Rte_NvmBlock_CmMtrCurr_CurrTempOffset.SetRamBlockStatus
      OIT_SetRamBlockStatus_PS_Rte_NvmBlock_CmMtrCurr_ShCurrCal_SetRamBlockStatus: start-on-event=SetRamBlockStatus, operation=PS_Rte_NvmBlock_CmMtrCurr_ShCurrCal.SetRamBlockStatus
      OIT_SetRamBlockStatus_PS_Rte_NvmBlock_CurrParamComp_EOLNomMtrParam_SetRamBlockStatus: start-on-event=SetRamBlockStatus, operation=PS_Rte_NvmBlock_CurrParamComp_EOLNomMtrParam.SetRamBlockStatus
      OIT_SetRamBlockStatus_PS_Rte_NvmBlock_DiagSvc_SparePartNumberData_SetRamBlockStatus: start-on-event=SetRamBlockStatus, operation=PS_Rte_NvmBlock_DiagSvc_SparePartNumberData.SetRamBlockStatus
      OIT_SetRamBlockStatus_PS_Rte_NvmBlock_DiagSvc_SupplierIdentifierData_SetRamBlockStatus: start-on-event=SetRamBlockStatus, operation=PS_Rte_NvmBlock_DiagSvc_SupplierIdentifierData.SetRamBlockStatus
      OIT_SetRamBlockStatus_PS_Rte_NvmBlock_DiagSvc_TuningSetSelectData_SetRamBlockStatus: start-on-event=SetRamBlockStatus, operation=PS_Rte_NvmBlock_DiagSvc_TuningSetSelectData.SetRamBlockStatus
      OIT_SetRamBlockStatus_PS_Rte_NvmBlock_DigHwTrqSENT_DigTrqTrim_SetRamBlockStatus: start-on-event=SetRamBlockStatus, operation=PS_Rte_NvmBlock_DigHwTrqSENT_DigTrqTrim.SetRamBlockStatus
      OIT_SetRamBlockStatus_PS_Rte_NvmBlock_DigMSB_DigMSBEOLData_SetRamBlockStatus: start-on-event=SetRamBlockStatus, operation=PS_Rte_NvmBlock_DigMSB_DigMSBEOLData.SetRamBlockStatus
      OIT_SetRamBlockStatus_PS_Rte_NvmBlock_LrnEOT_LearnedEOT_SetRamBlockStatus: start-on-event=SetRamBlockStatus, operation=PS_Rte_NvmBlock_LrnEOT_LearnedEOT.SetRamBlockStatus
      OIT_SetRamBlockStatus_PS_Rte_NvmBlock_Polarity_Polarity_Cnt_Str_SetRamBlockStatus: start-on-event=SetRamBlockStatus, operation=PS_Rte_NvmBlock_Polarity_Polarity_Cnt_Str.SetRamBlockStatus
      OIT_SetRamBlockStatus_PS_Rte_NvmBlock_StaMd_CloseCheckData_SetRamBlockStatus: start-on-event=SetRamBlockStatus, operation=PS_Rte_NvmBlock_StaMd_CloseCheckData.SetRamBlockStatus
      OIT_SetRamBlockStatus_PS_Rte_NvmBlock_StaMd_TypeHRamBuffer_SetRamBlockStatus: start-on-event=SetRamBlockStatus, operation=PS_Rte_NvmBlock_StaMd_TypeHRamBuffer.SetRamBlockStatus
      OIT_SetRamBlockStatus_PS_Rte_NvmBlock_ThrmlDutyCycle_ThrmlDutyCycle_FltStVal_SetRamBlockStatus: start-on-event=SetRamBlockStatus, operation=PS_Rte_NvmBlock_ThrmlDutyCycle_ThrmlDutyCycle_FltStVal.SetRamBlockStatus
      OIT_SetRamBlockStatus_PS_Rte_NvmBlock_TrqCanc_CogTrqCal_SetRamBlockStatus: start-on-event=SetRamBlockStatus, operation=PS_Rte_NvmBlock_TrqCanc_CogTrqCal.SetRamBlockStatus
      OIT_SetRamBlockStatus_PS_Rte_NvmBlock_TrqCanc_CogTrqRplComp_SetRamBlockStatus: start-on-event=SetRamBlockStatus, operation=PS_Rte_NvmBlock_TrqCanc_CogTrqRplComp.SetRamBlockStatus
      OIT_SetRamBlockStatus_PS_Rte_NvmBlock_TrqCmdScl_TorqueCmdSF_Uls_f32_SetRamBlockStatus: start-on-event=SetRamBlockStatus, operation=PS_Rte_NvmBlock_TrqCmdScl_TorqueCmdSF_Uls_f32.SetRamBlockStatus
      OIT_SetRamBlockStatus_PS_Rte_NvmBlock_VehDyn_MotPosReset_SetRamBlockStatus: start-on-event=SetRamBlockStatus, operation=PS_Rte_NvmBlock_VehDyn_MotPosReset.SetRamBlockStatus
      OIT_WriteBlock_PS_ConfigBlock_WriteBlock: start-on-event=WriteBlock, operation=PS_ConfigBlock.WriteBlock
      OIT_WriteBlock_PS_Deprecated_NVM_BLOCK_DEM_WriteBlock: start-on-event=WriteBlock, operation=PS_Deprecated_NVM_BLOCK_DEM.WriteBlock
      OIT_WriteBlock_PS_Deprecated_NvmBlock_AbsHwPos_EOLVehCntrOffset_WriteBlock: start-on-event=WriteBlock, operation=PS_Deprecated_NvmBlock_AbsHwPos_EOLVehCntrOffset.WriteBlock
      OIT_WriteBlock_PS_Deprecated_NvmBlock_AbsHwPos_EOLVehCntrOffset1_WriteBlock: start-on-event=WriteBlock, operation=PS_Deprecated_NvmBlock_AbsHwPos_EOLVehCntrOffset1.WriteBlock
      OIT_WriteBlock_PS_Deprecated_NvmBlock_AstLmt_SteerAsstDefeat_WriteBlock: start-on-event=WriteBlock, operation=PS_Deprecated_NvmBlock_AstLmt_SteerAsstDefeat.WriteBlock
      OIT_WriteBlock_PS_Deprecated_NvmBlock_AvgFricLrn_AvgFricLrnData_WriteBlock: start-on-event=WriteBlock, operation=PS_Deprecated_NvmBlock_AvgFricLrn_AvgFricLrnData.WriteBlock
      OIT_WriteBlock_PS_Deprecated_NvmBlock_CmMtrCurr_CurrTempOffset_WriteBlock: start-on-event=WriteBlock, operation=PS_Deprecated_NvmBlock_CmMtrCurr_CurrTempOffset.WriteBlock
      OIT_WriteBlock_PS_Deprecated_NvmBlock_CmMtrCurr_ShCurrCal_WriteBlock: start-on-event=WriteBlock, operation=PS_Deprecated_NvmBlock_CmMtrCurr_ShCurrCal.WriteBlock
      OIT_WriteBlock_PS_Deprecated_NvmBlock_DigHwTrqSENT_DigTrqTrim_WriteBlock: start-on-event=WriteBlock, operation=PS_Deprecated_NvmBlock_DigHwTrqSENT_DigTrqTrim.WriteBlock
      OIT_WriteBlock_PS_Deprecated_NvmBlock_LrnEOT_LearnedEOT_WriteBlock: start-on-event=WriteBlock, operation=PS_Deprecated_NvmBlock_LrnEOT_LearnedEOT.WriteBlock
      OIT_WriteBlock_PS_Deprecated_NvmBlock_TrqCanc_CogTrqCal_WriteBlock: start-on-event=WriteBlock, operation=PS_Deprecated_NvmBlock_TrqCanc_CogTrqCal.WriteBlock
      OIT_WriteBlock_PS_Deprecated_NvmBlock_TrqCanc_CogTrqRplComp_WriteBlock: start-on-event=WriteBlock, operation=PS_Deprecated_NvmBlock_TrqCanc_CogTrqRplComp.WriteBlock
      OIT_WriteBlock_PS_Deprecated_NvmBlock_TrqCmdScl_TorqueCmdSF_Uls_f32_WriteBlock: start-on-event=WriteBlock, operation=PS_Deprecated_NvmBlock_TrqCmdScl_TorqueCmdSF_Uls_f32.WriteBlock
      OIT_WriteBlock_PS_NVM_BLOCK_CMS_ECUHWPN_WriteBlock: start-on-event=WriteBlock, operation=PS_NVM_BLOCK_CMS_ECUHWPN.WriteBlock
      OIT_WriteBlock_PS_NVM_BLOCK_CMS_ECUSRLNUM_WriteBlock: start-on-event=WriteBlock, operation=PS_NVM_BLOCK_CMS_ECUSRLNUM.WriteBlock
      OIT_WriteBlock_PS_NVM_BLOCK_CMS_EPSSRLNUM_WriteBlock: start-on-event=WriteBlock, operation=PS_NVM_BLOCK_CMS_EPSSRLNUM.WriteBlock
      OIT_WriteBlock_PS_NVM_BLOCK_CMS_IGNCNTR_WriteBlock: start-on-event=WriteBlock, operation=PS_NVM_BLOCK_CMS_IGNCNTR.WriteBlock
      OIT_WriteBlock_PS_NVM_BLOCK_CMS_NXTRMANUFSCRATCHPAD_WriteBlock: start-on-event=WriteBlock, operation=PS_NVM_BLOCK_CMS_NXTRMANUFSCRATCHPAD.WriteBlock
      OIT_WriteBlock_PS_NVM_BLOCK_CMS_NXTRMEC_WriteBlock: start-on-event=WriteBlock, operation=PS_NVM_BLOCK_CMS_NXTRMEC.WriteBlock
      OIT_WriteBlock_PS_NVM_BLOCK_DIAGMGR_BLACKBOX_WriteBlock: start-on-event=WriteBlock, operation=PS_NVM_BLOCK_DIAGMGR_BLACKBOX.WriteBlock
      OIT_WriteBlock_PS_NVM_BLOCK_DIAGMGR_LATCHCNTRS_WriteBlock: start-on-event=WriteBlock, operation=PS_NVM_BLOCK_DIAGMGR_LATCHCNTRS.WriteBlock
      OIT_WriteBlock_PS_NVM_BLOCK_DIAGMGR_NTCSTRG_WriteBlock: start-on-event=WriteBlock, operation=PS_NVM_BLOCK_DIAGMGR_NTCSTRG.WriteBlock
      OIT_WriteBlock_PS_NVM_BLOCK_EPSDEFEATS_WriteBlock: start-on-event=WriteBlock, operation=PS_NVM_BLOCK_EPSDEFEATS.WriteBlock
      OIT_WriteBlock_PS_Rte_NvmBlock_AbsHwPos_EOLVehCntrOffset_WriteBlock: start-on-event=WriteBlock, operation=PS_Rte_NvmBlock_AbsHwPos_EOLVehCntrOffset.WriteBlock
      OIT_WriteBlock_PS_Rte_NvmBlock_AstLmt_SteerAsstDefeat_WriteBlock: start-on-event=WriteBlock, operation=PS_Rte_NvmBlock_AstLmt_SteerAsstDefeat.WriteBlock
      OIT_WriteBlock_PS_Rte_NvmBlock_AvgFricLrn_AvgFricLrnData_WriteBlock: start-on-event=WriteBlock, operation=PS_Rte_NvmBlock_AvgFricLrn_AvgFricLrnData.WriteBlock
      OIT_WriteBlock_PS_Rte_NvmBlock_BatteryVoltage_OvervoltageData_WriteBlock: start-on-event=WriteBlock, operation=PS_Rte_NvmBlock_BatteryVoltage_OvervoltageData.WriteBlock
      OIT_WriteBlock_PS_Rte_NvmBlock_CmMtrCurr_CurrTempOffset_WriteBlock: start-on-event=WriteBlock, operation=PS_Rte_NvmBlock_CmMtrCurr_CurrTempOffset.WriteBlock
      OIT_WriteBlock_PS_Rte_NvmBlock_CmMtrCurr_ShCurrCal_WriteBlock: start-on-event=WriteBlock, operation=PS_Rte_NvmBlock_CmMtrCurr_ShCurrCal.WriteBlock
      OIT_WriteBlock_PS_Rte_NvmBlock_CurrParamComp_EOLNomMtrParam_WriteBlock: start-on-event=WriteBlock, operation=PS_Rte_NvmBlock_CurrParamComp_EOLNomMtrParam.WriteBlock
      OIT_WriteBlock_PS_Rte_NvmBlock_DiagSvc_SparePartNumberData_WriteBlock: start-on-event=WriteBlock, operation=PS_Rte_NvmBlock_DiagSvc_SparePartNumberData.WriteBlock
      OIT_WriteBlock_PS_Rte_NvmBlock_DiagSvc_SupplierIdentifierData_WriteBlock: start-on-event=WriteBlock, operation=PS_Rte_NvmBlock_DiagSvc_SupplierIdentifierData.WriteBlock
      OIT_WriteBlock_PS_Rte_NvmBlock_DiagSvc_TuningSetSelectData_WriteBlock: start-on-event=WriteBlock, operation=PS_Rte_NvmBlock_DiagSvc_TuningSetSelectData.WriteBlock
      OIT_WriteBlock_PS_Rte_NvmBlock_DigHwTrqSENT_DigTrqTrim_WriteBlock: start-on-event=WriteBlock, operation=PS_Rte_NvmBlock_DigHwTrqSENT_DigTrqTrim.WriteBlock
      OIT_WriteBlock_PS_Rte_NvmBlock_DigMSB_DigMSBEOLData_WriteBlock: start-on-event=WriteBlock, operation=PS_Rte_NvmBlock_DigMSB_DigMSBEOLData.WriteBlock
      OIT_WriteBlock_PS_Rte_NvmBlock_LrnEOT_LearnedEOT_WriteBlock: start-on-event=WriteBlock, operation=PS_Rte_NvmBlock_LrnEOT_LearnedEOT.WriteBlock
      OIT_WriteBlock_PS_Rte_NvmBlock_Polarity_Polarity_Cnt_Str_WriteBlock: start-on-event=WriteBlock, operation=PS_Rte_NvmBlock_Polarity_Polarity_Cnt_Str.WriteBlock
      OIT_WriteBlock_PS_Rte_NvmBlock_StaMd_CloseCheckData_WriteBlock: start-on-event=WriteBlock, operation=PS_Rte_NvmBlock_StaMd_CloseCheckData.WriteBlock
      OIT_WriteBlock_PS_Rte_NvmBlock_StaMd_TypeHRamBuffer_WriteBlock: start-on-event=WriteBlock, operation=PS_Rte_NvmBlock_StaMd_TypeHRamBuffer.WriteBlock
      OIT_WriteBlock_PS_Rte_NvmBlock_ThrmlDutyCycle_ThrmlDutyCycle_FltStVal_WriteBlock: start-on-event=WriteBlock, operation=PS_Rte_NvmBlock_ThrmlDutyCycle_ThrmlDutyCycle_FltStVal.WriteBlock
      OIT_WriteBlock_PS_Rte_NvmBlock_TrqCanc_CogTrqCal_WriteBlock: start-on-event=WriteBlock, operation=PS_Rte_NvmBlock_TrqCanc_CogTrqCal.WriteBlock
      OIT_WriteBlock_PS_Rte_NvmBlock_TrqCanc_CogTrqRplComp_WriteBlock: start-on-event=WriteBlock, operation=PS_Rte_NvmBlock_TrqCanc_CogTrqRplComp.WriteBlock
      OIT_WriteBlock_PS_Rte_NvmBlock_TrqCmdScl_TorqueCmdSF_Uls_f32_WriteBlock: start-on-event=WriteBlock, operation=PS_Rte_NvmBlock_TrqCmdScl_TorqueCmdSF_Uls_f32.WriteBlock
      OIT_WriteBlock_PS_Rte_NvmBlock_VehDyn_MotPosReset_WriteBlock: start-on-event=WriteBlock, operation=PS_Rte_NvmBlock_VehDyn_MotPosReset.WriteBlock
    port-api-option enable-take-address=false, indirect-api=false, port=PAdmin_ConfigBlock:
      port-arg-values:
        integer literal NvM_AdminBlockId_1: type=NvM_BlockIdType, value=1
    port-api-option enable-take-address=false, indirect-api=false, port=PAdmin_Deprecated_NVM_BLOCK_DEM:
      port-arg-values:
        integer literal NvM_AdminBlockId_5: type=NvM_BlockIdType, value=5
    port-api-option enable-take-address=false, indirect-api=false, port=PAdmin_Deprecated_NvmBlock_AbsHwPos_EOLVehCntrOffset:
      port-arg-values:
        integer literal NvM_AdminBlockId_25: type=NvM_BlockIdType, value=25
    port-api-option enable-take-address=false, indirect-api=false, port=PAdmin_Deprecated_NvmBlock_AbsHwPos_EOLVehCntrOffset1:
      port-arg-values:
        integer literal NvM_AdminBlockId_27: type=NvM_BlockIdType, value=27
    port-api-option enable-take-address=false, indirect-api=false, port=PAdmin_Deprecated_NvmBlock_AstLmt_SteerAsstDefeat:
      port-arg-values:
        integer literal NvM_AdminBlockId_29: type=NvM_BlockIdType, value=29
    port-api-option enable-take-address=false, indirect-api=false, port=PAdmin_Deprecated_NvmBlock_AvgFricLrn_AvgFricLrnData:
      port-arg-values:
        integer literal NvM_AdminBlockId_21: type=NvM_BlockIdType, value=21
    port-api-option enable-take-address=false, indirect-api=false, port=PAdmin_Deprecated_NvmBlock_CmMtrCurr_CurrTempOffset:
      port-arg-values:
        integer literal NvM_AdminBlockId_8: type=NvM_BlockIdType, value=8
    port-api-option enable-take-address=false, indirect-api=false, port=PAdmin_Deprecated_NvmBlock_CmMtrCurr_ShCurrCal:
      port-arg-values:
        integer literal NvM_AdminBlockId_9: type=NvM_BlockIdType, value=9
    port-api-option enable-take-address=false, indirect-api=false, port=PAdmin_Deprecated_NvmBlock_DigHwTrqSENT_DigTrqTrim:
      port-arg-values:
        integer literal NvM_AdminBlockId_24: type=NvM_BlockIdType, value=24
    port-api-option enable-take-address=false, indirect-api=false, port=PAdmin_Deprecated_NvmBlock_LrnEOT_LearnedEOT:
      port-arg-values:
        integer literal NvM_AdminBlockId_11: type=NvM_BlockIdType, value=11
    port-api-option enable-take-address=false, indirect-api=false, port=PAdmin_Deprecated_NvmBlock_TrqCanc_CogTrqCal:
      port-arg-values:
        integer literal NvM_AdminBlockId_12: type=NvM_BlockIdType, value=12
    port-api-option enable-take-address=false, indirect-api=false, port=PAdmin_Deprecated_NvmBlock_TrqCanc_CogTrqRplComp:
      port-arg-values:
        integer literal NvM_AdminBlockId_28: type=NvM_BlockIdType, value=28
    port-api-option enable-take-address=false, indirect-api=false, port=PAdmin_Deprecated_NvmBlock_TrqCmdScl_TorqueCmdSF_Uls_f32:
      port-arg-values:
        integer literal NvM_AdminBlockId_7: type=NvM_BlockIdType, value=7
    port-api-option enable-take-address=false, indirect-api=false, port=PAdmin_NVM_BLOCK_CMS_ECUHWPN:
      port-arg-values:
        integer literal NvM_AdminBlockId_16: type=NvM_BlockIdType, value=16
    port-api-option enable-take-address=false, indirect-api=false, port=PAdmin_NVM_BLOCK_CMS_ECUSRLNUM:
      port-arg-values:
        integer literal NvM_AdminBlockId_14: type=NvM_BlockIdType, value=14
    port-api-option enable-take-address=false, indirect-api=false, port=PAdmin_NVM_BLOCK_CMS_EPSSRLNUM:
      port-arg-values:
        integer literal NvM_AdminBlockId_15: type=NvM_BlockIdType, value=15
    port-api-option enable-take-address=false, indirect-api=false, port=PAdmin_NVM_BLOCK_CMS_IGNCNTR:
      port-arg-values:
        integer literal NvM_AdminBlockId_18: type=NvM_BlockIdType, value=18
    port-api-option enable-take-address=false, indirect-api=false, port=PAdmin_NVM_BLOCK_CMS_NXTRMANUFSCRATCHPAD:
      port-arg-values:
        integer literal NvM_AdminBlockId_17: type=NvM_BlockIdType, value=17
    port-api-option enable-take-address=false, indirect-api=false, port=PAdmin_NVM_BLOCK_CMS_NXTRMEC:
      port-arg-values:
        integer literal NvM_AdminBlockId_13: type=NvM_BlockIdType, value=13
    port-api-option enable-take-address=false, indirect-api=false, port=PAdmin_NVM_BLOCK_DIAGMGR_BLACKBOX:
      port-arg-values:
        integer literal NvM_AdminBlockId_20: type=NvM_BlockIdType, value=20
    port-api-option enable-take-address=false, indirect-api=false, port=PAdmin_NVM_BLOCK_DIAGMGR_LATCHCNTRS:
      port-arg-values:
        integer literal NvM_AdminBlockId_31: type=NvM_BlockIdType, value=31
    port-api-option enable-take-address=false, indirect-api=false, port=PAdmin_NVM_BLOCK_DIAGMGR_NTCSTRG:
      port-arg-values:
        integer literal NvM_AdminBlockId_3: type=NvM_BlockIdType, value=3
    port-api-option enable-take-address=false, indirect-api=false, port=PAdmin_NVM_BLOCK_EPSDEFEATS:
      port-arg-values:
        integer literal NvM_AdminBlockId_4: type=NvM_BlockIdType, value=4
    port-api-option enable-take-address=false, indirect-api=false, port=PAdmin_Rte_NvmBlock_AbsHwPos_EOLVehCntrOffset:
      port-arg-values:
        integer literal NvM_AdminBlockId_41: type=NvM_BlockIdType, value=41
    port-api-option enable-take-address=false, indirect-api=false, port=PAdmin_Rte_NvmBlock_AstLmt_SteerAsstDefeat:
      port-arg-values:
        integer literal NvM_AdminBlockId_39: type=NvM_BlockIdType, value=39
    port-api-option enable-take-address=false, indirect-api=false, port=PAdmin_Rte_NvmBlock_AvgFricLrn_AvgFricLrnData:
      port-arg-values:
        integer literal NvM_AdminBlockId_33: type=NvM_BlockIdType, value=33
    port-api-option enable-take-address=false, indirect-api=false, port=PAdmin_Rte_NvmBlock_BatteryVoltage_OvervoltageData:
      port-arg-values:
        integer literal NvM_AdminBlockId_22: type=NvM_BlockIdType, value=22
    port-api-option enable-take-address=false, indirect-api=false, port=PAdmin_Rte_NvmBlock_CmMtrCurr_CurrTempOffset:
      port-arg-values:
        integer literal NvM_AdminBlockId_35: type=NvM_BlockIdType, value=35
    port-api-option enable-take-address=false, indirect-api=false, port=PAdmin_Rte_NvmBlock_CmMtrCurr_ShCurrCal:
      port-arg-values:
        integer literal NvM_AdminBlockId_36: type=NvM_BlockIdType, value=36
    port-api-option enable-take-address=false, indirect-api=false, port=PAdmin_Rte_NvmBlock_CurrParamComp_EOLNomMtrParam:
      port-arg-values:
        integer literal NvM_AdminBlockId_10: type=NvM_BlockIdType, value=10
    port-api-option enable-take-address=false, indirect-api=false, port=PAdmin_Rte_NvmBlock_DiagSvc_SparePartNumberData:
      port-arg-values:
        integer literal NvM_AdminBlockId_43: type=NvM_BlockIdType, value=43
    port-api-option enable-take-address=false, indirect-api=false, port=PAdmin_Rte_NvmBlock_DiagSvc_SupplierIdentifierData:
      port-arg-values:
        integer literal NvM_AdminBlockId_42: type=NvM_BlockIdType, value=42
    port-api-option enable-take-address=false, indirect-api=false, port=PAdmin_Rte_NvmBlock_DiagSvc_TuningSetSelectData:
      port-arg-values:
        integer literal NvM_AdminBlockId_26: type=NvM_BlockIdType, value=26
    port-api-option enable-take-address=false, indirect-api=false, port=PAdmin_Rte_NvmBlock_DigHwTrqSENT_DigTrqTrim:
      port-arg-values:
        integer literal NvM_AdminBlockId_34: type=NvM_BlockIdType, value=34
    port-api-option enable-take-address=false, indirect-api=false, port=PAdmin_Rte_NvmBlock_DigMSB_DigMSBEOLData:
      port-arg-values:
        integer literal NvM_AdminBlockId_23: type=NvM_BlockIdType, value=23
    port-api-option enable-take-address=false, indirect-api=false, port=PAdmin_Rte_NvmBlock_LrnEOT_LearnedEOT:
      port-arg-values:
        integer literal NvM_AdminBlockId_32: type=NvM_BlockIdType, value=32
    port-api-option enable-take-address=false, indirect-api=false, port=PAdmin_Rte_NvmBlock_Polarity_Polarity_Cnt_Str:
      port-arg-values:
        integer literal NvM_AdminBlockId_2: type=NvM_BlockIdType, value=2
    port-api-option enable-take-address=false, indirect-api=false, port=PAdmin_Rte_NvmBlock_StaMd_CloseCheckData:
      port-arg-values:
        integer literal NvM_AdminBlockId_19: type=NvM_BlockIdType, value=19
    port-api-option enable-take-address=false, indirect-api=false, port=PAdmin_Rte_NvmBlock_StaMd_TypeHRamBuffer:
      port-arg-values:
        integer literal NvM_AdminBlockId_6: type=NvM_BlockIdType, value=6
    port-api-option enable-take-address=false, indirect-api=false, port=PAdmin_Rte_NvmBlock_ThrmlDutyCycle_ThrmlDutyCycle_FltStVal:
      port-arg-values:
        integer literal NvM_AdminBlockId_30: type=NvM_BlockIdType, value=30
    port-api-option enable-take-address=false, indirect-api=false, port=PAdmin_Rte_NvmBlock_TrqCanc_CogTrqCal:
      port-arg-values:
        integer literal NvM_AdminBlockId_37: type=NvM_BlockIdType, value=37
    port-api-option enable-take-address=false, indirect-api=false, port=PAdmin_Rte_NvmBlock_TrqCanc_CogTrqRplComp:
      port-arg-values:
        integer literal NvM_AdminBlockId_38: type=NvM_BlockIdType, value=38
    port-api-option enable-take-address=false, indirect-api=false, port=PAdmin_Rte_NvmBlock_TrqCmdScl_TorqueCmdSF_Uls_f32:
      port-arg-values:
        integer literal NvM_AdminBlockId_40: type=NvM_BlockIdType, value=40
    port-api-option enable-take-address=false, indirect-api=false, port=PAdmin_Rte_NvmBlock_VehDyn_MotPosReset:
      port-arg-values:
        integer literal NvM_AdminBlockId_44: type=NvM_BlockIdType, value=44
    port-api-option enable-take-address=false, indirect-api=false, port=PS_ConfigBlock:
      port-arg-values:
        integer literal NvM_ServiceBlockId_1: type=NvM_BlockIdType, value=1
    port-api-option enable-take-address=false, indirect-api=false, port=PS_Deprecated_NVM_BLOCK_DEM:
      port-arg-values:
        integer literal NvM_ServiceBlockId_5: type=NvM_BlockIdType, value=5
    port-api-option enable-take-address=false, indirect-api=false, port=PS_Deprecated_NvmBlock_AbsHwPos_EOLVehCntrOffset:
      port-arg-values:
        integer literal NvM_ServiceBlockId_25: type=NvM_BlockIdType, value=25
    port-api-option enable-take-address=false, indirect-api=false, port=PS_Deprecated_NvmBlock_AbsHwPos_EOLVehCntrOffset1:
      port-arg-values:
        integer literal NvM_ServiceBlockId_27: type=NvM_BlockIdType, value=27
    port-api-option enable-take-address=false, indirect-api=false, port=PS_Deprecated_NvmBlock_AstLmt_SteerAsstDefeat:
      port-arg-values:
        integer literal NvM_ServiceBlockId_29: type=NvM_BlockIdType, value=29
    port-api-option enable-take-address=false, indirect-api=false, port=PS_Deprecated_NvmBlock_AvgFricLrn_AvgFricLrnData:
      port-arg-values:
        integer literal NvM_ServiceBlockId_21: type=NvM_BlockIdType, value=21
    port-api-option enable-take-address=false, indirect-api=false, port=PS_Deprecated_NvmBlock_CmMtrCurr_CurrTempOffset:
      port-arg-values:
        integer literal NvM_ServiceBlockId_8: type=NvM_BlockIdType, value=8
    port-api-option enable-take-address=false, indirect-api=false, port=PS_Deprecated_NvmBlock_CmMtrCurr_ShCurrCal:
      port-arg-values:
        integer literal NvM_ServiceBlockId_9: type=NvM_BlockIdType, value=9
    port-api-option enable-take-address=false, indirect-api=false, port=PS_Deprecated_NvmBlock_DigHwTrqSENT_DigTrqTrim:
      port-arg-values:
        integer literal NvM_ServiceBlockId_24: type=NvM_BlockIdType, value=24
    port-api-option enable-take-address=false, indirect-api=false, port=PS_Deprecated_NvmBlock_LrnEOT_LearnedEOT:
      port-arg-values:
        integer literal NvM_ServiceBlockId_11: type=NvM_BlockIdType, value=11
    port-api-option enable-take-address=false, indirect-api=false, port=PS_Deprecated_NvmBlock_TrqCanc_CogTrqCal:
      port-arg-values:
        integer literal NvM_ServiceBlockId_12: type=NvM_BlockIdType, value=12
    port-api-option enable-take-address=false, indirect-api=false, port=PS_Deprecated_NvmBlock_TrqCanc_CogTrqRplComp:
      port-arg-values:
        integer literal NvM_ServiceBlockId_28: type=NvM_BlockIdType, value=28
    port-api-option enable-take-address=false, indirect-api=false, port=PS_Deprecated_NvmBlock_TrqCmdScl_TorqueCmdSF_Uls_f32:
      port-arg-values:
        integer literal NvM_ServiceBlockId_7: type=NvM_BlockIdType, value=7
    port-api-option enable-take-address=false, indirect-api=false, port=PS_NVM_BLOCK_CMS_ECUHWPN:
      port-arg-values:
        integer literal NvM_ServiceBlockId_16: type=NvM_BlockIdType, value=16
    port-api-option enable-take-address=false, indirect-api=false, port=PS_NVM_BLOCK_CMS_ECUSRLNUM:
      port-arg-values:
        integer literal NvM_ServiceBlockId_14: type=NvM_BlockIdType, value=14
    port-api-option enable-take-address=false, indirect-api=false, port=PS_NVM_BLOCK_CMS_EPSSRLNUM:
      port-arg-values:
        integer literal NvM_ServiceBlockId_15: type=NvM_BlockIdType, value=15
    port-api-option enable-take-address=false, indirect-api=false, port=PS_NVM_BLOCK_CMS_IGNCNTR:
      port-arg-values:
        integer literal NvM_ServiceBlockId_18: type=NvM_BlockIdType, value=18
    port-api-option enable-take-address=false, indirect-api=false, port=PS_NVM_BLOCK_CMS_NXTRMANUFSCRATCHPAD:
      port-arg-values:
        integer literal NvM_ServiceBlockId_17: type=NvM_BlockIdType, value=17
    port-api-option enable-take-address=false, indirect-api=false, port=PS_NVM_BLOCK_CMS_NXTRMEC:
      port-arg-values:
        integer literal NvM_ServiceBlockId_13: type=NvM_BlockIdType, value=13
    port-api-option enable-take-address=false, indirect-api=false, port=PS_NVM_BLOCK_DIAGMGR_BLACKBOX:
      port-arg-values:
        integer literal NvM_ServiceBlockId_20: type=NvM_BlockIdType, value=20
    port-api-option enable-take-address=false, indirect-api=false, port=PS_NVM_BLOCK_DIAGMGR_LATCHCNTRS:
      port-arg-values:
        integer literal NvM_ServiceBlockId_31: type=NvM_BlockIdType, value=31
    port-api-option enable-take-address=false, indirect-api=false, port=PS_NVM_BLOCK_DIAGMGR_NTCSTRG:
      port-arg-values:
        integer literal NvM_ServiceBlockId_3: type=NvM_BlockIdType, value=3
    port-api-option enable-take-address=false, indirect-api=false, port=PS_NVM_BLOCK_EPSDEFEATS:
      port-arg-values:
        integer literal NvM_ServiceBlockId_4: type=NvM_BlockIdType, value=4
    port-api-option enable-take-address=false, indirect-api=false, port=PS_Rte_NvmBlock_AbsHwPos_EOLVehCntrOffset:
      port-arg-values:
        integer literal NvM_ServiceBlockId_41: type=NvM_BlockIdType, value=41
    port-api-option enable-take-address=false, indirect-api=false, port=PS_Rte_NvmBlock_AstLmt_SteerAsstDefeat:
      port-arg-values:
        integer literal NvM_ServiceBlockId_39: type=NvM_BlockIdType, value=39
    port-api-option enable-take-address=false, indirect-api=false, port=PS_Rte_NvmBlock_AvgFricLrn_AvgFricLrnData:
      port-arg-values:
        integer literal NvM_ServiceBlockId_33: type=NvM_BlockIdType, value=33
    port-api-option enable-take-address=false, indirect-api=false, port=PS_Rte_NvmBlock_BatteryVoltage_OvervoltageData:
      port-arg-values:
        integer literal NvM_ServiceBlockId_22: type=NvM_BlockIdType, value=22
    port-api-option enable-take-address=false, indirect-api=false, port=PS_Rte_NvmBlock_CmMtrCurr_CurrTempOffset:
      port-arg-values:
        integer literal NvM_ServiceBlockId_35: type=NvM_BlockIdType, value=35
    port-api-option enable-take-address=false, indirect-api=false, port=PS_Rte_NvmBlock_CmMtrCurr_ShCurrCal:
      port-arg-values:
        integer literal NvM_ServiceBlockId_36: type=NvM_BlockIdType, value=36
    port-api-option enable-take-address=false, indirect-api=false, port=PS_Rte_NvmBlock_CurrParamComp_EOLNomMtrParam:
      port-arg-values:
        integer literal NvM_ServiceBlockId_10: type=NvM_BlockIdType, value=10
    port-api-option enable-take-address=false, indirect-api=false, port=PS_Rte_NvmBlock_DiagSvc_SparePartNumberData:
      port-arg-values:
        integer literal NvM_ServiceBlockId_43: type=NvM_BlockIdType, value=43
    port-api-option enable-take-address=false, indirect-api=false, port=PS_Rte_NvmBlock_DiagSvc_SupplierIdentifierData:
      port-arg-values:
        integer literal NvM_ServiceBlockId_42: type=NvM_BlockIdType, value=42
    port-api-option enable-take-address=false, indirect-api=false, port=PS_Rte_NvmBlock_DiagSvc_TuningSetSelectData:
      port-arg-values:
        integer literal NvM_ServiceBlockId_26: type=NvM_BlockIdType, value=26
    port-api-option enable-take-address=false, indirect-api=false, port=PS_Rte_NvmBlock_DigHwTrqSENT_DigTrqTrim:
      port-arg-values:
        integer literal NvM_ServiceBlockId_34: type=NvM_BlockIdType, value=34
    port-api-option enable-take-address=false, indirect-api=false, port=PS_Rte_NvmBlock_DigMSB_DigMSBEOLData:
      port-arg-values:
        integer literal NvM_ServiceBlockId_23: type=NvM_BlockIdType, value=23
    port-api-option enable-take-address=false, indirect-api=false, port=PS_Rte_NvmBlock_LrnEOT_LearnedEOT:
      port-arg-values:
        integer literal NvM_ServiceBlockId_32: type=NvM_BlockIdType, value=32
    port-api-option enable-take-address=false, indirect-api=false, port=PS_Rte_NvmBlock_Polarity_Polarity_Cnt_Str:
      port-arg-values:
        integer literal NvM_ServiceBlockId_2: type=NvM_BlockIdType, value=2
    port-api-option enable-take-address=false, indirect-api=false, port=PS_Rte_NvmBlock_StaMd_CloseCheckData:
      port-arg-values:
        integer literal NvM_ServiceBlockId_19: type=NvM_BlockIdType, value=19
    port-api-option enable-take-address=false, indirect-api=false, port=PS_Rte_NvmBlock_StaMd_TypeHRamBuffer:
      port-arg-values:
        integer literal NvM_ServiceBlockId_6: type=NvM_BlockIdType, value=6
    port-api-option enable-take-address=false, indirect-api=false, port=PS_Rte_NvmBlock_ThrmlDutyCycle_ThrmlDutyCycle_FltStVal:
      port-arg-values:
        integer literal NvM_ServiceBlockId_30: type=NvM_BlockIdType, value=30
    port-api-option enable-take-address=false, indirect-api=false, port=PS_Rte_NvmBlock_TrqCanc_CogTrqCal:
      port-arg-values:
        integer literal NvM_ServiceBlockId_37: type=NvM_BlockIdType, value=37
    port-api-option enable-take-address=false, indirect-api=false, port=PS_Rte_NvmBlock_TrqCanc_CogTrqRplComp:
      port-arg-values:
        integer literal NvM_ServiceBlockId_38: type=NvM_BlockIdType, value=38
    port-api-option enable-take-address=false, indirect-api=false, port=PS_Rte_NvmBlock_TrqCmdScl_TorqueCmdSF_Uls_f32:
      port-arg-values:
        integer literal NvM_ServiceBlockId_40: type=NvM_BlockIdType, value=40
    port-api-option enable-take-address=false, indirect-api=false, port=PS_Rte_NvmBlock_VehDyn_MotPosReset:
      port-arg-values:
        integer literal NvM_ServiceBlockId_44: type=NvM_BlockIdType, value=44
    9 x runnable:
      EraseBlock: can-be-invoked-concurrently=true, symbol=NvM_EraseNvBlock
      GetErrorStatus: can-be-invoked-concurrently=true, symbol=NvM_GetErrorStatus
      InvalidateNvBlock: can-be-invoked-concurrently=true, symbol=NvM_InvalidateNvBlock
      NvM_MainFunction
      ReadBlock: can-be-invoked-concurrently=true, symbol=NvM_ReadBlock
      RestoreBlockDefaults: can-be-invoked-concurrently=true, symbol=NvM_RestoreBlockDefaults
      SetBlockProtection: can-be-invoked-concurrently=true, symbol=NvM_SetBlockProtection
      SetRamBlockStatus: can-be-invoked-concurrently=true, symbol=NvM_SetRamBlockStatus
      WriteBlock: can-be-invoked-concurrently=true, symbol=NvM_WriteBlock
  service component type NvM: category=ServiceComponent  # Software Component description for NvM generated from Ecuc Package: ActiveEcuC
    88 x provide port:
      PAdmin_ConfigBlock: server-com-spec{operation=SetBlockProtection, queue-length=1}, provided-interface=NvM_Administration  # P-Port Prototype of NvM_Administration for NVRAM Block ConfigBlock
      PAdmin_Deprecated_NVM_BLOCK_DEM: server-com-spec{operation=SetBlockProtection, queue-length=1}, provided-interface=NvM_Administration  # P-Port Prototype of NvM_Administration for NVRAM Block Deprecated_NVM_BLOCK_DEM
      PAdmin_Deprecated_NvmBlock_AbsHwPos_EOLVehCntrOffset: server-com-spec{operation=SetBlockProtection, queue-length=1}, provided-interface=NvM_Administration  # P-Port Prototype of NvM_Administration for NVRAM Block Deprecated_NvmBlock_AbsHwPos_EOLVehCntrOffset
      PAdmin_Deprecated_NvmBlock_AbsHwPos_EOLVehCntrOffset1: server-com-spec{operation=SetBlockProtection, queue-length=1}, provided-interface=NvM_Administration  # P-Port Prototype of NvM_Administration for NVRAM Block Deprecated_NvmBlock_AbsHwPos_EOLVehCntrOffset1
      PAdmin_Deprecated_NvmBlock_AstLmt_SteerAsstDefeat: server-com-spec{operation=SetBlockProtection, queue-length=1}, provided-interface=NvM_Administration  # P-Port Prototype of NvM_Administration for NVRAM Block Deprecated_NvmBlock_AstLmt_SteerAsstDefeat
      PAdmin_Deprecated_NvmBlock_AvgFricLrn_AvgFricLrnData: server-com-spec{operation=SetBlockProtection, queue-length=1}, provided-interface=NvM_Administration  # P-Port Prototype of NvM_Administration for NVRAM Block Deprecated_NvmBlock_AvgFricLrn_AvgFricLrnData
      PAdmin_Deprecated_NvmBlock_CmMtrCurr_CurrTempOffset: server-com-spec{operation=SetBlockProtection, queue-length=1}, provided-interface=NvM_Administration  # P-Port Prototype of NvM_Administration for NVRAM Block Deprecated_NvmBlock_CmMtrCurr_CurrTempOffset
      PAdmin_Deprecated_NvmBlock_CmMtrCurr_ShCurrCal: server-com-spec{operation=SetBlockProtection, queue-length=1}, provided-interface=NvM_Administration  # P-Port Prototype of NvM_Administration for NVRAM Block Deprecated_NvmBlock_CmMtrCurr_ShCurrCal
      PAdmin_Deprecated_NvmBlock_DigHwTrqSENT_DigTrqTrim: server-com-spec{operation=SetBlockProtection, queue-length=1}, provided-interface=NvM_Administration  # P-Port Prototype of NvM_Administration for NVRAM Block Deprecated_NvmBlock_DigHwTrqSENT_DigTrqTrim
      PAdmin_Deprecated_NvmBlock_LrnEOT_LearnedEOT: server-com-spec{operation=SetBlockProtection, queue-length=1}, provided-interface=NvM_Administration  # P-Port Prototype of NvM_Administration for NVRAM Block Deprecated_NvmBlock_LrnEOT_LearnedEOT
      PAdmin_Deprecated_NvmBlock_TrqCanc_CogTrqCal: server-com-spec{operation=SetBlockProtection, queue-length=1}, provided-interface=NvM_Administration  # P-Port Prototype of NvM_Administration for NVRAM Block Deprecated_NvmBlock_TrqCanc_CogTrqCal
      PAdmin_Deprecated_NvmBlock_TrqCanc_CogTrqRplComp: server-com-spec{operation=SetBlockProtection, queue-length=1}, provided-interface=NvM_Administration  # P-Port Prototype of NvM_Administration for NVRAM Block Deprecated_NvmBlock_TrqCanc_CogTrqRplComp
      PAdmin_Deprecated_NvmBlock_TrqCmdScl_TorqueCmdSF_Uls_f32: server-com-spec{operation=SetBlockProtection, queue-length=1}, provided-interface=NvM_Administration  # P-Port Prototype of NvM_Administration for NVRAM Block Deprecated_NvmBlock_TrqCmdScl_TorqueCmdSF_Uls_f32
      PAdmin_NVM_BLOCK_CMS_ECUHWPN: server-com-spec{operation=SetBlockProtection, queue-length=1}, provided-interface=NvM_Administration  # P-Port Prototype of NvM_Administration for NVRAM Block NVM_BLOCK_CMS_ECUHWPN
      PAdmin_NVM_BLOCK_CMS_ECUSRLNUM: server-com-spec{operation=SetBlockProtection, queue-length=1}, provided-interface=NvM_Administration  # P-Port Prototype of NvM_Administration for NVRAM Block NVM_BLOCK_CMS_ECUSRLNUM
      PAdmin_NVM_BLOCK_CMS_EPSSRLNUM: server-com-spec{operation=SetBlockProtection, queue-length=1}, provided-interface=NvM_Administration  # P-Port Prototype of NvM_Administration for NVRAM Block NVM_BLOCK_CMS_EPSSRLNUM
      PAdmin_NVM_BLOCK_CMS_IGNCNTR: server-com-spec{operation=SetBlockProtection, queue-length=1}, provided-interface=NvM_Administration  # P-Port Prototype of NvM_Administration for NVRAM Block NVM_BLOCK_CMS_IGNCNTR
      PAdmin_NVM_BLOCK_CMS_NXTRMANUFSCRATCHPAD: server-com-spec{operation=SetBlockProtection, queue-length=1}, provided-interface=NvM_Administration  # P-Port Prototype of NvM_Administration for NVRAM Block NVM_BLOCK_CMS_NXTRMANUFSCRATCHPAD
      PAdmin_NVM_BLOCK_CMS_NXTRMEC: server-com-spec{operation=SetBlockProtection, queue-length=1}, provided-interface=NvM_Administration  # P-Port Prototype of NvM_Administration for NVRAM Block NVM_BLOCK_CMS_NXTRMEC
      PAdmin_NVM_BLOCK_DIAGMGR_BLACKBOX: server-com-spec{operation=SetBlockProtection, queue-length=1}, provided-interface=NvM_Administration  # P-Port Prototype of NvM_Administration for NVRAM Block NVM_BLOCK_DIAGMGR_BLACKBOX
      PAdmin_NVM_BLOCK_DIAGMGR_LATCHCNTRS: server-com-spec{operation=SetBlockProtection, queue-length=1}, provided-interface=NvM_Administration  # P-Port Prototype of NvM_Administration for NVRAM Block NVM_BLOCK_DIAGMGR_LATCHCNTRS
      PAdmin_NVM_BLOCK_DIAGMGR_NTCSTRG: server-com-spec{operation=SetBlockProtection, queue-length=1}, provided-interface=NvM_Administration  # P-Port Prototype of NvM_Administration for NVRAM Block NVM_BLOCK_DIAGMGR_NTCSTRG
      PAdmin_NVM_BLOCK_EPSDEFEATS: server-com-spec{operation=SetBlockProtection, queue-length=1}, provided-interface=NvM_Administration  # P-Port Prototype of NvM_Administration for NVRAM Block NVM_BLOCK_EPSDEFEATS
      PAdmin_Rte_NvmBlock_AbsHwPos_EOLVehCntrOffset: server-com-spec{operation=SetBlockProtection, queue-length=1}, provided-interface=NvM_Administration  # P-Port Prototype of NvM_Administration for NVRAM Block Rte_NvmBlock_AbsHwPos_EOLVehCntrOffset
      PAdmin_Rte_NvmBlock_AstLmt_SteerAsstDefeat: server-com-spec{operation=SetBlockProtection, queue-length=1}, provided-interface=NvM_Administration  # P-Port Prototype of NvM_Administration for NVRAM Block Rte_NvmBlock_AstLmt_SteerAsstDefeat
      PAdmin_Rte_NvmBlock_AvgFricLrn_AvgFricLrnData: server-com-spec{operation=SetBlockProtection, queue-length=1}, provided-interface=NvM_Administration  # P-Port Prototype of NvM_Administration for NVRAM Block Rte_NvmBlock_AvgFricLrn_AvgFricLrnData
      PAdmin_Rte_NvmBlock_BatteryVoltage_OvervoltageData: server-com-spec{operation=SetBlockProtection, queue-length=1}, provided-interface=NvM_Administration  # P-Port Prototype of NvM_Administration for NVRAM Block Rte_NvmBlock_BatteryVoltage_OvervoltageData
      PAdmin_Rte_NvmBlock_CmMtrCurr_CurrTempOffset: server-com-spec{operation=SetBlockProtection, queue-length=1}, provided-interface=NvM_Administration  # P-Port Prototype of NvM_Administration for NVRAM Block Rte_NvmBlock_CmMtrCurr_CurrTempOffset
      PAdmin_Rte_NvmBlock_CmMtrCurr_ShCurrCal: server-com-spec{operation=SetBlockProtection, queue-length=1}, provided-interface=NvM_Administration  # P-Port Prototype of NvM_Administration for NVRAM Block Rte_NvmBlock_CmMtrCurr_ShCurrCal
      PAdmin_Rte_NvmBlock_CurrParamComp_EOLNomMtrParam: server-com-spec{operation=SetBlockProtection, queue-length=1}, provided-interface=NvM_Administration  # P-Port Prototype of NvM_Administration for NVRAM Block Rte_NvmBlock_CurrParamComp_EOLNomMtrParam
      PAdmin_Rte_NvmBlock_DiagSvc_SparePartNumberData: server-com-spec{operation=SetBlockProtection, queue-length=1}, provided-interface=NvM_Administration  # P-Port Prototype of NvM_Administration for NVRAM Block Rte_NvmBlock_DiagSvc_SparePartNumberData
      PAdmin_Rte_NvmBlock_DiagSvc_SupplierIdentifierData: server-com-spec{operation=SetBlockProtection, queue-length=1}, provided-interface=NvM_Administration  # P-Port Prototype of NvM_Administration for NVRAM Block Rte_NvmBlock_DiagSvc_SupplierIdentifierData
      PAdmin_Rte_NvmBlock_DiagSvc_TuningSetSelectData: server-com-spec{operation=SetBlockProtection, queue-length=1}, provided-interface=NvM_Administration  # P-Port Prototype of NvM_Administration for NVRAM Block Rte_NvmBlock_DiagSvc_TuningSetSelectData
      PAdmin_Rte_NvmBlock_DigHwTrqSENT_DigTrqTrim: server-com-spec{operation=SetBlockProtection, queue-length=1}, provided-interface=NvM_Administration  # P-Port Prototype of NvM_Administration for NVRAM Block Rte_NvmBlock_DigHwTrqSENT_DigTrqTrim
      PAdmin_Rte_NvmBlock_DigMSB_DigMSBEOLData: server-com-spec{operation=SetBlockProtection, queue-length=1}, provided-interface=NvM_Administration  # P-Port Prototype of NvM_Administration for NVRAM Block Rte_NvmBlock_DigMSB_DigMSBEOLData
      PAdmin_Rte_NvmBlock_LrnEOT_LearnedEOT: server-com-spec{operation=SetBlockProtection, queue-length=1}, provided-interface=NvM_Administration  # P-Port Prototype of NvM_Administration for NVRAM Block Rte_NvmBlock_LrnEOT_LearnedEOT
      PAdmin_Rte_NvmBlock_Polarity_Polarity_Cnt_Str: server-com-spec{operation=SetBlockProtection, queue-length=1}, provided-interface=NvM_Administration  # P-Port Prototype of NvM_Administration for NVRAM Block Rte_NvmBlock_Polarity_Polarity_Cnt_Str
      PAdmin_Rte_NvmBlock_StaMd_CloseCheckData: server-com-spec{operation=SetBlockProtection, queue-length=1}, provided-interface=NvM_Administration  # P-Port Prototype of NvM_Administration for NVRAM Block Rte_NvmBlock_StaMd_CloseCheckData
      PAdmin_Rte_NvmBlock_StaMd_TypeHRamBuffer: server-com-spec{operation=SetBlockProtection, queue-length=1}, provided-interface=NvM_Administration  # P-Port Prototype of NvM_Administration for NVRAM Block Rte_NvmBlock_StaMd_TypeHRamBuffer
      PAdmin_Rte_NvmBlock_ThrmlDutyCycle_ThrmlDutyCycle_FltStVal: server-com-spec{operation=SetBlockProtection, queue-length=1}, provided-interface=NvM_Administration  # P-Port Prototype of NvM_Administration for NVRAM Block Rte_NvmBlock_ThrmlDutyCycle_ThrmlDutyCycle_FltStVal
      PAdmin_Rte_NvmBlock_TrqCanc_CogTrqCal: server-com-spec{operation=SetBlockProtection, queue-length=1}, provided-interface=NvM_Administration  # P-Port Prototype of NvM_Administration for NVRAM Block Rte_NvmBlock_TrqCanc_CogTrqCal
      PAdmin_Rte_NvmBlock_TrqCanc_CogTrqRplComp: server-com-spec{operation=SetBlockProtection, queue-length=1}, provided-interface=NvM_Administration  # P-Port Prototype of NvM_Administration for NVRAM Block Rte_NvmBlock_TrqCanc_CogTrqRplComp
      PAdmin_Rte_NvmBlock_TrqCmdScl_TorqueCmdSF_Uls_f32: server-com-spec{operation=SetBlockProtection, queue-length=1}, provided-interface=NvM_Administration  # P-Port Prototype of NvM_Administration for NVRAM Block Rte_NvmBlock_TrqCmdScl_TorqueCmdSF_Uls_f32
      PAdmin_Rte_NvmBlock_VehDyn_MotPosReset: server-com-spec{operation=SetBlockProtection, queue-length=1}, provided-interface=NvM_Administration  # P-Port Prototype of NvM_Administration for NVRAM Block Rte_NvmBlock_VehDyn_MotPosReset
      PS_ConfigBlock: provided-interface=NvM_AC3_SRBS_Srv  # P-Port Prototype of NvM_AC3_SRBS_Srv for NVRAM Block ConfigBlock
        provided-com-specs:
          operation=EraseBlock, queue-length=1
          operation=GetErrorStatus, queue-length=1
          operation=InvalidateNvBlock, queue-length=1
          operation=ReadBlock, queue-length=1
          operation=SetRamBlockStatus, queue-length=1
          operation=WriteBlock, queue-length=1
      PS_Deprecated_NVM_BLOCK_DEM: provided-interface=NvM_AC3_SRBS_Srv  # P-Port Prototype of NvM_AC3_SRBS_Srv for NVRAM Block Deprecated_NVM_BLOCK_DEM
        provided-com-specs:
          operation=EraseBlock, queue-length=1
          operation=GetErrorStatus, queue-length=1
          operation=InvalidateNvBlock, queue-length=1
          operation=ReadBlock, queue-length=1
          operation=SetRamBlockStatus, queue-length=1
          operation=WriteBlock, queue-length=1
      PS_Deprecated_NvmBlock_AbsHwPos_EOLVehCntrOffset: provided-interface=NvM_AC3_SRBS_Srv  # P-Port Prototype of NvM_AC3_SRBS_Srv for NVRAM Block Deprecated_NvmBlock_AbsHwPos_EOLVehCntrOffset
        provided-com-specs:
          operation=EraseBlock, queue-length=1
          operation=GetErrorStatus, queue-length=1
          operation=InvalidateNvBlock, queue-length=1
          operation=ReadBlock, queue-length=1
          operation=SetRamBlockStatus, queue-length=1
          operation=WriteBlock, queue-length=1
      PS_Deprecated_NvmBlock_AbsHwPos_EOLVehCntrOffset1: provided-interface=NvM_AC3_SRBS_Srv  # P-Port Prototype of NvM_AC3_SRBS_Srv for NVRAM Block Deprecated_NvmBlock_AbsHwPos_EOLVehCntrOffset1
        provided-com-specs:
          operation=EraseBlock, queue-length=1
          operation=GetErrorStatus, queue-length=1
          operation=InvalidateNvBlock, queue-length=1
          operation=ReadBlock, queue-length=1
          operation=SetRamBlockStatus, queue-length=1
          operation=WriteBlock, queue-length=1
      PS_Deprecated_NvmBlock_AstLmt_SteerAsstDefeat: provided-interface=NvM_AC3_SRBS_Srv  # P-Port Prototype of NvM_AC3_SRBS_Srv for NVRAM Block Deprecated_NvmBlock_AstLmt_SteerAsstDefeat
        provided-com-specs:
          operation=EraseBlock, queue-length=1
          operation=GetErrorStatus, queue-length=1
          operation=InvalidateNvBlock, queue-length=1
          operation=ReadBlock, queue-length=1
          operation=SetRamBlockStatus, queue-length=1
          operation=WriteBlock, queue-length=1
      PS_Deprecated_NvmBlock_AvgFricLrn_AvgFricLrnData: provided-interface=NvM_AC3_SRBS_Srv  # P-Port Prototype of NvM_AC3_SRBS_Srv for NVRAM Block Deprecated_NvmBlock_AvgFricLrn_AvgFricLrnData
        provided-com-specs:
          operation=EraseBlock, queue-length=1
          operation=GetErrorStatus, queue-length=1
          operation=InvalidateNvBlock, queue-length=1
          operation=ReadBlock, queue-length=1
          operation=SetRamBlockStatus, queue-length=1
          operation=WriteBlock, queue-length=1
      PS_Deprecated_NvmBlock_CmMtrCurr_CurrTempOffset: provided-interface=NvM_AC3_SRBS_Srv  # P-Port Prototype of NvM_AC3_SRBS_Srv for NVRAM Block Deprecated_NvmBlock_CmMtrCurr_CurrTempOffset
        provided-com-specs:
          operation=EraseBlock, queue-length=1
          operation=GetErrorStatus, queue-length=1
          operation=InvalidateNvBlock, queue-length=1
          operation=ReadBlock, queue-length=1
          operation=SetRamBlockStatus, queue-length=1
          operation=WriteBlock, queue-length=1
      PS_Deprecated_NvmBlock_CmMtrCurr_ShCurrCal: provided-interface=NvM_AC3_SRBS_Srv  # P-Port Prototype of NvM_AC3_SRBS_Srv for NVRAM Block Deprecated_NvmBlock_CmMtrCurr_ShCurrCal
        provided-com-specs:
          operation=EraseBlock, queue-length=1
          operation=GetErrorStatus, queue-length=1
          operation=InvalidateNvBlock, queue-length=1
          operation=ReadBlock, queue-length=1
          operation=SetRamBlockStatus, queue-length=1
          operation=WriteBlock, queue-length=1
      PS_Deprecated_NvmBlock_DigHwTrqSENT_DigTrqTrim: provided-interface=NvM_AC3_SRBS_Srv  # P-Port Prototype of NvM_AC3_SRBS_Srv for NVRAM Block Deprecated_NvmBlock_DigHwTrqSENT_DigTrqTrim
        provided-com-specs:
          operation=EraseBlock, queue-length=1
          operation=GetErrorStatus, queue-length=1
          operation=InvalidateNvBlock, queue-length=1
          operation=ReadBlock, queue-length=1
          operation=SetRamBlockStatus, queue-length=1
          operation=WriteBlock, queue-length=1
      PS_Deprecated_NvmBlock_LrnEOT_LearnedEOT: provided-interface=NvM_AC3_SRBS_Srv  # P-Port Prototype of NvM_AC3_SRBS_Srv for NVRAM Block Deprecated_NvmBlock_LrnEOT_LearnedEOT
        provided-com-specs:
          operation=EraseBlock, queue-length=1
          operation=GetErrorStatus, queue-length=1
          operation=InvalidateNvBlock, queue-length=1
          operation=ReadBlock, queue-length=1
          operation=SetRamBlockStatus, queue-length=1
          operation=WriteBlock, queue-length=1
      PS_Deprecated_NvmBlock_TrqCanc_CogTrqCal: provided-interface=NvM_AC3_SRBS_Srv  # P-Port Prototype of NvM_AC3_SRBS_Srv for NVRAM Block Deprecated_NvmBlock_TrqCanc_CogTrqCal
        provided-com-specs:
          operation=EraseBlock, queue-length=1
          operation=GetErrorStatus, queue-length=1
          operation=InvalidateNvBlock, queue-length=1
          operation=ReadBlock, queue-length=1
          operation=SetRamBlockStatus, queue-length=1
          operation=WriteBlock, queue-length=1
      PS_Deprecated_NvmBlock_TrqCanc_CogTrqRplComp: provided-interface=NvM_AC3_SRBS_Srv  # P-Port Prototype of NvM_AC3_SRBS_Srv for NVRAM Block Deprecated_NvmBlock_TrqCanc_CogTrqRplComp
        provided-com-specs:
          operation=EraseBlock, queue-length=1
          operation=GetErrorStatus, queue-length=1
          operation=InvalidateNvBlock, queue-length=1
          operation=ReadBlock, queue-length=1
          operation=SetRamBlockStatus, queue-length=1
          operation=WriteBlock, queue-length=1
      PS_Deprecated_NvmBlock_TrqCmdScl_TorqueCmdSF_Uls_f32: provided-interface=NvM_AC3_SRBS_Srv  # P-Port Prototype of NvM_AC3_SRBS_Srv for NVRAM Block Deprecated_NvmBlock_TrqCmdScl_TorqueCmdSF_Uls_f32
        provided-com-specs:
          operation=EraseBlock, queue-length=1
          operation=GetErrorStatus, queue-length=1
          operation=InvalidateNvBlock, queue-length=1
          operation=ReadBlock, queue-length=1
          operation=SetRamBlockStatus, queue-length=1
          operation=WriteBlock, queue-length=1
      PS_NVM_BLOCK_CMS_ECUHWPN: provided-interface=NvM_AC3_SRBS_Srv  # P-Port Prototype of NvM_AC3_SRBS_Srv for NVRAM Block NVM_BLOCK_CMS_ECUHWPN
        provided-com-specs:
          operation=EraseBlock, queue-length=1
          operation=GetErrorStatus, queue-length=1
          operation=InvalidateNvBlock, queue-length=1
          operation=ReadBlock, queue-length=1
          operation=SetRamBlockStatus, queue-length=1
          operation=WriteBlock, queue-length=1
      PS_NVM_BLOCK_CMS_ECUSRLNUM: provided-interface=NvM_AC3_SRBS_Srv  # P-Port Prototype of NvM_AC3_SRBS_Srv for NVRAM Block NVM_BLOCK_CMS_ECUSRLNUM
        provided-com-specs:
          operation=EraseBlock, queue-length=1
          operation=GetErrorStatus, queue-length=1
          operation=InvalidateNvBlock, queue-length=1
          operation=ReadBlock, queue-length=1
          operation=SetRamBlockStatus, queue-length=1
          operation=WriteBlock, queue-length=1
      PS_NVM_BLOCK_CMS_EPSSRLNUM: provided-interface=NvM_AC3_SRBS_Srv  # P-Port Prototype of NvM_AC3_SRBS_Srv for NVRAM Block NVM_BLOCK_CMS_EPSSRLNUM
        provided-com-specs:
          operation=EraseBlock, queue-length=1
          operation=GetErrorStatus, queue-length=1
          operation=InvalidateNvBlock, queue-length=1
          operation=ReadBlock, queue-length=1
          operation=SetRamBlockStatus, queue-length=1
          operation=WriteBlock, queue-length=1
      PS_NVM_BLOCK_CMS_IGNCNTR: provided-interface=NvM_AC3_SRBS_Srv  # P-Port Prototype of NvM_AC3_SRBS_Srv for NVRAM Block NVM_BLOCK_CMS_IGNCNTR
        provided-com-specs:
          operation=EraseBlock, queue-length=1
          operation=GetErrorStatus, queue-length=1
          operation=InvalidateNvBlock, queue-length=1
          operation=ReadBlock, queue-length=1
          operation=SetRamBlockStatus, queue-length=1
          operation=WriteBlock, queue-length=1
      PS_NVM_BLOCK_CMS_NXTRMANUFSCRATCHPAD: provided-interface=NvM_AC3_SRBS_Srv  # P-Port Prototype of NvM_AC3_SRBS_Srv for NVRAM Block NVM_BLOCK_CMS_NXTRMANUFSCRATCHPAD
        provided-com-specs:
          operation=EraseBlock, queue-length=1
          operation=GetErrorStatus, queue-length=1
          operation=InvalidateNvBlock, queue-length=1
          operation=ReadBlock, queue-length=1
          operation=SetRamBlockStatus, queue-length=1
          operation=WriteBlock, queue-length=1
      PS_NVM_BLOCK_CMS_NXTRMEC: provided-interface=NvM_AC3_SRBS_Srv  # P-Port Prototype of NvM_AC3_SRBS_Srv for NVRAM Block NVM_BLOCK_CMS_NXTRMEC
        provided-com-specs:
          operation=EraseBlock, queue-length=1
          operation=GetErrorStatus, queue-length=1
          operation=InvalidateNvBlock, queue-length=1
          operation=ReadBlock, queue-length=1
          operation=SetRamBlockStatus, queue-length=1
          operation=WriteBlock, queue-length=1
      PS_NVM_BLOCK_DIAGMGR_BLACKBOX: provided-interface=NvM_AC3_SRBS_Srv  # P-Port Prototype of NvM_AC3_SRBS_Srv for NVRAM Block NVM_BLOCK_DIAGMGR_BLACKBOX
        provided-com-specs:
          operation=EraseBlock, queue-length=1
          operation=GetErrorStatus, queue-length=1
          operation=InvalidateNvBlock, queue-length=1
          operation=ReadBlock, queue-length=1
          operation=SetRamBlockStatus, queue-length=1
          operation=WriteBlock, queue-length=1
      PS_NVM_BLOCK_DIAGMGR_LATCHCNTRS: provided-interface=NvM_AC3_SRBS_Srv  # P-Port Prototype of NvM_AC3_SRBS_Srv for NVRAM Block NVM_BLOCK_DIAGMGR_LATCHCNTRS
        provided-com-specs:
          operation=EraseBlock, queue-length=1
          operation=GetErrorStatus, queue-length=1
          operation=InvalidateNvBlock, queue-length=1
          operation=ReadBlock, queue-length=1
          operation=SetRamBlockStatus, queue-length=1
          operation=WriteBlock, queue-length=1
      PS_NVM_BLOCK_DIAGMGR_NTCSTRG: provided-interface=NvM_AC3_SRBS_Srv  # P-Port Prototype of NvM_AC3_SRBS_Srv for NVRAM Block NVM_BLOCK_DIAGMGR_NTCSTRG
        provided-com-specs:
          operation=EraseBlock, queue-length=1
          operation=GetErrorStatus, queue-length=1
          operation=InvalidateNvBlock, queue-length=1
          operation=ReadBlock, queue-length=1
          operation=SetRamBlockStatus, queue-length=1
          operation=WriteBlock, queue-length=1
      PS_NVM_BLOCK_EPSDEFEATS: provided-interface=NvM_AC3_SRBS_Srv  # P-Port Prototype of NvM_AC3_SRBS_Srv for NVRAM Block NVM_BLOCK_EPSDEFEATS
        provided-com-specs:
          operation=EraseBlock, queue-length=1
          operation=GetErrorStatus, queue-length=1
          operation=InvalidateNvBlock, queue-length=1
          operation=ReadBlock, queue-length=1
          operation=SetRamBlockStatus, queue-length=1
          operation=WriteBlock, queue-length=1
      PS_Rte_NvmBlock_AbsHwPos_EOLVehCntrOffset: provided-interface=NvM_AC3_SRBS_Srv  # P-Port Prototype of NvM_AC3_SRBS_Srv for NVRAM Block Rte_NvmBlock_AbsHwPos_EOLVehCntrOffset
        provided-com-specs:
          operation=EraseBlock, queue-length=1
          operation=GetErrorStatus, queue-length=1
          operation=InvalidateNvBlock, queue-length=1
          operation=ReadBlock, queue-length=1
          operation=SetRamBlockStatus, queue-length=1
          operation=WriteBlock, queue-length=1
      PS_Rte_NvmBlock_AstLmt_SteerAsstDefeat: provided-interface=NvM_AC3_SRBS_Srv  # P-Port Prototype of NvM_AC3_SRBS_Srv for NVRAM Block Rte_NvmBlock_AstLmt_SteerAsstDefeat
        provided-com-specs:
          operation=EraseBlock, queue-length=1
          operation=GetErrorStatus, queue-length=1
          operation=InvalidateNvBlock, queue-length=1
          operation=ReadBlock, queue-length=1
          operation=SetRamBlockStatus, queue-length=1
          operation=WriteBlock, queue-length=1
      PS_Rte_NvmBlock_AvgFricLrn_AvgFricLrnData: provided-interface=NvM_AC3_SRBS_Srv_Defs  # P-Port Prototype of NvM_AC3_SRBS_Srv_Defs for NVRAM Block Rte_NvmBlock_AvgFricLrn_AvgFricLrnData
        provided-com-specs:
          operation=EraseBlock, queue-length=1
          operation=GetErrorStatus, queue-length=1
          operation=InvalidateNvBlock, queue-length=1
          operation=ReadBlock, queue-length=1
          operation=RestoreBlockDefaults, queue-length=1
          operation=SetRamBlockStatus, queue-length=1
          operation=WriteBlock, queue-length=1
      PS_Rte_NvmBlock_BatteryVoltage_OvervoltageData: provided-interface=NvM_AC3_SRBS_Srv  # P-Port Prototype of NvM_AC3_SRBS_Srv for NVRAM Block Rte_NvmBlock_BatteryVoltage_OvervoltageData
        provided-com-specs:
          operation=EraseBlock, queue-length=1
          operation=GetErrorStatus, queue-length=1
          operation=InvalidateNvBlock, queue-length=1
          operation=ReadBlock, queue-length=1
          operation=SetRamBlockStatus, queue-length=1
          operation=WriteBlock, queue-length=1
      PS_Rte_NvmBlock_CmMtrCurr_CurrTempOffset: provided-interface=NvM_AC3_SRBS_Srv  # P-Port Prototype of NvM_AC3_SRBS_Srv for NVRAM Block Rte_NvmBlock_CmMtrCurr_CurrTempOffset
        provided-com-specs:
          operation=EraseBlock, queue-length=1
          operation=GetErrorStatus, queue-length=1
          operation=InvalidateNvBlock, queue-length=1
          operation=ReadBlock, queue-length=1
          operation=SetRamBlockStatus, queue-length=1
          operation=WriteBlock, queue-length=1
      PS_Rte_NvmBlock_CmMtrCurr_ShCurrCal: provided-interface=NvM_AC3_SRBS_Srv  # P-Port Prototype of NvM_AC3_SRBS_Srv for NVRAM Block Rte_NvmBlock_CmMtrCurr_ShCurrCal
        provided-com-specs:
          operation=EraseBlock, queue-length=1
          operation=GetErrorStatus, queue-length=1
          operation=InvalidateNvBlock, queue-length=1
          operation=ReadBlock, queue-length=1
          operation=SetRamBlockStatus, queue-length=1
          operation=WriteBlock, queue-length=1
      PS_Rte_NvmBlock_CurrParamComp_EOLNomMtrParam: provided-interface=NvM_AC3_SRBS_Srv  # P-Port Prototype of NvM_AC3_SRBS_Srv for NVRAM Block Rte_NvmBlock_CurrParamComp_EOLNomMtrParam
        provided-com-specs:
          operation=EraseBlock, queue-length=1
          operation=GetErrorStatus, queue-length=1
          operation=InvalidateNvBlock, queue-length=1
          operation=ReadBlock, queue-length=1
          operation=SetRamBlockStatus, queue-length=1
          operation=WriteBlock, queue-length=1
      PS_Rte_NvmBlock_DiagSvc_SparePartNumberData: provided-interface=NvM_AC3_SRBS_Srv  # P-Port Prototype of NvM_AC3_SRBS_Srv for NVRAM Block Rte_NvmBlock_DiagSvc_SparePartNumberData
        provided-com-specs:
          operation=EraseBlock, queue-length=1
          operation=GetErrorStatus, queue-length=1
          operation=InvalidateNvBlock, queue-length=1
          operation=ReadBlock, queue-length=1
          operation=SetRamBlockStatus, queue-length=1
          operation=WriteBlock, queue-length=1
      PS_Rte_NvmBlock_DiagSvc_SupplierIdentifierData: provided-interface=NvM_AC3_SRBS_Srv  # P-Port Prototype of NvM_AC3_SRBS_Srv for NVRAM Block Rte_NvmBlock_DiagSvc_SupplierIdentifierData
        provided-com-specs:
          operation=EraseBlock, queue-length=1
          operation=GetErrorStatus, queue-length=1
          operation=InvalidateNvBlock, queue-length=1
          operation=ReadBlock, queue-length=1
          operation=SetRamBlockStatus, queue-length=1
          operation=WriteBlock, queue-length=1
      PS_Rte_NvmBlock_DiagSvc_TuningSetSelectData: provided-interface=NvM_AC3_SRBS_Srv  # P-Port Prototype of NvM_AC3_SRBS_Srv for NVRAM Block Rte_NvmBlock_DiagSvc_TuningSetSelectData
        provided-com-specs:
          operation=EraseBlock, queue-length=1
          operation=GetErrorStatus, queue-length=1
          operation=InvalidateNvBlock, queue-length=1
          operation=ReadBlock, queue-length=1
          operation=SetRamBlockStatus, queue-length=1
          operation=WriteBlock, queue-length=1
      PS_Rte_NvmBlock_DigHwTrqSENT_DigTrqTrim: provided-interface=NvM_AC3_SRBS_Srv  # P-Port Prototype of NvM_AC3_SRBS_Srv for NVRAM Block Rte_NvmBlock_DigHwTrqSENT_DigTrqTrim
        provided-com-specs:
          operation=EraseBlock, queue-length=1
          operation=GetErrorStatus, queue-length=1
          operation=InvalidateNvBlock, queue-length=1
          operation=ReadBlock, queue-length=1
          operation=SetRamBlockStatus, queue-length=1
          operation=WriteBlock, queue-length=1
      PS_Rte_NvmBlock_DigMSB_DigMSBEOLData: provided-interface=NvM_AC3_SRBS_Srv  # P-Port Prototype of NvM_AC3_SRBS_Srv for NVRAM Block Rte_NvmBlock_DigMSB_DigMSBEOLData
        provided-com-specs:
          operation=EraseBlock, queue-length=1
          operation=GetErrorStatus, queue-length=1
          operation=InvalidateNvBlock, queue-length=1
          operation=ReadBlock, queue-length=1
          operation=SetRamBlockStatus, queue-length=1
          operation=WriteBlock, queue-length=1
      PS_Rte_NvmBlock_LrnEOT_LearnedEOT: provided-interface=NvM_AC3_SRBS_Srv_Defs  # P-Port Prototype of NvM_AC3_SRBS_Srv_Defs for NVRAM Block Rte_NvmBlock_LrnEOT_LearnedEOT
        provided-com-specs:
          operation=EraseBlock, queue-length=1
          operation=GetErrorStatus, queue-length=1
          operation=InvalidateNvBlock, queue-length=1
          operation=ReadBlock, queue-length=1
          operation=RestoreBlockDefaults, queue-length=1
          operation=SetRamBlockStatus, queue-length=1
          operation=WriteBlock, queue-length=1
      PS_Rte_NvmBlock_Polarity_Polarity_Cnt_Str: provided-interface=NvM_AC3_SRBS_Srv  # P-Port Prototype of NvM_AC3_SRBS_Srv for NVRAM Block Rte_NvmBlock_Polarity_Polarity_Cnt_Str
        provided-com-specs:
          operation=EraseBlock, queue-length=1
          operation=GetErrorStatus, queue-length=1
          operation=InvalidateNvBlock, queue-length=1
          operation=ReadBlock, queue-length=1
          operation=SetRamBlockStatus, queue-length=1
          operation=WriteBlock, queue-length=1
      PS_Rte_NvmBlock_StaMd_CloseCheckData: provided-interface=NvM_AC3_SRBS_Srv  # P-Port Prototype of NvM_AC3_SRBS_Srv for NVRAM Block Rte_NvmBlock_StaMd_CloseCheckData
        provided-com-specs:
          operation=EraseBlock, queue-length=1
          operation=GetErrorStatus, queue-length=1
          operation=InvalidateNvBlock, queue-length=1
          operation=ReadBlock, queue-length=1
          operation=SetRamBlockStatus, queue-length=1
          operation=WriteBlock, queue-length=1
      PS_Rte_NvmBlock_StaMd_TypeHRamBuffer: provided-interface=NvM_AC3_SRBS_Srv  # P-Port Prototype of NvM_AC3_SRBS_Srv for NVRAM Block Rte_NvmBlock_StaMd_TypeHRamBuffer
        provided-com-specs:
          operation=EraseBlock, queue-length=1
          operation=GetErrorStatus, queue-length=1
          operation=InvalidateNvBlock, queue-length=1
          operation=ReadBlock, queue-length=1
          operation=SetRamBlockStatus, queue-length=1
          operation=WriteBlock, queue-length=1
      PS_Rte_NvmBlock_ThrmlDutyCycle_ThrmlDutyCycle_FltStVal: provided-interface=NvM_AC3_SRBS_Srv  # P-Port Prototype of NvM_AC3_SRBS_Srv for NVRAM Block Rte_NvmBlock_ThrmlDutyCycle_ThrmlDutyCycle_FltStVal
        provided-com-specs:
          operation=EraseBlock, queue-length=1
          operation=GetErrorStatus, queue-length=1
          operation=InvalidateNvBlock, queue-length=1
          operation=ReadBlock, queue-length=1
          operation=SetRamBlockStatus, queue-length=1
          operation=WriteBlock, queue-length=1
      PS_Rte_NvmBlock_TrqCanc_CogTrqCal: provided-interface=NvM_AC3_SRBS_Srv  # P-Port Prototype of NvM_AC3_SRBS_Srv for NVRAM Block Rte_NvmBlock_TrqCanc_CogTrqCal
        provided-com-specs:
          operation=EraseBlock, queue-length=1
          operation=GetErrorStatus, queue-length=1
          operation=InvalidateNvBlock, queue-length=1
          operation=ReadBlock, queue-length=1
          operation=SetRamBlockStatus, queue-length=1
          operation=WriteBlock, queue-length=1
      PS_Rte_NvmBlock_TrqCanc_CogTrqRplComp: provided-interface=NvM_AC3_SRBS_Srv  # P-Port Prototype of NvM_AC3_SRBS_Srv for NVRAM Block Rte_NvmBlock_TrqCanc_CogTrqRplComp
        provided-com-specs:
          operation=EraseBlock, queue-length=1
          operation=GetErrorStatus, queue-length=1
          operation=InvalidateNvBlock, queue-length=1
          operation=ReadBlock, queue-length=1
          operation=SetRamBlockStatus, queue-length=1
          operation=WriteBlock, queue-length=1
      PS_Rte_NvmBlock_TrqCmdScl_TorqueCmdSF_Uls_f32: provided-interface=NvM_AC3_SRBS_Srv  # P-Port Prototype of NvM_AC3_SRBS_Srv for NVRAM Block Rte_NvmBlock_TrqCmdScl_TorqueCmdSF_Uls_f32
        provided-com-specs:
          operation=EraseBlock, queue-length=1
          operation=GetErrorStatus, queue-length=1
          operation=InvalidateNvBlock, queue-length=1
          operation=ReadBlock, queue-length=1
          operation=SetRamBlockStatus, queue-length=1
          operation=WriteBlock, queue-length=1
      PS_Rte_NvmBlock_VehDyn_MotPosReset: provided-interface=NvM_AC3_SRBS_Srv  # P-Port Prototype of NvM_AC3_SRBS_Srv for NVRAM Block Rte_NvmBlock_VehDyn_MotPosReset
        provided-com-specs:
          operation=EraseBlock, queue-length=1
          operation=GetErrorStatus, queue-length=1
          operation=InvalidateNvBlock, queue-length=1
          operation=ReadBlock, queue-length=1
          operation=SetRamBlockStatus, queue-length=1
          operation=WriteBlock, queue-length=1
  swc implementation NvM_Implementation: behavior=NvM_InternalBehavior
    code-descriptors:
      code Code: type=SRC
