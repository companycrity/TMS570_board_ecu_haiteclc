AUTOSAR XML (schema 314)
package /Constant
  4 x constant specification:
    D_NEGONE_CNT_S8
      value:
        integer literal D_NEGONE_CNT_S8: type=SInt8, value=-1
    D_ONE_CNT_S8
      value:
        integer literal D_ONE_CNT_S8: type=SInt8, value=1
    D_ZERO_CNT_S32
      value:
        integer literal D_ZERO_CNT_S32: type=SInt32, value=0
    D_ZERO_CNT_S8
      value:
        integer literal D_ZERO_CNT_S8: type=SInt8, value=0
