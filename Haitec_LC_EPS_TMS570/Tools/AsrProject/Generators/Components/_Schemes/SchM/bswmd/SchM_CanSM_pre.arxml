AUTOSAR XML (schema 3.0.1)
package /MICROSAR
  module config SchM_Rec: definition=SchM, implementation-config-variant=VARIANT-PRE-COMPILE  # Configuration of the SchM (BSW Scheduler) module.
    CanSM (SchMModuleConfiguration): SchMModuleLiteral=CanSM, SchMModuleInclude=CanSM_SchM.h, SchMModuleConfigVersion=1.0.0, SchMModuleImplementationRef=CanSM_Impl
      SCHM_CANSM_INSTANCE_0 (InstanceConfiguration): SchMInstanceLiteral=SCHM_CANSM_INSTANCE_0
        6 x ExclusiveAreaConf, all with SchMExclusiveAreaDescription=(unset):
          CANSM_EXCLUSIVE_AREA_{0..5}: SchMExclusiveAreaLiteral=CANSM_EXCLUSIVE_AREA_{0..5}
    CanSM_MainFunction (SchMMainFunctionMapping): SchMMainFunctionSymbol=CanSM_MainFunction, SchMModuleRef=CanSM
      SchMBswEvent
        SchMBswDerivedTimingEvent: SchMMainFunctionPeriodParamScale=1.0, SchMMainFunctionPeriodParamRef=/MICROSAR/CanSM/CanStateManagerConfiguration/CanSMMainFctCycleTime
