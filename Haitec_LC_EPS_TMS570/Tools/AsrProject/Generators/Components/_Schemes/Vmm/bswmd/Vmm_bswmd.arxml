AUTOSAR XML (schema 3.0.1)
package /MICROSAR
  module definition Vmm: variants pre-compile/link-time
    container VmmGeneral: multiple-configuration-container=true
      boolean VmmDevErrorDetect: set at pre-compile, origin=Vector Informatik, default-value=false  # If 'Development Error Detection' is enabled, all development errors are reported to the Development Error Tracer (DET). The errors are described in the TechnicalReference_Vmm.pdf. Note: In general, the development error detection is recommended during pre-test phase. It is not recommended to enable the development error detection in production code due to increased runtime and ROM needs.
      boolean VmmEcuPassiveMode: set at pre-compile, origin=Vector Informatik, default-value=false  # En-/ disable the Ecu Passive Mode handling of the ECU. If this attribute is enabled/disable, the Ecu Passive Mode attribute of the CanSM/FrSM gets enabled/disabled. (paramter name: CanSMEcuPassiveMode/FrSmEcuPassiveMode)
      reference VmmEcuMConfigurationRef [0..1]: set at pre-compile, origin=Vector Informatik, destination=EcuMConfiguration  # Internaly reference used by loader
      container VmmChannel [1..*]
        reference VmmNetworkHandle: set at link, origin=Vector Informatik, destination=ComMChannel  # Unique handle to identify one certain CAN/FlexRay network. Reference to one of the network handles configured for the ComM.
        reference VmmRxPduGroup [0..1]: set at link, origin=Vector Informatik, destination=ComIPduGroup  # Choose the Rx PDU Group, which is used by the Vmm to start/stop the Rx PDUs which must be send during the communciation control phase for this channel. These Rx PDU Group will be enabled by the Vmm if Rx commnication control is active. The configuration of the Pdu group is optional and must not the same as the BusSM Rx Pdu Group for this channel.
        reference VmmTxPduGroup [0..1]: set at link, origin=Vector Informatik, destination=ComIPduGroup  # Choose the Tx PDU Group, which is used by the Vmm to start/stop the Tx PDUs which must be send during the communciation control phase for this channel. These Tx PDU Group will be enabled by the Vmm if Tx commnication control is active. The configuration of the Pdu group is optional and must not the same as the BusSM Tx Pdu Group for this channel.
    container VectorCommonData
      string BswmdVersion: set at published-information, origin=Vector Informatik, default-value=1.06.01  # Bswmd version
  bsw implementation Vmm_Impl: code-generator=GENy, programming-language=C, sw-major-version=1, sw-minor-version=5, sw-patch-version=1, vendor-id=30, preconfigured-configuration=Vmm_Pre, recommended-configuration=Vmm_Rec, vendor-specific-module-def=Vmm
  module config Vmm_Pre: definition=Vmm
  module config Vmm_Rec: definition=Vmm
