AUTOSAR XML (schema 3.0.1)
package /MICROSAR
  module config SchM_Rec: definition=SchM, implementation-config-variant=VARIANT-PRE-COMPILE  # Configuration of the SchM (BSW Scheduler) module.
    3 x SchMMainFunctionMapping, all with SchMBswUsedOsEvent=SchM_AsyncEvent_1, SchMBswUsedOsAlarm=SchM_Alarm_Async_1, SchMBswActivationOffset=0.002, SchMTaskConfigurationRef=SchM_AsyncTask_1:
      CanTp_MainFunction: SchMPositionInTask=7
      CanTp_MainFunctionRx: SchMPositionInTask=8
      CanTp_MainFunctionTx: SchMPositionInTask=9
