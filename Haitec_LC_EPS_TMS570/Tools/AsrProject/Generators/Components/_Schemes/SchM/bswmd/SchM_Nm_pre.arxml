AUTOSAR XML (schema 3.0.1)
# COPYRIGHT
# Copyright (c) 2011-2012 by Vector Informatik GmbH. All rights reserved.
# This software is copyright protected and proprietary to Vector Informatik GmbH.
# Vector Informatik GmbH grants to you only those rights as set out in the license conditions.
package /MICROSAR
  module config SchM_Rec: definition=SchM, implementation-config-variant=VARIANT-PRE-COMPILE  # Configuration of the SchM (BSW Scheduler) module.
    Nm (SchMModuleConfiguration): SchMModuleLiteral=Nm, SchMModuleInclude=Nm.h, SchMModuleConfigVersion=1.0.0, SchMModuleImplementationRef=Nm_Impl
      SCHM_NM_INSTANCE_0 (InstanceConfiguration): SchMInstanceLiteral=SCHM_NM_INSTANCE_0
        NM_EXCLUSIVE_AREA_0 (ExclusiveAreaConf): SchMExclusiveAreaLiteral=NM_EXCLUSIVE_AREA_0, SchMExclusiveAreaDescription=No interruption by any interrupt allowed
        NM_EXCLUSIVE_AREA_1 (ExclusiveAreaConf): SchMExclusiveAreaLiteral=NM_EXCLUSIVE_AREA_1, SchMExclusiveAreaDescription=No interruption by BusNm tasks allowed
    Nm_MainFunction (SchMMainFunctionMapping): SchMMainFunctionSymbol=Nm_MainFunction, SchMModuleRef=Nm
      SchMBswEvent
        SchMBswDerivedTimingEvent: SchMMainFunctionPeriodParamScale=1.0, SchMMainFunctionPeriodParamRef=/MICROSAR/Nm/NmGlobalConfig/NmCycletimeMainFunction
