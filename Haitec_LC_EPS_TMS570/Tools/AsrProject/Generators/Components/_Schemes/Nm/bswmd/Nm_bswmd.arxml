AUTOSAR XML (schema 3.0.1)
# COPYRIGHT
# Copyright (c) 2009-2012 by Vector Informatik GmbH. All rights reserved.
# This software is copyright protected and proprietary to Vector Informatik GmbH.
# Vector Informatik GmbH grants to you only those rights as set out in the license conditions.
package /MICROSAR
  module definition Nm [0..1]: refined-module-def=Nm, variants pre-compile/link-time  # The Generic Network Management Interface module
    container NmGlobalConfig  # This container contains all global configuration parameters of the Nm Interface.
      integer NmAutosarGatewayRounds: 0..65535, set at pre-compile, default-value=0  # Number of rounds the coordinator shall keep a bus which runs AUTOSAR NM awake after all nodes including itself are ready to sleep (not used).
      boolean NmBusSynchronizationEnabled: set at pre-compile, default-value=false  # Pre-processor switch for enabling bus synchronization support. This option allows the transmission of an asynchronous NM message at any time within Network Mode. This may be required for the synchronized shutdown of networks. Therefore this option is usually only enabled in gateways. Note: Since this is a pre-compile parameter it can only be customized in pre-compile configurations. RESTRICTIONS: If (NmPassiveModeEnabled == True) then (NmBusSynchronizationEnabled = False)
      boolean NmComControlEnabled: set at pre-compile, default-value=false  # Pre-processor switch for enabling the Communication Control support. If this option is enabled an additional API is available that allows to enable and disable the transmission of Network Management Messages in the Normal Operation state. While the transmission is disabled the network cannot be released. Note: Since this is a pre-compile parameter it can only be customized in pre-compile configurations. RESTRICTIONS:If (NmPassiveModeEnabled == True) then (NmComControlEnabled = False)
      boolean NmCoordinatorSupportEnabled: set at pre-compile, default-value=false  # Pre-processor switch for enabling coordination support. This feature allows the coordinated shutdown for all synchronized channels of the node. Additionally all synchronized channels are also (re-)started synchronously, i.e synchronous wake-up is provided. Supported Network Managements are CAN, FlexRay and OSEK (if OSEK NM Support is enabled). Note: Since this is a pre-compile parameter it can only be customized in pre-compile configurations. RESTRICTIONS:If (NmPassiveModeEnabled == True) then (NmCoordinatorSupportEnabled = False)
      float NmCycletimeMainFunction: 0.001..0.255, set at pre-compile in variant pre-compile / link in variant link-time, default-value=0.01  # Nm main function cycle time. Within the AUTOSAR ECU configuration file the value is provided in seconds (float), within GENy and DBC configurations the value is provided in ms (integer). This value defines the period between successive calls of the Main Function of the NM Interface. RESTRICTIONS: Only valid if (NmCoordinatorSupportEnabled == True)
      boolean NmDevErrorDetect: set at pre-compile, default-value=true  # Pre-processor switch for enabling development error detection support. If it is enabled development errors are reported to the Development Error Tracer (Det). The following development errors are reported: - main function call without intialization of network management - service call with invalid channel handle - null pointer has been passed as argument - further coordinator with same priority detected (priority collision) - Sleep bit received under wrong conditions All development errors are reported to the Development Error Tracer. Note: In general, the 'Development Error Detection' is recommended during pre-test phase. It is not recommended to enable it in production code due to increased runtime and ROM needs. Since this is a pre-compile parameter it can only be customized in pre-compile configurations
      boolean NmMultipleChannelsEnabled: set at pre-compile, default-value=false  # Pre-processor switch for enabling channel multiplicity support (not used).
      boolean NmNodeDetectionEnabled: set at pre-compile, default-value=false  # Pre-processor switch for enabling the node detection support. If a Tester is present in the network 'NodeDetectionEnabled' offers the opportunity to detect all present network nodes. Note: Since this is a pre-compile parameter it can only be customized in pre-compile configurations. RESTRICTIONS: If (NmPassiveModeEnabled == True) OR (NmNodeIdEnabled == False) then (NmNodeDetectionEnabled = False)
      boolean NmNodeIdEnabled: set at pre-compile, default-value=false  # Pre-processor switch for enabling the source node identifier. This option provides read access to the local node identifier and to the node identifier received in the last NM message. Note: Since this is a pre-compile parameter it can only be customized in pre-compile configurations.
      integer NmNumberOfChannels: 1..255, set at pre-compile in variant pre-compile / link in variant link-time, default-value=1  # Number of NM channels allowed within one ECU.
      integer NmOsekGatewayRounds: 0..65535, set at pre-compile, default-value=0  # Number of rounds the coordinator shall keep a bus which runs OSEK NM awake after all nodes including itself are ready to sleep (not used).
      boolean NmOsekSupportEnabled: set at pre-compile, default-value=false  # Pre-processor switch for enabling OSEK NM support. If this feature is enabled the NM Interface can control channels with OSEK NM. Note: Since this is a pre-compile parameter it can only be customized in pre-compile configurations. Please take care that the OSEK NM is configured adequate (refer to the Technical Reference for more information). RESTRICTIONS: At least one channe with OSEK NM configured has to be available
      boolean NmPassiveModeEnabled: set at pre-compile, default-value=false  # Pre-processor switch for enabling support of the Passive Mode. If this option is set, the node is not able to send NM messages. This option can be used for nodes that do not require to keep the bus awake. Note: Since this is a pre-compile parameter it can only be customized in pre-compile configurations.
      boolean NmPduRxIndicationEnabled: set at pre-compile, default-value=false  # Pre-processor switch for enabling the PDU Rx Indication. If 'PduRxIndicationEnabled' option is enabled a callback function for every received Pdu will be triggered. Note: Since this is a pre-compile parameter it can only be customized in pre-compile configurations.
      boolean NmRemoteSleepIndEnabled: set at pre-compile, default-value=false  # Pre-processor switch for enabling remote sleep indication support. 'RemoteSleepIndEnabled' is used in gateways to detect when the synchronized shutdown of networks has to be carried out. It comprises Remote Sleep Indication, Remote Sleep Cancelation and checking of the Remote Sleep Indication State. Remote Sleep Indication is notified when your network node is the only one in the whole network that requests bus-communication for 'Remote Sleep Indication Time [ms]'. Remote Sleep Cancelation is notified if any other network node requires the communcation bus while Remote Sleep Indication takes place in your network node. Note: Since this is a pre-compile parameter it can only be customized in pre-compile configurations. RESTRICTIONS: If (NmPassiveModeEnabled == True) then (NmRemoteSleepIndEnabled == False)
      boolean NmStateChangeIndEnabled: set at pre-compile, default-value=false  # Pre-processor switch for enabling the Nm state change notification. This option allows to track every change in the NM state machine due to a callback function triggered on every state change. Note: Since this is a pre-compile parameter it can only be customized in pre-compile configurations.
      boolean NmUserDataEnabled: set at pre-compile, default-value=false  # Pre-processor switch for enabling user data support. This option provides read and write access to the user data. Location of user data in the NM message depends on the message configuration. Note: Since this is a pre-compile parameter it can only be customized in pre-compile configurations.
      boolean NmVersionInfoApi: set at pre-compile, default-value=false  # Pre-processor switch for enabling version info API support. This option provides access to the version information of the Generic Network Management module. Provided informations are Module identifier, Vendor identifier and vendor specific Version numbers. Note: Since this is a pre-compile parameter it can only be customized in pre-compile configurations.
      string NmUserConfigFile: set at pre-compile, origin=Vector Informatik  # User configuration file that shall be part of the Nm configuration. If you want to overwrite or provide own settings in the generated configuration file, you can specify a path to a user defined configuration file. The user defined configuration file will be included at the end of the generated file. Thus definitions in the user defined configuration file can overwrite definitions in the generated configuration file.
      boolean NmMacroLayerEnabled: set at pre-compile, origin=Vector Informatik, default-value=false  # If the NM Interface has no own functionality and the pre-compile configuration variant is available the module can be a macro layer to save ROM, RAM and runtime. Note: Since this is a pre-compile parameter it can only be customized in pre-compile configurations. RESTRICTIONS: If (NmCoordinatorSupportEnabled == True) OR (NmOsekSupportEnabled == TRUE) OR (Number of different BusNms configured > 1) then (NmMacroLayerEnabled = False)
      boolean NmLimpHomeIndication: set at pre-compile, origin=Vector Informatik, default-value=false  # This feature provides callbacks to detect 'Limp Home' in the AUTOSAR NM, i.e. when for a certain time ('NM Messages Timeout Time') no NM message could be sent or received. Note: Since this is a pre-compile parameter it can only be customized in pre-compile configurations. RESTRICTIONS: If (NmPassiveModeEnabled == True) then (NmLimpHomeIndication = False)
      boolean NmProdErrorDetect: set at pre-compile, origin=Vector Informatik, default-value=true  # Enable/disable error reporting to diagnostic event manager. If 'Prod Error Detect' is enabled production errors are reported to the Diagnostic Event Manager (Dem). Note that the Generic NM does currently not contain any DEM errors to be reported. Note: Since this is a pre-compile parameter it can only be customized in pre-compile configurations. For AUTOSAR stacks this parameter shall be set to TRUE.
      boolean NmCoordinatorSyncSupport: set at pre-compile, origin=Vector Informatik, default-value=false  # If two or more coordinators are connected to the same bus, they would keep one another awake. In such a case this extension of the coordinator algorithm can be activated. Please refer to the Technical Reference for more details. RESTRICTIONS: If (NmCoordinatorSupportEnabled == False) then (NmCoordinatorSyncSupport = False)
      enumeration NmCoordinatorSyncPrio: {Low, Middle, High}, set at pre-compile in variant pre-compile / link in variant link-time, origin=Vector Informatik, default-value=Low  # To avoid that two coordinators try to coordinate the same channel actively an unique Coordinator ID for the channel has to be provided. With this ID it can be prioritized which coordinator shall be the main coordinator for the channel. RESTRICTIONS: Only valid if (NmCoordinatorSyncSupport == True)
      integer NmOsekChannel: 0..255, set at pre-compile in variant pre-compile / link in variant link-time, origin=Vector Informatik, default-value=255  # OSEK NM Channel which shall be synchronized. Since the coordination algorithm can only be synchronized with one OSEK NM channel this channel has to be explicitly chosen. Note: The system channel handle shall be entered. RESTRICTIONS: Only valid if (NmOsekSupportEnabled == True) AND (NmCoordinatorSupportEnabled == True)
      function name NmStateChangeIndCallback: set at pre-compile, origin=Vector Informatik  # If a function name is entered into the string field, this function will be called in case of a NM state change. RESTRICTIONS: Only valid if (NmStateChangeIndEnabled == True )
      function name NmRemoteSleepIndCallback: set at pre-compile, origin=Vector Informatik  # If a function name is entered into the string field, this function will be called in case of a NM remote sleep indication. RESTRICTIONS: Only valid if (NmRemoteSleepIndEnabled == True )
      function name NmRemoteSleepCancelCallback: set at pre-compile, origin=Vector Informatik  # If a function name is entered into the string field, this function will be called in case of a NM remote sleep cancellation. RESTRICTIONS: Only valid if (NmRemoteSleepIndEnabled == True )
      function name NmPduReceiveIndCallback: set at pre-compile, origin=Vector Informatik  # If a function name is entered into the string field, this function will be called in case of a NM PDU receive indication. RESTRICTIONS: Only valid if (NmPduRxIndicationEnabled == True )
      function name NmRepeatMessageIndCallback: set at pre-compile, origin=Vector Informatik  # If a function name is entered into the string field, this function will be called in case of a NM repeat message indication. RESTRICTIONS: Only valid if (NmNodeDetectionEnabled == True )
      function name NmTxTimeoutErrorCallback: set at pre-compile, origin=Vector Informatik  # If a function name is entered into the string field, this function will be called in case of a NM transmission error indication. RESTRICTIONS: Only valid if (NmPassiveModeEnabled == True )
      float NmCoordinationShutdownTimer: set at pre-compile in variant pre-compile / link in variant link-time, origin=Vector Informatik  # This value can be used to set the common coordination shutdown time, e.g. if coordination among different clusters (Multiple Coordinators; different timings on independant clusters) is necessary or if the coordination starting point shall be delayed. If the value is 0 GENy will automatically compute the value as maximum of the shutdown timings of the NM channels. If the user sets any other value, this value has to be greater or equal then this computed value. Please refer to the Technical Reference for more details. RESTRICTIONS: Only valid if (NmCoordinatorSupportEnabled == True)
      boolean NmSupportComM21: set at pre-compile, origin=Vector Informatik, default-value=false  # If this feature is enabled the NM Interface supports integration together with an AUTOSAR 2.1 ComM. Note: This feature is OEM-specific. This feature does not support a general 2.1 AUTOSAR stack!
      boolean NmComUserDataEnabled: set at pre-compile, origin=Vector Informatik, default-value=false  # If this feature is enabled the application can set the NM user data via the signal interface of the Com by setting signals of the corresponding NM I-PDU. Note that this feature will disable the API Nm_SetUserData. Since this is a pre-compile parameter it can only be customized in pre-compile configurations. RESTRICTIONS: If (NmPassiveModeEnabled == True) then (NmComUserDataEnabled = False)
      boolean NmStateChangeIndOsekNmEnabled: set at pre-compile, origin=Vector Informatik, default-value=false  # If this feature is enabled the NM Interface provides state change notifications callbacks also for a channel where OSEK NM is configured but only for the transitions 'Bus Sleep' to 'Repeat Message' and 'Wait Bus Sleep' to 'Repeat Message'. Note: Since this is a pre-compile parameter it can only be customized in pre-compile configurations. RESTRICTIONS: If (NmStateChangeIndEnabled == FALSE) then (NmStateChangeIndOsekNmEnabled = False)
      boolean NmExtInitOsekNmEnabled: set at pre-compile, origin=Vector Informatik, default-value=false  # If this feature is enabled the NM Interface provides the possibility to initialize channels where OSEK NM is enabled with the initialization value provided in 'Ext Init Osek Nm State'. Note: This feature is only available if there is at least one NM channel where OSEK NM is configured. Since this is a pre-compile parameter it can only be customized in pre-compile configurations. RESTRICTIONS: If (NmOsekSupportEnabled == False) then (NmExtInitOsekNmEnabled = False)
      enumeration NmExtInitOsekNmState: {NM_CANSLEEP, NM_NORMAL, NM_SLEEPIND}, set at pre-compile in variant pre-compile / link in variant link-time, origin=Vector Informatik, default-value=NM_CANSLEEP  # The value defines in which state OSEK NM is set during initialization. Note: This feature only affects NM channels where OSEK NM is configured. RESTRICTIONS: Only valid if (NmExtInitOsekNmEnabled == True)
      boolean NmGatewayExtEnabled: set at pre-compile, origin=Vector Informatik, default-value=false  # Pre-processor switch for enabling network management gateway extension. This feature allows to shutdown a gateway network when the network is ready to sleep and no other network needs information from this network. Please refer to the Technical Reference for more details. Note: Since this is a pre-compile parameter it can only be customized in pre-compile configurations. RESTRICTIONS:If (NmPassiveModeEnabled == True) then (NmGatewayExtEnabled = False)
      boolean NmDiagGatewayExtEnabled: set at pre-compile, origin=Vector Informatik, default-value=false  # Pre-processor switch for enabling diagnostic gateway extension. This feature provides an additional API to set a specific byte in the NM message for the diagnostic gateway handling. It also enables an additional callback to track changes in this byte for received NM messages. Please refer to the Technical Reference for more details. Note: Since this is a pre-compile parameter it can only be customized in pre-compile configurations. RESTRICTIONS:If (NmPassiveModeEnabled == True) then (NmDiagGatewayExtEnabled = False)
      boolean NmCarWakeUpRxEnabled: set at pre-compile, origin=Vector Informatik, default-value=false  # Pre-processor switch for enabling the Car WakeUp Rx Handling. If this option is enabled the Nm reports a detected Car Wakeup in a received NM message to the upper layer. Note: Since this is a pre-compile parameter it can only be customized in pre-compile configurations.
      boolean NmStateReportFeatureEnabled: set at pre-compile, origin=Vector Informatik, default-value=false  # Pre-processor switch for enabling the feature State Report. If this option is enabled the Nm writes state transition information into user data. Note: Since this is a pre-compile parameter it can only be customized in pre-compile configurations. RESTRICTIONS:If (NmStateChangeIndEnabled == False) then (NmStateReportFeatureEnabled = False)
      function name NmCarWakeUpCallback: set at pre-compile, origin=Vector Informatik  # If a function name is entered into the string field, this function will be called in case of a detected Car Wakeup. RESTRICTIONS: Only valid if (NmCarWakeUpRxEnabled == True )
      string NmCallbacksPrototypeHeader: set at pre-compile in variant pre-compile / link in variant link-time, origin=Vector Informatik  # If any of the additional callback functions of the Nm (State Change Notification, Remote Sleep Indication, Remote Sleep Cancelation Pdu Receive Indication, Repeat Message Indication, Tx Timeout Error Notification or Car Wakeup Indication) is used a header file has to be entered here that contains the prototypes of all used Nm callback functions.
      container NmChannelConfig [1..*]  # This container contains the configuration (parameters) of the bus channel(s). The channel parameter shall be harmonized within the whole communication stack.
        enumeration NmBusType: {NM_BUS_TYPE_CAN, NM_BUS_TYPE_FR, NM_BUS_TYPE_LIN, NM_BUS_TYPE_OSEK, NM_BUS_TYPE_UNDEF}, set at pre-compile in variant pre-compile / link in variant link-time, default-value=NM_BUS_TYPE_CAN  # Identifies the bus type of the channel. LIN is not yet supported.
        integer NmChannelId: 0..255, set at pre-compile in variant pre-compile / link in variant link-time, symbolic-name-value=true, default-value=0  # Channel identification number of the corresponding channel.
        boolean NmSelectiveNmChannel: set at pre-compile in variant pre-compile / link in variant link-time, origin=Vector Informatik, default-value=false  # If the shutdown of a channel shall not be synchronized with the other channels this channel can be set to selective. Therefore the coordination algorithm will not take care for this channel. RESTRICTIONS: Only valid if (NmCoordinatorSupportEnabled == True)
        boolean NmPassiveCoordinatedNmChannel: set at pre-compile in variant pre-compile / link in variant link-time, origin=Vector Informatik, default-value=false  # If the feature is enabled the corresponding channel will always be passively coordinated, i.e. the channel is only kept requested if the ECU requests communication or another actively coordinated channel is not ready to sleep. RESTRICTIONS: Only valid if (NmCoordinatorSyncSupport == True). If (NmSelectiveNmChannel == True) then (NmPassiveCoordinatedNmChannel = False)
        boolean NmStateReportEnabled: set at pre-compile in variant pre-compile / link in variant link-time, origin=Vector Informatik, default-value=false  # If this feature is enabled the Nm will write state transition information into the Com User Data signal provided by 'NmStateReportSignalRef'. RESTRICTIONS: Only valid if (NmStateReportFeatureEnabled == True).
        symbolic name reference NmComMChannelRef: set at pre-compile in variant pre-compile / link in variant link-time, destination=ComMChannel  # Reference to the corresponding ComM Channel.
        symbolic name reference NmStateReportSignalRef [0..1]: set at pre-compile in variant pre-compile / link in variant link-time, origin=Vector Informatik, destination=ComSignal  # Reference to Com Signal where the state transition information shall be written to. RESTRICTIONS: Only valid if (NmStateReportEnabled == True)
    container VectorCommonData
      string BswmdVersion: set at published-information, origin=Vector Informatik, default-value=1.13.04  # Latest bswmd version (REVISION-LABEL)
  bsw implementation Nm_Impl: code-generator=cMICROSAR,GENy, programming-language=C, sw-major-version=2, sw-minor-version=17, sw-patch-version=4, vendor-id=30, ar-major-version=1, ar-minor-version=0, ar-patch-version=0, preconfigured-configuration=Nm_Pre, recommended-configuration=Nm_Rec, vendor-specific-module-def=Nm
  module config Nm_Pre: definition=Nm
  module config Nm_Rec: definition=Nm
