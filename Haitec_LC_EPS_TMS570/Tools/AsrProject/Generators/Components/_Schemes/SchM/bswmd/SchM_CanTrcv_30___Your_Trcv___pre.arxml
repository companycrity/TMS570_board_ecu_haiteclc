AUTOSAR XML (schema 3.0.1)
# COPYRIGHT
# Copyright (c) 2011 by Vector Informatik GmbH. All rights reserved.
# This software is copyright protected and proprietary to Vector Informatik GmbH.
# Vector Informatik GmbH grants to you only those rights as set out in the license conditions.
package /MICROSAR
  module config SchM_Rec: definition=SchM, implementation-config-variant=VARIANT-PRE-COMPILE  # Configuration of the SchM (BSW Scheduler) module.
    CanTrcv_30___Your_Trcv__ (SchMModuleConfiguration):
      SchMModuleLiteral = CanTrcv_30___Your_Trcv__
      SchMModuleInclude = CanTrcv_30___Your_Trcv__.h
      SchMModuleConfigVersion = 1.0.0
      SchMModuleImplementationRef = CanTrcv_Impl
      INSTANCE_0 (InstanceConfiguration): SchMInstanceLiteral=SCHM_CANTRCV_30___YOUR_TRCV___INSTANCE_0
        EXCLUSIVE_AREA_0 (ExclusiveAreaConf):
          SchMExclusiveAreaLiteral = CANTRCV_30___YOUR_TRCV___EXCLUSIVE_AREA_0
          SchMExclusiveAreaDescription = Using to secure atomic Hardware access. this Area should be protected with global interrupt locks.
