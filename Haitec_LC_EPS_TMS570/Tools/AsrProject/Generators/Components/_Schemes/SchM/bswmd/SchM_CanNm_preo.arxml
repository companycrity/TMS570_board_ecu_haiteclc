AUTOSAR XML (schema 3.0.1)
package /MICROSAR
  module config SchM_Rec: definition=SchM, implementation-config-variant=VARIANT-PRE-COMPILE  # Configuration of the SchM (BSW Scheduler) module.
    7 x SchMMainFunctionMapping, all with SchMBswUsedOsEvent=SchM_AsyncEvent_1, SchMBswUsedOsAlarm=SchM_Alarm_Async_1, SchMBswActivationOffset=0.002, SchMTaskConfigurationRef=SchM_AsyncTask_1:
      CanNm_MainFunction_0: SchMPositionInTask=28
      CanNm_MainFunction_1: SchMPositionInTask=29
      CanNm_MainFunction_2: SchMPositionInTask=30
      CanNm_MainFunction_3: SchMPositionInTask=31
      CanNm_MainFunction_4: SchMPositionInTask=32
      CanNm_MainFunction_5: SchMPositionInTask=33
      CanNm_MainFunction_6: SchMPositionInTask=34
