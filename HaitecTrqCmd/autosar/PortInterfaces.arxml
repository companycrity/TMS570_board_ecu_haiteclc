AUTOSAR XML (schema 314)
package /PortInterface
  client server interface AssistLmtFunc_Scom
    operation GetSteeringAssistDefeat
      arg SteeringAsstDefeat_Cnt_lgc: type=Boolean, direction=OUT
    operation ManualTrqCmd
      arg EnableManualCtrl: type=Boolean, direction=IN
      arg ManTrqCmd_MtrNm_f32: type=Float, direction=IN
    operation SetSteeringAssistDefeat
      arg SteeringAsstDefeat_Cnt_lgc: type=Boolean, direction=IN
  client server interface HaitecTrqCmd_SCom
    operation StartCtrl: possible-error=E_NOT_OK
      arg Param_ManTrqCmd_MtrNm_f32: type=Float, direction=IN
      arg Param_DefeatHwTrq_Cnt_lgc: type=Boolean, direction=IN
      arg Param_DefeatTemp_Cnt_lgc: type=Boolean, direction=IN
    operation StopCtrl
    error E_NOT_OK: error-code=1
  4 x sender receiver interface:
    HwTrq_HwNm_f32
      data HwNm_f32: sw-calibration-access=READ-ONLY, type=Float
    MtrVel_MtrRadpS_f32
      data MtrRadpS_f32: sw-calibration-access=READ-ONLY, type=Float
    Temperature_DegC_f32
      data DegC_f32: sw-calibration-access=READ-ONLY, type=Float
    VehSpd_Kph_f32
      data Kph_f32: sw-calibration-access=READ-ONLY, type=Float
