AUTOSAR XML (schema 314)
package /Constant
  6 x constant specification:
    C_INIT_TUNINGSESSIONADDRPTRENUM
      value:
        integer literal C_INIT_TUNINGSESSIONADDRPTRENUM: type=TuningSessionAddrPtrEnum, value=255
    D_FALSE_CNT_LGC
      value:
        boolean literal D_FALSE_CNT_LGC: type=Boolean, value=false
    D_TRUE_CNT_LGC
      value:
        boolean literal D_TRUE_CNT_LGC: type=Boolean, value=true
    D_ZERO_CNT_U16
      value:
        integer literal D_ZERO_CNT_U16: type=UInt16, value=0
    D_ZERO_CNT_U32
      value:
        integer literal D_ZERO_CNT_U32: type=UInt32, value=0
    D_ZERO_ULS_F32
      value:
        real literal D_ZERO_ULS_F32: type=Float, value=0
