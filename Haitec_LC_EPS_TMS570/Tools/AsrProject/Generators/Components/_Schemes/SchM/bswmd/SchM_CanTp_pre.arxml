AUTOSAR XML (schema 3.0.1)
package /MICROSAR
  module config SchM_Rec: definition=SchM, implementation-config-variant=VARIANT-PRE-COMPILE  # Configuration of the SchM (BSW Scheduler) module.
    CanTp (SchMModuleConfiguration): SchMModuleLiteral=CanTp, SchMModuleInclude=CanTp.h, SchMModuleConfigVersion=1.0.0, SchMModuleImplementationRef=CanTp_Impl
      SCHM_CANTP_INSTANCE_0 (InstanceConfiguration): SchMInstanceLiteral=SCHM_CANTP_INSTANCE_0
        CANTP_EXCLUSIVE_AREA_0 (ExclusiveAreaConf): SchMExclusiveAreaLiteral=CANTP_EXCLUSIVE_AREA_0, SchMExclusiveAreaDescription=(unset)
        CANTP_EXCLUSIVE_AREA_1 (ExclusiveAreaConf): SchMExclusiveAreaLiteral=CANTP_EXCLUSIVE_AREA_1, SchMExclusiveAreaDescription=(unset)
    3 x SchMMainFunctionMapping, all with SchMModuleRef=CanTp:
      CanTp_MainFunction: SchMMainFunctionSymbol=CanTp_MainFunction
        SchMBswEvent
          SchMBswDerivedTimingEvent: SchMMainFunctionPeriodParamScale=1.0, SchMMainFunctionPeriodParamRef=/MICROSAR/CanTp/CanTpGeneral/CanTpMainFunctionPeriod
      CanTp_MainFunctionRx: SchMMainFunctionSymbol=CanTp_MainFunctionRx
        SchMBswEvent
          SchMBswDerivedTimingEvent: SchMMainFunctionPeriodParamScale=1.0, SchMMainFunctionPeriodParamRef=/MICROSAR/CanTp/CanTpGeneral/CanTpMainFunctionPeriod
      CanTp_MainFunctionTx: SchMMainFunctionSymbol=CanTp_MainFunctionTx
        SchMBswEvent
          SchMBswDerivedTimingEvent: SchMMainFunctionPeriodParamScale=1.0, SchMMainFunctionPeriodParamRef=/MICROSAR/CanTp/CanTpGeneral/CanTpMainFunctionPeriod
