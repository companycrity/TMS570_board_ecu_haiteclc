AUTOSAR XML (schema 3.0.1)
package /MICROSAR
  module config SchM_Rec: definition=SchM, implementation-config-variant=VARIANT-PRE-COMPILE  # Configuration of the SchM (BSW Scheduler) module.
    11 x SchMMainFunctionMapping, all with SchMBswUsedOsEvent=SchM_AsyncEvent_1, SchMBswUsedOsAlarm=SchM_Alarm_Async_1, SchMBswActivationOffset=0, SchMTaskConfigurationRef=SchM_AsyncTask_1:
      ComM_MainFunction_0: SchMPositionInTask=48
      ComM_MainFunction_1: SchMPositionInTask=49
      ComM_MainFunction_2: SchMPositionInTask=50
      ComM_MainFunction_3: SchMPositionInTask=51
      ComM_MainFunction_4: SchMPositionInTask=52
      ComM_MainFunction_5: SchMPositionInTask=53
      ComM_MainFunction_6: SchMPositionInTask=54
      ComM_MainFunction_7: SchMPositionInTask=55
      ComM_MainFunction_8: SchMPositionInTask=56
      ComM_MainFunction_9: SchMPositionInTask=57
      ComM_MainFunction_10: SchMPositionInTask=58
