AUTOSAR XML (schema 3.0.1)
package /MICROSAR
  module config SchM_Rec: definition=SchM, implementation-config-variant=VARIANT-PRE-COMPILE  # Configuration of the SchM (BSW Scheduler) module.
    3 x SchMMainFunctionMapping, all with SchMBswUsedOsEvent=SchM_SyncEvent_1, SchMBswUsedOsAlarm=SchM_Alarm_Sync_1, SchMBswActivationOffset=0.004, SchMTaskConfigurationRef=SchM_SyncTask_1:
      Com_MainFunctionRx: SchMPositionInTask=2
      Com_MainFunctionRouteSignals: SchMPositionInTask=3
      Com_MainFunctionTx: SchMPositionInTask=4
