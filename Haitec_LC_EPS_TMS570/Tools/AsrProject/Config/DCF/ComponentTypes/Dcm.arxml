AUTOSAR XML (schema 314)
package /ComponentType
  internal behavior Dcm_InternalBehavior: component=Dcm
    timing event TMT_Dcm_MainFunction: start-on-event=Dcm_MainFunction, period=0.01
    operation invoked event OIT_GetSecurityLevel_DCMServices_GetSecurityLevel: start-on-event=GetSecurityLevel, operation=DCMServices.GetSecurityLevel
    operation invoked event OIT_GetSesCtrlType_DCMServices_GetSesCtrlType: start-on-event=GetSesCtrlType, operation=DCMServices.GetSesCtrlType
    port-api-options:
      enable-take-address=true, indirect-api=false, port=DCMServices
      enable-take-address=true, indirect-api=false, port=DidServices_0x0100
      enable-take-address=true, indirect-api=false, port=DidServices_0xf180
      enable-take-address=true, indirect-api=false, port=DidServices_0xf187
      enable-take-address=true, indirect-api=false, port=DidServices_0xf18a
      enable-take-address=true, indirect-api=false, port=DidServices_0xf18c
      enable-take-address=true, indirect-api=false, port=DidServices_0xf191
      enable-take-address=true, indirect-api=false, port=DidServices_0xf{193..195}
      enable-take-address=true, indirect-api=false, port=DidServices_0xfd01
      enable-take-address=true, indirect-api=false, port=DidServices_0xfd02
      enable-take-address=true, indirect-api=false, port=DidServices_0xfd07
      enable-take-address=true, indirect-api=false, port=DidServices_0xfd0d
      enable-take-address=true, indirect-api=false, port=DidServices_0xfd0e
      enable-take-address=true, indirect-api=false, port=DidServices_0xfd{10..14}
      enable-take-address=true, indirect-api=false, port=DidServices_0xfd17
      enable-take-address=true, indirect-api=false, port=DidServices_0xfd19
      enable-take-address=true, indirect-api=false, port=DidServices_0xfd1a
      enable-take-address=true, indirect-api=false, port=DidServices_0xfd1b
      enable-take-address=true, indirect-api=false, port=DidServices_0xfd1c
      enable-take-address=true, indirect-api=false, port=DidServices_0xfd1e
      enable-take-address=true, indirect-api=false, port=DidServices_0xfd20
      enable-take-address=true, indirect-api=false, port=DidServices_0xfd21
      enable-take-address=true, indirect-api=false, port=DidServices_0xfd23
      enable-take-address=true, indirect-api=false, port=DidServices_0xfd{25..27}
      enable-take-address=true, indirect-api=false, port=DidServices_0xfd{29..31}
      enable-take-address=true, indirect-api=false, port=DidServices_0xfda{1..3}
      enable-take-address=true, indirect-api=false, port=DidServices_0xfdac
      enable-take-address=true, indirect-api=false, port=DidServices_0xfdad
      enable-take-address=true, indirect-api=false, port=DidServices_0xfdae
      enable-take-address=true, indirect-api=false, port=DidServices_0xfdaf
      enable-take-address=true, indirect-api=false, port=DidServices_0xfdb{0..7}
      enable-take-address=true, indirect-api=false, port=DidServices_0xfe00
      enable-take-address=true, indirect-api=false, port=RoutineServices_0xf000
      enable-take-address=true, indirect-api=false, port=RoutineServices_0xf001
      enable-take-address=true, indirect-api=false, port=RoutineServices_0xf{003..005}
      enable-take-address=true, indirect-api=false, port=RoutineServices_0xf008
      enable-take-address=true, indirect-api=false, port=RoutineServices_0xf009
      enable-take-address=true, indirect-api=false, port=RoutineServices_0xf0ff
      enable-take-address=true, indirect-api=false, port=RoutineServices_0xfee0
      enable-take-address=true, indirect-api=false, port=SecurityAccess_1
      enable-take-address=true, indirect-api=false, port=SessionControl
    runnable Dcm_MainFunction
      180 x sync call, all with timeout=0:
        SC_DidServices_0x0100_ConditionCheckRead: operation=DidServices_0x0100.ConditionCheckRead
        SC_DidServices_0x0100_ConditionCheckWrite: operation=DidServices_0x0100.ConditionCheckWrite
        SC_DidServices_0x0100_ReadData: operation=DidServices_0x0100.ReadData
        SC_DidServices_0x0100_WriteData: operation=DidServices_0x0100.WriteData
        SC_DidServices_0xf180_ConditionCheckRead: operation=DidServices_0xf180.ConditionCheckRead
        SC_DidServices_0xf180_ReadData: operation=DidServices_0xf180.ReadData
        SC_DidServices_0xf187_ConditionCheckRead: operation=DidServices_0xf187.ConditionCheckRead
        SC_DidServices_0xf187_ConditionCheckWrite: operation=DidServices_0xf187.ConditionCheckWrite
        SC_DidServices_0xf187_ReadData: operation=DidServices_0xf187.ReadData
        SC_DidServices_0xf187_WriteData: operation=DidServices_0xf187.WriteData
        SC_DidServices_0xf18a_ConditionCheckRead: operation=DidServices_0xf18a.ConditionCheckRead
        SC_DidServices_0xf18a_ConditionCheckWrite: operation=DidServices_0xf18a.ConditionCheckWrite
        SC_DidServices_0xf18a_ReadData: operation=DidServices_0xf18a.ReadData
        SC_DidServices_0xf18a_WriteData: operation=DidServices_0xf18a.WriteData
        SC_DidServices_0xf18c_ConditionCheckRead: operation=DidServices_0xf18c.ConditionCheckRead
        SC_DidServices_0xf18c_ReadData: operation=DidServices_0xf18c.ReadData
        SC_DidServices_0xf191_ConditionCheckRead: operation=DidServices_0xf191.ConditionCheckRead
        SC_DidServices_0xf191_ReadData: operation=DidServices_0xf191.ReadData
        SC_DidServices_0xf193_ConditionCheckRead: operation=DidServices_0xf193.ConditionCheckRead
        SC_DidServices_0xf193_ReadData: operation=DidServices_0xf193.ReadData
        SC_DidServices_0xf194_ConditionCheckRead: operation=DidServices_0xf194.ConditionCheckRead
        SC_DidServices_0xf194_ReadData: operation=DidServices_0xf194.ReadData
        SC_DidServices_0xf195_ConditionCheckRead: operation=DidServices_0xf195.ConditionCheckRead
        SC_DidServices_0xf195_ReadData: operation=DidServices_0xf195.ReadData
        SC_DidServices_0xfd01_ConditionCheckRead: operation=DidServices_0xfd01.ConditionCheckRead
        SC_DidServices_0xfd01_ReadData: operation=DidServices_0xfd01.ReadData
        SC_DidServices_0xfd02_ConditionCheckRead: operation=DidServices_0xfd02.ConditionCheckRead
        SC_DidServices_0xfd02_ConditionCheckWrite: operation=DidServices_0xfd02.ConditionCheckWrite
        SC_DidServices_0xfd02_ReadData: operation=DidServices_0xfd02.ReadData
        SC_DidServices_0xfd02_WriteData: operation=DidServices_0xfd02.WriteData
        SC_DidServices_0xfd07_ConditionCheckRead: operation=DidServices_0xfd07.ConditionCheckRead
        SC_DidServices_0xfd07_ConditionCheckWrite: operation=DidServices_0xfd07.ConditionCheckWrite
        SC_DidServices_0xfd07_ReadData: operation=DidServices_0xfd07.ReadData
        SC_DidServices_0xfd07_WriteData: operation=DidServices_0xfd07.WriteData
        SC_DidServices_0xfd0d_ConditionCheckRead: operation=DidServices_0xfd0d.ConditionCheckRead
        SC_DidServices_0xfd0d_ReadData: operation=DidServices_0xfd0d.ReadData
        SC_DidServices_0xfd0d_ReturnControlToECU: operation=DidServices_0xfd0d.ReturnControlToECU
        SC_DidServices_0xfd0d_ShortTermAdjustment: operation=DidServices_0xfd0d.ShortTermAdjustment
        SC_DidServices_0xfd0e_ConditionCheckRead: operation=DidServices_0xfd0e.ConditionCheckRead
        SC_DidServices_0xfd0e_ReadData: operation=DidServices_0xfd0e.ReadData
        SC_DidServices_0xfd10_ConditionCheckRead: operation=DidServices_0xfd10.ConditionCheckRead
        SC_DidServices_0xfd10_ReadData: operation=DidServices_0xfd10.ReadData
        SC_DidServices_0xfd11_ConditionCheckRead: operation=DidServices_0xfd11.ConditionCheckRead
        SC_DidServices_0xfd11_ReadData: operation=DidServices_0xfd11.ReadData
        SC_DidServices_0xfd11_ReturnControlToECU: operation=DidServices_0xfd11.ReturnControlToECU
        SC_DidServices_0xfd11_ShortTermAdjustment: operation=DidServices_0xfd11.ShortTermAdjustment
        SC_DidServices_0xfd12_ConditionCheckRead: operation=DidServices_0xfd12.ConditionCheckRead
        SC_DidServices_0xfd12_ConditionCheckWrite: operation=DidServices_0xfd12.ConditionCheckWrite
        SC_DidServices_0xfd12_ReadData: operation=DidServices_0xfd12.ReadData
        SC_DidServices_0xfd12_WriteData: operation=DidServices_0xfd12.WriteData
        SC_DidServices_0xfd13_ConditionCheckRead: operation=DidServices_0xfd13.ConditionCheckRead
        SC_DidServices_0xfd13_ReadData: operation=DidServices_0xfd13.ReadData
        SC_DidServices_0xfd14_ConditionCheckRead: operation=DidServices_0xfd14.ConditionCheckRead
        SC_DidServices_0xfd14_ReadData: operation=DidServices_0xfd14.ReadData
        SC_DidServices_0xfd17_ConditionCheckRead: operation=DidServices_0xfd17.ConditionCheckRead
        SC_DidServices_0xfd17_ReadData: operation=DidServices_0xfd17.ReadData
        SC_DidServices_0xfd19_ConditionCheckRead: operation=DidServices_0xfd19.ConditionCheckRead
        SC_DidServices_0xfd19_ConditionCheckWrite: operation=DidServices_0xfd19.ConditionCheckWrite
        SC_DidServices_0xfd19_ReadData: operation=DidServices_0xfd19.ReadData
        SC_DidServices_0xfd19_WriteData: operation=DidServices_0xfd19.WriteData
        SC_DidServices_0xfd1a_ConditionCheckRead: operation=DidServices_0xfd1a.ConditionCheckRead
        SC_DidServices_0xfd1a_ReadData: operation=DidServices_0xfd1a.ReadData
        SC_DidServices_0xfd1b_ConditionCheckRead: operation=DidServices_0xfd1b.ConditionCheckRead
        SC_DidServices_0xfd1b_ConditionCheckWrite: operation=DidServices_0xfd1b.ConditionCheckWrite
        SC_DidServices_0xfd1b_ReadData: operation=DidServices_0xfd1b.ReadData
        SC_DidServices_0xfd1b_WriteData: operation=DidServices_0xfd1b.WriteData
        SC_DidServices_0xfd1c_ConditionCheckRead: operation=DidServices_0xfd1c.ConditionCheckRead
        SC_DidServices_0xfd1c_ReadData: operation=DidServices_0xfd1c.ReadData
        SC_DidServices_0xfd1e_ConditionCheckRead: operation=DidServices_0xfd1e.ConditionCheckRead
        SC_DidServices_0xfd1e_ConditionCheckWrite: operation=DidServices_0xfd1e.ConditionCheckWrite
        SC_DidServices_0xfd1e_ReadData: operation=DidServices_0xfd1e.ReadData
        SC_DidServices_0xfd1e_WriteData: operation=DidServices_0xfd1e.WriteData
        SC_DidServices_0xfd20_ConditionCheckRead: operation=DidServices_0xfd20.ConditionCheckRead
        SC_DidServices_0xfd20_ReadData: operation=DidServices_0xfd20.ReadData
        SC_DidServices_0xfd21_ConditionCheckRead: operation=DidServices_0xfd21.ConditionCheckRead
        SC_DidServices_0xfd21_ConditionCheckWrite: operation=DidServices_0xfd21.ConditionCheckWrite
        SC_DidServices_0xfd21_ReadData: operation=DidServices_0xfd21.ReadData
        SC_DidServices_0xfd21_WriteData: operation=DidServices_0xfd21.WriteData
        SC_DidServices_0xfd23_ConditionCheckRead: operation=DidServices_0xfd23.ConditionCheckRead
        SC_DidServices_0xfd23_ConditionCheckWrite: operation=DidServices_0xfd23.ConditionCheckWrite
        SC_DidServices_0xfd23_ReadData: operation=DidServices_0xfd23.ReadData
        SC_DidServices_0xfd23_WriteData: operation=DidServices_0xfd23.WriteData
        SC_DidServices_0xfd25_ConditionCheckRead: operation=DidServices_0xfd25.ConditionCheckRead
        SC_DidServices_0xfd25_ConditionCheckWrite: operation=DidServices_0xfd25.ConditionCheckWrite
        SC_DidServices_0xfd25_ReadData: operation=DidServices_0xfd25.ReadData
        SC_DidServices_0xfd25_WriteData: operation=DidServices_0xfd25.WriteData
        SC_DidServices_0xfd26_ConditionCheckRead: operation=DidServices_0xfd26.ConditionCheckRead
        SC_DidServices_0xfd26_ConditionCheckWrite: operation=DidServices_0xfd26.ConditionCheckWrite
        SC_DidServices_0xfd26_ReadData: operation=DidServices_0xfd26.ReadData
        SC_DidServices_0xfd26_WriteData: operation=DidServices_0xfd26.WriteData
        SC_DidServices_0xfd27_ConditionCheckRead: operation=DidServices_0xfd27.ConditionCheckRead
        SC_DidServices_0xfd27_ConditionCheckWrite: operation=DidServices_0xfd27.ConditionCheckWrite
        SC_DidServices_0xfd27_ReadData: operation=DidServices_0xfd27.ReadData
        SC_DidServices_0xfd27_WriteData: operation=DidServices_0xfd27.WriteData
        SC_DidServices_0xfd29_ConditionCheckRead: operation=DidServices_0xfd29.ConditionCheckRead
        SC_DidServices_0xfd29_ConditionCheckWrite: operation=DidServices_0xfd29.ConditionCheckWrite
        SC_DidServices_0xfd29_ReadData: operation=DidServices_0xfd29.ReadData
        SC_DidServices_0xfd29_WriteData: operation=DidServices_0xfd29.WriteData
        SC_DidServices_0xfd30_ConditionCheckRead: operation=DidServices_0xfd30.ConditionCheckRead
        SC_DidServices_0xfd30_ConditionCheckWrite: operation=DidServices_0xfd30.ConditionCheckWrite
        SC_DidServices_0xfd30_ReadData: operation=DidServices_0xfd30.ReadData
        SC_DidServices_0xfd30_WriteData: operation=DidServices_0xfd30.WriteData
        SC_DidServices_0xfd31_ConditionCheckRead: operation=DidServices_0xfd31.ConditionCheckRead
        SC_DidServices_0xfd31_ReadData: operation=DidServices_0xfd31.ReadData
        SC_DidServices_0xfda1_ConditionCheckRead: operation=DidServices_0xfda1.ConditionCheckRead
        SC_DidServices_0xfda1_ConditionCheckWrite: operation=DidServices_0xfda1.ConditionCheckWrite
        SC_DidServices_0xfda1_ReadData: operation=DidServices_0xfda1.ReadData
        SC_DidServices_0xfda1_WriteData: operation=DidServices_0xfda1.WriteData
        SC_DidServices_0xfda2_ConditionCheckRead: operation=DidServices_0xfda2.ConditionCheckRead
        SC_DidServices_0xfda2_ConditionCheckWrite: operation=DidServices_0xfda2.ConditionCheckWrite
        SC_DidServices_0xfda2_ReadData: operation=DidServices_0xfda2.ReadData
        SC_DidServices_0xfda2_WriteData: operation=DidServices_0xfda2.WriteData
        SC_DidServices_0xfda3_ConditionCheckRead: operation=DidServices_0xfda3.ConditionCheckRead
        SC_DidServices_0xfda3_ConditionCheckWrite: operation=DidServices_0xfda3.ConditionCheckWrite
        SC_DidServices_0xfda3_ReadData: operation=DidServices_0xfda3.ReadData
        SC_DidServices_0xfda3_WriteData: operation=DidServices_0xfda3.WriteData
        SC_DidServices_0xfdac_ConditionCheckRead: operation=DidServices_0xfdac.ConditionCheckRead
        SC_DidServices_0xfdac_ConditionCheckWrite: operation=DidServices_0xfdac.ConditionCheckWrite
        SC_DidServices_0xfdac_ReadData: operation=DidServices_0xfdac.ReadData
        SC_DidServices_0xfdac_WriteData: operation=DidServices_0xfdac.WriteData
        SC_DidServices_0xfdad_ConditionCheckRead: operation=DidServices_0xfdad.ConditionCheckRead
        SC_DidServices_0xfdad_ReadData: operation=DidServices_0xfdad.ReadData
        SC_DidServices_0xfdae_ConditionCheckRead: operation=DidServices_0xfdae.ConditionCheckRead
        SC_DidServices_0xfdae_ConditionCheckWrite: operation=DidServices_0xfdae.ConditionCheckWrite
        SC_DidServices_0xfdae_ReadData: operation=DidServices_0xfdae.ReadData
        SC_DidServices_0xfdae_WriteData: operation=DidServices_0xfdae.WriteData
        SC_DidServices_0xfdaf_ConditionCheckRead: operation=DidServices_0xfdaf.ConditionCheckRead
        SC_DidServices_0xfdaf_ReadData: operation=DidServices_0xfdaf.ReadData
        SC_DidServices_0xfdb0_ConditionCheckRead: operation=DidServices_0xfdb0.ConditionCheckRead
        SC_DidServices_0xfdb0_ConditionCheckWrite: operation=DidServices_0xfdb0.ConditionCheckWrite
        SC_DidServices_0xfdb0_ReadData: operation=DidServices_0xfdb0.ReadData
        SC_DidServices_0xfdb0_WriteData: operation=DidServices_0xfdb0.WriteData
        SC_DidServices_0xfdb1_ConditionCheckRead: operation=DidServices_0xfdb1.ConditionCheckRead
        SC_DidServices_0xfdb1_ConditionCheckWrite: operation=DidServices_0xfdb1.ConditionCheckWrite
        SC_DidServices_0xfdb1_ReadData: operation=DidServices_0xfdb1.ReadData
        SC_DidServices_0xfdb1_WriteData: operation=DidServices_0xfdb1.WriteData
        SC_DidServices_0xfdb2_ConditionCheckRead: operation=DidServices_0xfdb2.ConditionCheckRead
        SC_DidServices_0xfdb2_ConditionCheckWrite: operation=DidServices_0xfdb2.ConditionCheckWrite
        SC_DidServices_0xfdb2_ReadData: operation=DidServices_0xfdb2.ReadData
        SC_DidServices_0xfdb2_WriteData: operation=DidServices_0xfdb2.WriteData
        SC_DidServices_0xfdb3_ConditionCheckRead: operation=DidServices_0xfdb3.ConditionCheckRead
        SC_DidServices_0xfdb3_ConditionCheckWrite: operation=DidServices_0xfdb3.ConditionCheckWrite
        SC_DidServices_0xfdb3_ReadData: operation=DidServices_0xfdb3.ReadData
        SC_DidServices_0xfdb3_WriteData: operation=DidServices_0xfdb3.WriteData
        SC_DidServices_0xfdb4_ConditionCheckRead: operation=DidServices_0xfdb4.ConditionCheckRead
        SC_DidServices_0xfdb4_ConditionCheckWrite: operation=DidServices_0xfdb4.ConditionCheckWrite
        SC_DidServices_0xfdb4_ReadData: operation=DidServices_0xfdb4.ReadData
        SC_DidServices_0xfdb4_WriteData: operation=DidServices_0xfdb4.WriteData
        SC_DidServices_0xfdb5_ConditionCheckRead: operation=DidServices_0xfdb5.ConditionCheckRead
        SC_DidServices_0xfdb5_ConditionCheckWrite: operation=DidServices_0xfdb5.ConditionCheckWrite
        SC_DidServices_0xfdb5_ReadData: operation=DidServices_0xfdb5.ReadData
        SC_DidServices_0xfdb5_WriteData: operation=DidServices_0xfdb5.WriteData
        SC_DidServices_0xfdb6_ConditionCheckRead: operation=DidServices_0xfdb6.ConditionCheckRead
        SC_DidServices_0xfdb6_ConditionCheckWrite: operation=DidServices_0xfdb6.ConditionCheckWrite
        SC_DidServices_0xfdb6_ReadData: operation=DidServices_0xfdb6.ReadData
        SC_DidServices_0xfdb6_WriteData: operation=DidServices_0xfdb6.WriteData
        SC_DidServices_0xfdb7_ConditionCheckRead: operation=DidServices_0xfdb7.ConditionCheckRead
        SC_DidServices_0xfdb7_ConditionCheckWrite: operation=DidServices_0xfdb7.ConditionCheckWrite
        SC_DidServices_0xfdb7_ReadData: operation=DidServices_0xfdb7.ReadData
        SC_DidServices_0xfdb7_WriteData: operation=DidServices_0xfdb7.WriteData
        SC_DidServices_0xfe00_ConditionCheckRead: operation=DidServices_0xfe00.ConditionCheckRead
        SC_DidServices_0xfe00_ReadData: operation=DidServices_0xfe00.ReadData
        SC_DidServices_0xfe00_ReturnControlToECU: operation=DidServices_0xfe00.ReturnControlToECU
        SC_DidServices_0xfe00_ShortTermAdjustment: operation=DidServices_0xfe00.ShortTermAdjustment
        SC_RoutineServices_0xf000_Start: operation=RoutineServices_0xf000.Start
        SC_RoutineServices_0xf001_Start: operation=RoutineServices_0xf001.Start
        SC_RoutineServices_0xf{003..005}_Start: operation=RoutineServices_0xf{003..005}.Start
        SC_RoutineServices_0xf008_Start: operation=RoutineServices_0xf008.Start
        SC_RoutineServices_0xf009_RequestResults: operation=RoutineServices_0xf009.RequestResults
        SC_RoutineServices_0xf009_Start: operation=RoutineServices_0xf009.Start
        SC_RoutineServices_0xf009_Stop: operation=RoutineServices_0xf009.Stop
        SC_RoutineServices_0xf0ff_Start: operation=RoutineServices_0xf0ff.Start
        SC_RoutineServices_0xfee0_Start: operation=RoutineServices_0xfee0.Start
        SC_SecurityAccess_1_CompareKey: operation=SecurityAccess_1.CompareKey
        SC_SecurityAccess_1_GetSeed: operation=SecurityAccess_1.GetSeed
        SC_SessionControl_ChangeIndication: operation=SessionControl.ChangeIndication
        SC_SessionControl_ConfirmationRespPending: operation=SessionControl.ConfirmationRespPending
        SC_SessionControl_GetSesChgPermission: operation=SessionControl.GetSesChgPermission
    runnable GetSecurityLevel: can-be-invoked-concurrently=true, symbol=Dcm_GetSecurityLevel
    runnable GetSesCtrlType: can-be-invoked-concurrently=true, symbol=Dcm_GetSesCtrlType
  service component type Dcm: category=ServiceComponent
    provide port DCMServices: provided-com-specs=[{operation=GetSecurityLevel, queue-length=1}, {operation=GetSesCtrlType, queue-length=1}], provided-interface=DCMServices
    61 x require port:
      DidServices_0x0100: required-com-specs=[ConditionCheckRead, ConditionCheckWrite, ReadData, WriteData], required-interface=DidServices_0x0100
      DidServices_0xf180: required-com-specs=[ConditionCheckRead, ReadData], required-interface=DidServices_0xf180
      DidServices_0xf187: required-com-specs=[ConditionCheckRead, ConditionCheckWrite, ReadData, WriteData], required-interface=DidServices_0xf187
      DidServices_0xf18a: required-com-specs=[ConditionCheckRead, ConditionCheckWrite, ReadData, WriteData], required-interface=DidServices_0xf18a
      DidServices_0xf18c: required-com-specs=[ConditionCheckRead, ReadData], required-interface=DidServices_0xf18c
      DidServices_0xf191: required-com-specs=[ConditionCheckRead, ReadData], required-interface=DidServices_0xf191
      DidServices_0xf{193..195}: required-com-specs=[ConditionCheckRead, ReadData], required-interface=DidServices_0xf{193..195}
      DidServices_0xfd01: required-com-specs=[ConditionCheckRead, ReadData], required-interface=DidServices_0xfd01
      DidServices_0xfd02: required-com-specs=[ConditionCheckRead, ConditionCheckWrite, ReadData, WriteData], required-interface=DidServices_0xfd02
      DidServices_0xfd07: required-com-specs=[ConditionCheckRead, ConditionCheckWrite, ReadData, WriteData], required-interface=DidServices_0xfd07
      DidServices_0xfd0d: required-com-specs=[ConditionCheckRead, ReadData, ReturnControlToECU, ShortTermAdjustment], required-interface=DidServices_0xfd0d
      DidServices_0xfd0e: required-com-specs=[ConditionCheckRead, ReadData], required-interface=DidServices_0xfd0e
      DidServices_0xfd10: required-com-specs=[ConditionCheckRead, ReadData], required-interface=DidServices_0xfd10
      DidServices_0xfd11: required-com-specs=[ConditionCheckRead, ReadData, ReturnControlToECU, ShortTermAdjustment], required-interface=DidServices_0xfd11
      DidServices_0xfd12: required-com-specs=[ConditionCheckRead, ConditionCheckWrite, ReadData, WriteData], required-interface=DidServices_0xfd12
      DidServices_0xfd13: required-com-specs=[ConditionCheckRead, ReadData], required-interface=DidServices_0xfd13
      DidServices_0xfd14: required-com-specs=[ConditionCheckRead, ReadData], required-interface=DidServices_0xfd14
      DidServices_0xfd17: required-com-specs=[ConditionCheckRead, ReadData], required-interface=DidServices_0xfd17
      DidServices_0xfd19: required-com-specs=[ConditionCheckRead, ConditionCheckWrite, ReadData, WriteData], required-interface=DidServices_0xfd19
      DidServices_0xfd1a: required-com-specs=[ConditionCheckRead, ReadData], required-interface=DidServices_0xfd1a
      DidServices_0xfd1b: required-com-specs=[ConditionCheckRead, ConditionCheckWrite, ReadData, WriteData], required-interface=DidServices_0xfd1b
      DidServices_0xfd1c: required-com-specs=[ConditionCheckRead, ReadData], required-interface=DidServices_0xfd1c
      DidServices_0xfd1e: required-com-specs=[ConditionCheckRead, ConditionCheckWrite, ReadData, WriteData], required-interface=DidServices_0xfd1e
      DidServices_0xfd20: required-com-specs=[ConditionCheckRead, ReadData], required-interface=DidServices_0xfd20
      DidServices_0xfd21: required-com-specs=[ConditionCheckRead, ConditionCheckWrite, ReadData, WriteData], required-interface=DidServices_0xfd21
      DidServices_0xfd23: required-com-specs=[ConditionCheckRead, ConditionCheckWrite, ReadData, WriteData], required-interface=DidServices_0xfd23
      DidServices_0xfd{25..27}: required-com-specs=[ConditionCheckRead, ConditionCheckWrite, ReadData, WriteData], required-interface=DidServices_0xfd{25..27}
      DidServices_0xfd29: required-com-specs=[ConditionCheckRead, ConditionCheckWrite, ReadData, WriteData], required-interface=DidServices_0xfd29
      DidServices_0xfd30: required-com-specs=[ConditionCheckRead, ConditionCheckWrite, ReadData, WriteData], required-interface=DidServices_0xfd30
      DidServices_0xfd31: required-com-specs=[ConditionCheckRead, ReadData], required-interface=DidServices_0xfd31
      DidServices_0xfda{1..3}: required-com-specs=[ConditionCheckRead, ConditionCheckWrite, ReadData, WriteData], required-interface=DidServices_0xfda{1..3}
      DidServices_0xfdac: required-com-specs=[ConditionCheckRead, ConditionCheckWrite, ReadData, WriteData], required-interface=DidServices_0xfdac
      DidServices_0xfdad: required-com-specs=[ConditionCheckRead, ReadData], required-interface=DidServices_0xfdad
      DidServices_0xfdae: required-com-specs=[ConditionCheckRead, ConditionCheckWrite, ReadData, WriteData], required-interface=DidServices_0xfdae
      DidServices_0xfdaf: required-com-specs=[ConditionCheckRead, ReadData], required-interface=DidServices_0xfdaf
      DidServices_0xfdb{0..7}: required-com-specs=[ConditionCheckRead, ConditionCheckWrite, ReadData, WriteData], required-interface=DidServices_0xfdb{0..7}
      DidServices_0xfe00: required-com-specs=[ConditionCheckRead, ReadData, ReturnControlToECU, ShortTermAdjustment], required-interface=DidServices_0xfe00
      RoutineServices_0xf000: client-com-spec=Start, required-interface=RoutineServices_0xf000
      RoutineServices_0xf001: client-com-spec=Start, required-interface=RoutineServices_0xf001
      RoutineServices_0xf{003..005}: client-com-spec=Start, required-interface=RoutineServices_0xf{003..005}
      RoutineServices_0xf008: client-com-spec=Start, required-interface=RoutineServices_0xf008
      RoutineServices_0xf009: required-com-specs=[RequestResults, Start, Stop], required-interface=RoutineServices_0xf009
      RoutineServices_0xf0ff: client-com-spec=Start, required-interface=RoutineServices_0xf0ff
      RoutineServices_0xfee0: client-com-spec=Start, required-interface=RoutineServices_0xfee0
      SecurityAccess_1: required-com-specs=[CompareKey, GetSeed], required-interface=SecurityAccess_1
      SessionControl: required-com-specs=[ChangeIndication, ConfirmationRespPending, GetSesChgPermission], required-interface=SessionControl
  swc implementation Dcm_Implementation: behavior=Dcm_InternalBehavior
    code-descriptors:
      code Code: type=SRC
