AUTOSAR XML (schema 3.0.1)
package /MICROSAR
  module config SchM_Rec: definition=SchM, implementation-config-variant=VARIANT-PRE-COMPILE  # Configuration of the SchM (BSW Scheduler) module.
    4 x SchMMainFunctionMapping, all with SchMBswUsedOsEvent=SchM_AsyncEvent_1, SchMBswUsedOsAlarm=SchM_Alarm_Async_1, SchMBswActivationOffset=0.002, SchMTaskConfigurationRef=SchM_AsyncTask_1:
      Can_MainFunction_Write: SchMPositionInTask=2
      Can_MainFunction_Read: SchMPositionInTask=3
      Can_MainFunction_BusOff: SchMPositionInTask=4
      Can_MainFunction_Wakeup: SchMPositionInTask=5
