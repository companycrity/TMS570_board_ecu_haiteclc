AUTOSAR XML (schema 3.0.1)
standard types defined: Boolean, UInt8, UInt16, UInt32
package /ComponentType
  internal behavior DemInternalBehavior: component=Dem
    timing event Timer_Dem_MainFunction: start-on-event=Dem_MainFunction, period=0.01
    103 x operation invoked event:
      OpEventDiagnosticMonito_52826b3e: start-on-event=SetEventStatus, operation=Event_CTC_0x505700.SetEventStatus
      OpEventDiagnosticMonito_51c88e60: start-on-event=ResetEventStatus, operation=Event_CTC_0x505700.ResetEventStatus
      OpEventDiagnosticMonito_2d9cd849: start-on-event=GetEventStatus, operation=Event_CTC_0x505700.GetEventStatus
      OpEventDiagnosticMonito_c8171e22: start-on-event=GetEventFailed, operation=Event_CTC_0x505700.GetEventFailed
      OpEventDiagnosticMonito_5e185e41: start-on-event=GetEventTested, operation=Event_CTC_0x505700.GetEventTested
      OpEventDiagnosticMonito_4fdf47e0: start-on-event=GetDTCOfEvent, operation=Event_CTC_0x505700.GetDTCOfEvent
      OpEventDiagnosticMonito_cbd6d252: start-on-event=GetFaultDetectionCounter, operation=Event_CTC_0x505700.GetFaultDetectionCounter
      OpEventDiagnosticMonito_35e840e1: start-on-event=SetEventStatus, operation=Event_CTC_0x505800.SetEventStatus
      OpEventDiagnosticMonito_b93876f7: start-on-event=ResetEventStatus, operation=Event_CTC_0x505800.ResetEventStatus
      OpEventDiagnosticMonito_fbf6bacd: start-on-event=GetEventStatus, operation=Event_CTC_0x505800.GetEventStatus
      OpEventDiagnosticMonito_217389db: start-on-event=GetEventFailed, operation=Event_CTC_0x505800.GetEventFailed
      OpEventDiagnosticMonito_f55eb679: start-on-event=GetEventTested, operation=Event_CTC_0x505800.GetEventTested
      OpEventDiagnosticMonito_549ee21e: start-on-event=GetDTCOfEvent, operation=Event_CTC_0x505800.GetDTCOfEvent
      OpEventDiagnosticMonito_7175392b: start-on-event=GetFaultDetectionCounter, operation=Event_CTC_0x505800.GetFaultDetectionCounter
      OpEventDiagnosticMonito_42ef7077: start-on-event=SetEventStatus, operation=Event_CTC_0x505900.SetEventStatus
      OpEventDiagnosticMonito_ce3f4661: start-on-event=ResetEventStatus, operation=Event_CTC_0x505900.ResetEventStatus
      OpEventDiagnosticMonito_8cf18a5b: start-on-event=GetEventStatus, operation=Event_CTC_0x505900.GetEventStatus
      OpEventDiagnosticMonito_5674b94d: start-on-event=GetEventFailed, operation=Event_CTC_0x505900.GetEventFailed
      OpEventDiagnosticMonito_825986ef: start-on-event=GetEventTested, operation=Event_CTC_0x505900.GetEventTested
      OpEventDiagnosticMonito_2399d288: start-on-event=GetDTCOfEvent, operation=Event_CTC_0x505900.GetDTCOfEvent
      OpEventDiagnosticMonito_067209bd: start-on-event=GetFaultDetectionCounter, operation=Event_CTC_0x505900.GetFaultDetectionCounter
      OpEventDiagnosticMonito_dbe621cd: start-on-event=SetEventStatus, operation=Event_CTC_0xD00300.SetEventStatus
      OpEventDiagnosticMonito_573617db: start-on-event=ResetEventStatus, operation=Event_CTC_0xD00300.ResetEventStatus
      OpEventDiagnosticMonito_15f8dbe1: start-on-event=GetEventStatus, operation=Event_CTC_0xD00300.GetEventStatus
      OpEventDiagnosticMonito_cf7de8f7: start-on-event=GetEventFailed, operation=Event_CTC_0xD00300.GetEventFailed
      OpEventDiagnosticMonito_1b50d755: start-on-event=GetEventTested, operation=Event_CTC_0xD00300.GetEventTested
      OpEventDiagnosticMonito_ba908332: start-on-event=GetDTCOfEvent, operation=Event_CTC_0xD00300.GetDTCOfEvent
      OpEventDiagnosticMonito_9f7b5807: start-on-event=GetFaultDetectionCounter, operation=Event_CTC_0xD00300.GetFaultDetectionCounter
      OpEventDiagnosticMonito_ace1115b: start-on-event=SetEventStatus, operation=Event_CTC_0xD11700.SetEventStatus
      OpEventDiagnosticMonito_2031274d: start-on-event=ResetEventStatus, operation=Event_CTC_0xD11700.ResetEventStatus
      OpEventDiagnosticMonito_62ffeb77: start-on-event=GetEventStatus, operation=Event_CTC_0xD11700.GetEventStatus
      OpEventDiagnosticMonito_b87ad861: start-on-event=GetEventFailed, operation=Event_CTC_0xD11700.GetEventFailed
      OpEventDiagnosticMonito_6c57e7c3: start-on-event=GetEventTested, operation=Event_CTC_0xD11700.GetEventTested
      OpEventDiagnosticMonito_cd97b3a4: start-on-event=GetDTCOfEvent, operation=Event_CTC_0xD11700.GetDTCOfEvent
      OpEventDiagnosticMonito_e87c6891: start-on-event=GetFaultDetectionCounter, operation=Event_CTC_0xD11700.GetFaultDetectionCounter
      OpEventDiagnosticMonito_328584f8: start-on-event=SetEventStatus, operation=Event_CTC_0xD12100.SetEventStatus
      OpEventDiagnosticMonito_be55b2ee: start-on-event=ResetEventStatus, operation=Event_CTC_0xD12100.ResetEventStatus
      OpEventDiagnosticMonito_fc9b7ed4: start-on-event=GetEventStatus, operation=Event_CTC_0xD12100.GetEventStatus
      OpEventDiagnosticMonito_261e4dc2: start-on-event=GetEventFailed, operation=Event_CTC_0xD12100.GetEventFailed
      OpEventDiagnosticMonito_f2337260: start-on-event=GetEventTested, operation=Event_CTC_0xD12100.GetEventTested
      OpEventDiagnosticMonito_53f32607: start-on-event=GetDTCOfEvent, operation=Event_CTC_0xD12100.GetDTCOfEvent
      OpEventDiagnosticMonito_7618fd32: start-on-event=GetFaultDetectionCounter, operation=Event_CTC_0xD12100.GetFaultDetectionCounter
      OpEventDiagnosticMonito_4582b46e: start-on-event=SetEventStatus, operation=Event_CTC_0xD14000.SetEventStatus
      OpEventDiagnosticMonito_c9528278: start-on-event=ResetEventStatus, operation=Event_CTC_0xD14000.ResetEventStatus
      OpEventDiagnosticMonito_8b9c4e42: start-on-event=GetEventStatus, operation=Event_CTC_0xD14000.GetEventStatus
      OpEventDiagnosticMonito_51197d54: start-on-event=GetEventFailed, operation=Event_CTC_0xD14000.GetEventFailed
      OpEventDiagnosticMonito_853442f6: start-on-event=GetEventTested, operation=Event_CTC_0xD14000.GetEventTested
      OpEventDiagnosticMonito_24f41691: start-on-event=GetDTCOfEvent, operation=Event_CTC_0xD14000.GetDTCOfEvent
      OpEventDiagnosticMonito_011fcda4: start-on-event=GetFaultDetectionCounter, operation=Event_CTC_0xD14000.GetFaultDetectionCounter
      OpEventOperationCycleSe_d13956d3: start-on-event=SetOperationCycleState, operation=OpCycle_DEM_IGNITION.SetOperationCycleState
      OpEventOperationCycleSe_ebd06519: start-on-event=SetOperationCycleState, operation=OpCycle_DEM_OBD_DCY.SetOperationCycleState
      OpEventOperationCycleSe_9cd7558f: start-on-event=SetOperationCycleState, operation=OpCycle_DEM_POWER.SetOperationCycleState
      OpEventOperationCycleSe_05de0435: start-on-event=SetOperationCycleState, operation=OpCycle_DEM_WARMUP.SetOperationCycleState
      OpEventIndicatorStatusG_1495fc2f: start-on-event=GetIndicatorStatus, operation=IndStatus_EpasFailed.GetIndicatorStatus
      OpEventDiagnosticMonito_dc8be5d4: start-on-event=SetEventStatus, operation=Event_CTC_0x505100.SetEventStatus
      OpEventDiagnosticMonito_505bd3c2: start-on-event=ResetEventStatus, operation=Event_CTC_0x505100.ResetEventStatus
      OpEventDiagnosticMonito_12951ff8: start-on-event=GetEventStatus, operation=Event_CTC_0x505100.GetEventStatus
      OpEventDiagnosticMonito_c8102cee: start-on-event=GetEventFailed, operation=Event_CTC_0x505100.GetEventFailed
      OpEventDiagnosticMonito_1c3d134c: start-on-event=GetEventTested, operation=Event_CTC_0x505100.GetEventTested
      OpEventDiagnosticMonito_bdfd472b: start-on-event=GetDTCOfEvent, operation=Event_CTC_0x505100.GetDTCOfEvent
      OpEventDiagnosticMonito_98169c1e: start-on-event=GetFaultDetectionCounter, operation=Event_CTC_0x505100.GetFaultDetectionCounter
      OpEventDiagnosticMonito_ab8cd542: start-on-event=SetEventStatus, operation=Event_CTC_0x505200.SetEventStatus
      OpEventDiagnosticMonito_275ce354: start-on-event=ResetEventStatus, operation=Event_CTC_0x505200.ResetEventStatus
      OpEventDiagnosticMonito_65922f6e: start-on-event=GetEventStatus, operation=Event_CTC_0x505200.GetEventStatus
      OpEventDiagnosticMonito_bf171c78: start-on-event=GetEventFailed, operation=Event_CTC_0x505200.GetEventFailed
      OpEventDiagnosticMonito_6b3a23da: start-on-event=GetEventTested, operation=Event_CTC_0x505200.GetEventTested
      OpEventDiagnosticMonito_cafa77bd: start-on-event=GetDTCOfEvent, operation=Event_CTC_0x505200.GetDTCOfEvent
      OpEventDiagnosticMonito_ef11ac88: start-on-event=GetFaultDetectionCounter, operation=Event_CTC_0x505200.GetFaultDetectionCounter
      OpEventDiagnosticMonito_3b33c8d3: start-on-event=SetEventStatus, operation=Event_CTC_0x505316.SetEventStatus
      OpEventDiagnosticMonito_b7e3fec5: start-on-event=ResetEventStatus, operation=Event_CTC_0x505316.ResetEventStatus
      OpEventDiagnosticMonito_f52d32ff: start-on-event=GetEventStatus, operation=Event_CTC_0x505316.GetEventStatus
      OpEventDiagnosticMonito_2fa801e9: start-on-event=GetEventFailed, operation=Event_CTC_0x505316.GetEventFailed
      OpEventDiagnosticMonito_fb853e4b: start-on-event=GetEventTested, operation=Event_CTC_0x505316.GetEventTested
      OpEventDiagnosticMonito_5a456a2c: start-on-event=GetDTCOfEvent, operation=Event_CTC_0x505316.GetDTCOfEvent
      OpEventDiagnosticMonito_7faeb119: start-on-event=GetFaultDetectionCounter, operation=Event_CTC_0x505316.GetFaultDetectionCounter
      OpEventDiagnosticMonito_4c34f845: start-on-event=SetEventStatus, operation=Event_CTC_0x505600.SetEventStatus
      OpEventDiagnosticMonito_c0e4ce53: start-on-event=ResetEventStatus, operation=Event_CTC_0x505600.ResetEventStatus
      OpEventDiagnosticMonito_822a0269: start-on-event=GetEventStatus, operation=Event_CTC_0x505600.GetEventStatus
      OpEventDiagnosticMonito_58af317f: start-on-event=GetEventFailed, operation=Event_CTC_0x505600.GetEventFailed
      OpEventDiagnosticMonito_8c820edd: start-on-event=GetEventTested, operation=Event_CTC_0x505600.GetEventTested
      OpEventDiagnosticMonito_2d425aba: start-on-event=GetDTCOfEvent, operation=Event_CTC_0x505600.GetDTCOfEvent
      OpEventDiagnosticMonito_08a9818f: start-on-event=GetFaultDetectionCounter, operation=Event_CTC_0x505600.GetFaultDetectionCounter
      OpEventDiagnosticMonito_3af8d4ce: start-on-event=SetEventStatus, operation=Event_CTC_0x505500.SetEventStatus
      OpEventDiagnosticMonito_cea0b1a9: start-on-event=ResetEventStatus, operation=Event_CTC_0x505500.ResetEventStatus
      OpEventDiagnosticMonito_08eea6d7: start-on-event=GetEventStatus, operation=Event_CTC_0x505500.GetEventStatus
      OpEventDiagnosticMonito_fce096b5: start-on-event=GetEventFailed, operation=Event_CTC_0x505500.GetEventFailed
      OpEventDiagnosticMonito_c4ec794e: start-on-event=GetEventTested, operation=Event_CTC_0x505500.GetEventTested
      OpEventDiagnosticMonito_179b4de1: start-on-event=GetDTCOfEvent, operation=Event_CTC_0x505500.GetDTCOfEvent
      OpEventDiagnosticMonito_410d6219: start-on-event=GetFaultDetectionCounter, operation=Event_CTC_0x505500.GetFaultDetectionCounter
      OpEventDiagnosticMonito_4dffe458: start-on-event=SetEventStatus, operation=Event_CTC_0x505317.SetEventStatus
      OpEventDiagnosticMonito_b9a7813f: start-on-event=ResetEventStatus, operation=Event_CTC_0x505317.ResetEventStatus
      OpEventDiagnosticMonito_7fe99641: start-on-event=GetEventStatus, operation=Event_CTC_0x505317.GetEventStatus
      OpEventDiagnosticMonito_8be7a623: start-on-event=GetEventFailed, operation=Event_CTC_0x505317.GetEventFailed
      OpEventDiagnosticMonito_b3eb49d8: start-on-event=GetEventTested, operation=Event_CTC_0x505317.GetEventTested
      OpEventDiagnosticMonito_609c7d77: start-on-event=GetDTCOfEvent, operation=Event_CTC_0x505317.GetDTCOfEvent
      OpEventDiagnosticMonito_360a528f: start-on-event=GetFaultDetectionCounter, operation=Event_CTC_0x505317.GetFaultDetectionCounter
      OpEventDiagnosticMonito_d4f6b5e2: start-on-event=SetEventStatus, operation=Event_CTC_0x505400.SetEventStatus
      OpEventDiagnosticMonito_20aed085: start-on-event=ResetEventStatus, operation=Event_CTC_0x505400.ResetEventStatus
      OpEventDiagnosticMonito_e6e0c7fb: start-on-event=GetEventStatus, operation=Event_CTC_0x505400.GetEventStatus
      OpEventDiagnosticMonito_12eef799: start-on-event=GetEventFailed, operation=Event_CTC_0x505400.GetEventFailed
      OpEventDiagnosticMonito_2ae21862: start-on-event=GetEventTested, operation=Event_CTC_0x505400.GetEventTested
      OpEventDiagnosticMonito_f9952ccd: start-on-event=GetDTCOfEvent, operation=Event_CTC_0x505400.GetDTCOfEvent
      OpEventDiagnosticMonito_af030335: start-on-event=GetFaultDetectionCounter, operation=Event_CTC_0x505400.GetFaultDetectionCounter
    port-api-option enable-take-address=true, indirect-api=false, port=Event_CTC_0x505100:
      port-arg-values:
        integer literal Event_CTC_0x505100: type=Dem_EventIdType, value=14
    port-api-option enable-take-address=true, indirect-api=false, port=Event_CTC_0x505200:
      port-arg-values:
        integer literal Event_CTC_0x505200: type=Dem_EventIdType, value=13
    port-api-option enable-take-address=true, indirect-api=false, port=Event_CTC_0x505316:
      port-arg-values:
        integer literal Event_CTC_0x505316: type=Dem_EventIdType, value=12
    port-api-option enable-take-address=true, indirect-api=false, port=Event_CTC_0x505317:
      port-arg-values:
        integer literal Event_CTC_0x505317: type=Dem_EventIdType, value=11
    port-api-option enable-take-address=true, indirect-api=false, port=Event_CTC_0x505400:
      port-arg-values:
        integer literal Event_CTC_0x505400: type=Dem_EventIdType, value=10
    port-api-option enable-take-address=true, indirect-api=false, port=Event_CTC_0x505500:
      port-arg-values:
        integer literal Event_CTC_0x505500: type=Dem_EventIdType, value=9
    port-api-option enable-take-address=true, indirect-api=false, port=Event_CTC_0x505600:
      port-arg-values:
        integer literal Event_CTC_0x505600: type=Dem_EventIdType, value=8
    port-api-option enable-take-address=true, indirect-api=false, port=Event_CTC_0x505700:
      port-arg-values:
        integer literal Event_CTC_0x505700: type=Dem_EventIdType, value=7
    port-api-option enable-take-address=true, indirect-api=false, port=Event_CTC_0x505800:
      port-arg-values:
        integer literal Event_CTC_0x505800: type=Dem_EventIdType, value=6
    port-api-option enable-take-address=true, indirect-api=false, port=Event_CTC_0x505900:
      port-arg-values:
        integer literal Event_CTC_0x505900: type=Dem_EventIdType, value=5
    port-api-option enable-take-address=true, indirect-api=false, port=Event_CTC_0xD00300:
      port-arg-values:
        integer literal Event_CTC_0xD00300: type=Dem_EventIdType, value=4
    port-api-option enable-take-address=true, indirect-api=false, port=Event_CTC_0xD11700:
      port-arg-values:
        integer literal Event_CTC_0xD11700: type=Dem_EventIdType, value=3
    port-api-option enable-take-address=true, indirect-api=false, port=Event_CTC_0xD12100:
      port-arg-values:
        integer literal Event_CTC_0xD12100: type=Dem_EventIdType, value=2
    port-api-option enable-take-address=true, indirect-api=false, port=Event_CTC_0xD14000:
      port-arg-values:
        integer literal Event_CTC_0xD14000: type=Dem_EventIdType, value=1
    port-api-option enable-take-address=true, indirect-api=false, port=OpCycle_DEM_IGNITION:
      port-arg-values:
        integer literal OpCycle_DEM_IGNITION: type=Dem_OperationCycleIdType, value=0
    port-api-option enable-take-address=true, indirect-api=false, port=OpCycle_DEM_OBD_DCY:
      port-arg-values:
        integer literal OpCycle_DEM_OBD_DCY: type=Dem_OperationCycleIdType, value=1
    port-api-option enable-take-address=true, indirect-api=false, port=OpCycle_DEM_POWER:
      port-arg-values:
        integer literal OpCycle_DEM_POWER: type=Dem_OperationCycleIdType, value=3
    port-api-option enable-take-address=true, indirect-api=false, port=OpCycle_DEM_WARMUP:
      port-arg-values:
        integer literal OpCycle_DEM_WARMUP: type=Dem_OperationCycleIdType, value=2
    port-api-option enable-take-address=true, indirect-api=false, port=IndStatus_EpasFailed:
      port-arg-values:
        integer literal IndStatus_EpasFailed: type=UInt8, value=0
    10 x runnable:
      Dem_MainFunction
      SetEventStatus: can-be-invoked-concurrently=true, symbol=Dem_SetEventStatus
      ResetEventStatus: can-be-invoked-concurrently=true, symbol=Dem_ResetEventStatus
      GetEventStatus: can-be-invoked-concurrently=true, symbol=Dem_GetEventStatus
      GetEventFailed: can-be-invoked-concurrently=true, symbol=Dem_GetEventFailed
      GetEventTested: can-be-invoked-concurrently=true, symbol=Dem_GetEventTested
      GetDTCOfEvent: can-be-invoked-concurrently=true, symbol=Dem_GetDTCOfEvent
      GetFaultDetectionCounter: can-be-invoked-concurrently=true, symbol=Dem_GetFaultDetectionCounter
      SetOperationCycleState: can-be-invoked-concurrently=true, symbol=Dem_SetOperationCycleState
      GetIndicatorStatus: can-be-invoked-concurrently=true, symbol=Dem_GetIndicatorStatus
  swc implementation DemImplementation: behavior=DemInternalBehavior
  service component type Dem: category=ServiceComponent
    19 x provide port:
      Event_CTC_0x505100: provided-interface=DiagnosticMonitor
      Event_CTC_0x505200: provided-interface=DiagnosticMonitor
      Event_CTC_0x505316: provided-interface=DiagnosticMonitor
      Event_CTC_0x505317: provided-interface=DiagnosticMonitor
      Event_CTC_0x505400: provided-interface=DiagnosticMonitor
      Event_CTC_0x505500: provided-interface=DiagnosticMonitor
      Event_CTC_0x505600: provided-interface=DiagnosticMonitor
      Event_CTC_0x505700: provided-interface=DiagnosticMonitor
      Event_CTC_0x505800: provided-interface=DiagnosticMonitor
      Event_CTC_0x505900: provided-interface=DiagnosticMonitor
      Event_CTC_0xD00300: provided-interface=DiagnosticMonitor
      Event_CTC_0xD11700: provided-interface=DiagnosticMonitor
      Event_CTC_0xD12100: provided-interface=DiagnosticMonitor
      Event_CTC_0xD14000: provided-interface=DiagnosticMonitor
      OpCycle_DEM_IGNITION: provided-interface=OperationCycle
      OpCycle_DEM_OBD_DCY: provided-interface=OperationCycle
      OpCycle_DEM_POWER: provided-interface=OperationCycle
      OpCycle_DEM_WARMUP: provided-interface=OperationCycle
      IndStatus_EpasFailed: provided-interface=IndicatorStatus
package /PortInterface
  client server interface DiagnosticMonitor: is-service=true
    7 x operation:
      SetEventStatus: possible-error=[DiagnosticMonitor/E_NOT_OK, DiagnosticMonitor/DEM_E_QUEUE_OVERFLOW]
        arg EventStatus: type=Dem_EventStatusType, direction=IN
      ResetEventStatus: possible-error=[DiagnosticMonitor/E_NOT_OK, DiagnosticMonitor/DEM_E_QUEUE_OVERFLOW]
      GetEventStatus: possible-error=DiagnosticMonitor/E_NOT_OK
        arg EventStatus: type=Dem_EventStatusExtendedType, direction=OUT
      GetEventFailed: possible-error=DiagnosticMonitor/E_NOT_OK
        arg Failed: type=Boolean, direction=OUT
      GetEventTested: possible-error=DiagnosticMonitor/E_NOT_OK
        arg Failed: type=Boolean, direction=OUT
      GetDTCOfEvent: possible-error=[DiagnosticMonitor/E_NOT_OK, DEM_GET_DTCOFEVENT_WRONG_DTCKIND, DEM_GET_DTCOFEVENT_WRONG_EVENTID]
        arg DTCKind: type=Dem_DTCKindType, direction=IN
        arg DTC: type=Dem_DTCType, direction=OUT
      GetFaultDetectionCounter: possible-error=DiagnosticMonitor/E_NOT_OK
        arg EventIdFaultDetectionCounter: type=Dem_FaultDetectionCounterType, direction=OUT
    4 x error:
      E_NOT_OK: error-code=1
      DEM_GET_DTCOFEVENT_WRONG_DTCKIND: error-code=4
      DEM_GET_DTCOFEVENT_WRONG_EVENTID: error-code=5
      DEM_E_QUEUE_OVERFLOW: error-code=15
  client server interface OperationCycle: is-service=true
    operation SetOperationCycleState: possible-error=[OperationCycle/E_NOT_OK, OperationCycle/DEM_E_QUEUE_OVERFLOW]
      arg CycleState: type=Dem_OperationCycleStateType, direction=IN
    error E_NOT_OK: error-code=1
    error DEM_E_QUEUE_OVERFLOW: error-code=15
  client server interface IndicatorStatus: is-service=true
    operation GetIndicatorStatus: possible-error=IndicatorStatus/E_NOT_OK
      arg IndicatorStatus: type=Dem_IndicatorStatusType, direction=OUT
    error E_NOT_OK: error-code=1
package /DataType
  integer type Dem_EventIdType: lower-limit=0, upper-limit=255
  integer type Dem_EventStatusType: compu {0=DEM_EVENT_STATUS_PASSED, 1=DEM_EVENT_STATUS_FAILED, 2=DEM_EVENT_STATUS_PREPASSED, 3=DEM_EVENT_STATUS_PREFAILED}, lower-limit=0, upper-limit=255
  integer type Dem_EventStatusExtendedType: lower-limit=0, upper-limit=255
  integer type Dem_DTCKindType: compu {1=DEM_DTC_KIND_ALL_DTCS, 2=DEM_DTC_KIND_EMISSION_REL_DTCS}, lower-limit=1, upper-limit=2
  integer type Dem_DTCType: lower-limit=0, upper-limit=4294967295
  integer type Dem_InitMonitorKindType: compu {1=DEM_INIT_MONITOR_CLEAR, 2=DEM_INIT_MONITOR_RESTART}, lower-limit=0, upper-limit=2
  integer type Dem_DTCStatusMaskType: lower-limit=0, upper-limit=255
  integer type Dem_OperationCycleIdType: lower-limit=0, upper-limit=255
  integer type Dem_OperationCycleStateType: compu {1=DEM_CYCLE_STATE_START, 2=DEM_CYCLE_STATE_END}, lower-limit=1, upper-limit=2
  integer type Dem_IndicatorStatusType: compu {0=DEM_INDICATOR_OFF, 1=DEM_INDICATOR_CONTINUOUS, 2=DEM_INDICATOR_BLINKING, 3=DEM_INDICATOR_BLINK_CONT}, lower-limit=0, upper-limit=3
  integer type Dem_FaultDetectionCounterType: lower-limit=-128, upper-limit=127
  array type Dem_MaxDataValueType
    element Dem_MaxDataValueType: type=UInt8, max-number-of-elements=1
  array type Dem_MaxExtendedDataRecordType
    element Dem_MaxExtendedDataRecordType: type=UInt8, max-number-of-elements=1
  integer type Dem_SuppressDTCStatusType: compu {0=DEM_SUPPRESS_DTC_OFF, 1=DEM_SUPPRESS_DTC_ON}, lower-limit=0, upper-limit=1
