AUTOSAR XML (schema 3.0.1)
package /MICROSAR
  module config SchM_Rec: definition=SchM, implementation-config-variant=VARIANT-PRE-COMPILE  # Configuration of the SchM (BSW Scheduler) module.
    PduR (SchMModuleConfiguration): SchMModuleLiteral=PduR, SchMModuleInclude=PduR.h, SchMModuleConfigVersion=1.0.0, SchMModuleImplementationRef=PduR_Impl
      SCHM_PDUR_INSTANCE_0 (InstanceConfiguration): SchMInstanceLiteral=SCHM_PDUR_INSTANCE_0
        PDUR_EXCLUSIVE_AREA_0 (ExclusiveAreaConf):
          SchMExclusiveAreaLiteral = PDUR_EXCLUSIVE_AREA_0
          SchMExclusiveAreaDescription = This critical section has to lock global interrupts to protect common critical sections.
    PduR_MainFunction (SchMMainFunctionMapping): SchMMainFunctionSymbol=PduR_MainFunction, SchMModuleRef=PduR
      SchMBswEvent
        SchMBswTimingEvent: SchMMainFunctionPeriod=0.005
